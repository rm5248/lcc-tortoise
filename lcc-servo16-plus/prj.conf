## CMakeLists.txt
```
# SPDX-License-Identifier: Apache-2.0

cmake_minimum_required(VERSION 3.20.0)
find_package(Zephyr REQUIRED HINTS $ENV{ZEPHYR_BASE})
project(LCC-Tortoise)

# Bring in the LCC library
#set(LIBLCC_ENABLE_STATIC_CONTEXT ON)
#add_subdirectory(TrainUtils/LCC)

# Zephyr does not want to play with third party libraries nicely:
# https://github.com/zephyrproject-rtos/zephyr/issues/8439
# So we do the highly annoying thing here of re-creating part of the liblcc cmake file
# in order to bring in all of the sources that we need
set(TRAINUTILS_DIR "${CMAKE_CURRENT_SOURCE_DIR}/../TrainUtils")
include(${TRAINUTILS_DIR}/LCC/lcc-version)

file(GLOB lcc-sources
    ${TRAINUTILS_DIR}/LCC/*.c
    ${TRAINUTILS_DIR}/LCC/*.h
    ${TRAINUTILS_DIR}/DCC/*.h
    ${TRAINUTILS_DIR}/DCC/*.c
)

target_sources(app PRIVATE 
	src/main.c 
	src/servo16-state.c
	src/pca9685_board.c
	src/servo16-output-state.c
	src/power-handler.c
	src/led-funcs/led-process-pulse.c
	src/led-funcs/led-process-onoff.c
	src/led-funcs/led-process-fade.c
	${lcc-sources}
	../common/firmware_upgrade.h
	../common/firmware_upgrade.c
	../common/dcc-decode-stm32.h
	../common/dcc-decode-stm32.c
	../common/adc_utils.h
	../common/adc_utils.c
	../common/partition_utils.c
	../common/configuration_flusher.c
)
target_include_directories(app PRIVATE
	${TRAINUTILS_DIR}/LCC
	${CMAKE_CURRENT_BINARY_DIR}/TrainUtils/LCC
	${TRAINUTILS_DIR}/DCC
	../common/
)
set_property(TARGET app PROPERTY C_STANDARD 11)

string(REPLACE "." ";" VERSION_LIST ${LIBLCC_VERSION})
list(GET VERSION_LIST 0 LCC_VERSION_MAJOR)
list(GET VERSION_LIST 1 LCC_VERSION_MINOR)
list(GET VERSION_LIST 2 LCC_VERSION_PATCH)
target_compile_definitions(app PRIVATE
    LIBLCC_BUILD
)
set(LIBLCC_DEBUG 0)
set(LIBLCC_ENABLE_STATIC_CONTEXT 1)
set(LIBLCC_EVENT_LIST_STATIC_SIZE 1024)
set(PROJECT_VERSION_MAJOR ${LCC_VERSION_MAJOR})
set(PROJECT_VERSION_MINOR ${LCC_VERSION_MINOR})
set(PROJECT_VERSION_PATCH ${LCC_VERSION_PATCH})
configure_file( ${TRAINUTILS_DIR}/LCC/lcc-config.h.cmake TrainUtils/LCC/lcc-config.h )
```

## sysbuild.conf
```
# Sysbuild configuration file.

# Enable MCUboot per default for this sample.
SB_CONFIG_BOOTLOADER_MCUBOOT=y
#SB_CONFIG_BOOT_SIGNATURE_TYPE_NONE=y
SB_CONFIG_BOOT_SIGNATURE_KEY_FILE="${APP_DIR}/lcc-servo16-plus.pem"
```

## prj.conf
```kconfig
CONFIG_SERIAL=y
CONFIG_SPI=y
CONFIG_SYS_CLOCK_TICKS_PER_SEC=100000
CONFIG_COUNTER=y
# CONFIG_INIT_ARCH_HW_AT_BOOT is not set
CONFIG_FLASH=y
CONFIG_GPIO=y
CONFIG_LOG=y
CONFIG_CONSOLE=y
CONFIG_REBOOT=y
CONFIG_BOOTLOADER_MCUBOOT=y
CONFIG_MCUBOOT_SIGNATURE_KEY_FILE="/home/robert/lcc-workspace/lcc-tortoise/lcc-servo16-plus/lcc-servo16-plus.pem"
CONFIG_ARM_MPU=y
CONFIG_POLL=y
CONFIG_ADC=y
CONFIG_CAN=y
CONFIG_UART_CONSOLE=y
CONFIG_EEPROM=y
CONFIG_PINCTRL_DYNAMIC=y
CONFIG_PWM=y
CONFIG_CONSOLE_SUBSYS=y
CONFIG_CONSOLE_GETLINE=y
CONFIG_IMG_MANAGER=y
CONFIG_MCUBOOT_UPDATE_FOOTER_SIZE=0x1800
CONFIG_FLASH_MAP=y
CONFIG_STREAM_FLASH=y
CONFIG_ROM_END_OFFSET=0x1950
CONFIG_KERNEL_BIN_NAME="lcc-servo16-plus"
```

## src/main.c
```c
/*
 * SPDX-License-Identifier: GPL-2.0
 */

#include <stdio.h>
#include <stdlib.h>
#include <assert.h>
#include <zephyr/kernel.h>
#include <zephyr/drivers/gpio.h>
#include <zephyr/drivers/can.h>
#include <zephyr/drivers/eeprom.h>
#include <zephyr/drivers/pwm.h>
#include <zephyr/drivers/led.h>
#include <zephyr/storage/flash_map.h>
#include <zephyr/device.h>
#include <zephyr/sys/reboot.h>
#include <zephyr/console/console.h>
#include <zephyr/dfu/mcuboot.h>
#include <zephyr/drivers/uart.h>
#include <zephyr/logging/log.h>

#include "firmware_upgrade.h"
#include "lcc.h"
#include "lcc-event.h"
#include "lcc-memory.h"
#include "lcc-memory-map.h"
#include "servo16-config.h"
#include "cdi.h"
#include "pca9685_board.h"
#include "servo16-output-state.h"
#include "power-handler.h"
#include "partition_utils.h"

#include "dcc-packet-parser.h"
#include "app_version.h"

LOG_MODULE_REGISTER(servo16_main, LOG_LEVEL_DBG);

const struct device *const can_dev = DEVICE_DT_GET(DT_CHOSEN(zephyr_canbus));
static struct lcc_can_frame lcc_rx;
static struct lcc_context* lcc_ctx;

static struct gpio_callback blue_button_cb_data;
static struct gpio_callback gold_button_cb_data;

const struct gpio_dt_spec green_led = GPIO_DT_SPEC_GET(DT_ALIAS(greenled), gpios);
const struct gpio_dt_spec blue_led = GPIO_DT_SPEC_GET(DT_ALIAS(blueled), gpios);
const struct gpio_dt_spec gold_led = GPIO_DT_SPEC_GET(DT_ALIAS(goldled), gpios);

K_THREAD_STACK_DEFINE(tx_stack, 512);
struct k_thread tx_thread_data;
k_tid_t tx_thread_tid;
CAN_MSGQ_DEFINE(rx_msgq, 55);
CAN_MSGQ_DEFINE(tx_msgq, 12);

K_MSGQ_DEFINE(button_msgq, sizeof(uint8_t), 10, 1);

static struct adc_readings power_readings;

const struct lcc_memory_segment memory_segments[] = {
	{
		.space = 253,
		.space_flags = 0,
		.low_address = 0,
		.high_address = sizeof(servo16_state.pwm_boards_config),
		.memory = &servo16_state.pwm_boards_config,
	},
	{
		// Voltage information
		.space = 248,
		.space_flags = LCC_MEMORY_FLAG_SPACE_READ_ONLY,
		.high_address = sizeof(power_readings),
		.memory = &power_readings,
	},
	{
		.space = 251,
		.space_flags = 0,
		.high_address = sizeof(struct Servo16PlusNameDescription),
		.memory = &servo16_state.name_desc,
	},
	{ .space = 0 },
};

static void blink_led_green();
K_THREAD_DEFINE(green_blink, 512, blink_led_green, NULL, NULL, NULL,
		7, 0, 0);

static void blink_led_green(){
	while(1){
		uint64_t diff = k_cycle_get_32() - servo16_state.last_rx_dcc_message;

		if(k_cyc_to_ms_ceil32(diff) < 500){
			// Receiving DCC signal, double blink
			gpio_pin_set_dt(&green_led, 1);
			k_sleep(K_MSEC(100));
			gpio_pin_set_dt(&green_led, 0);
			k_sleep(K_MSEC(100));
			gpio_pin_set_dt(&green_led, 1);
			k_sleep(K_MSEC(100));
			gpio_pin_set_dt(&green_led, 0);
			k_sleep(K_MSEC(1500));
		}else{
			// No DCC signal, single blink
			gpio_pin_set_dt(&green_led, 1);
			k_sleep(K_MSEC(100));
			gpio_pin_set_dt(&green_led, 0);
			k_sleep(K_MSEC(1500));
		}

		gpio_pin_toggle_dt(&blue_led);
		gpio_pin_toggle_dt(&gold_led);
	}
}

char *state_to_str(enum can_state state)
{
	switch (state) {
	case CAN_STATE_ERROR_ACTIVE:
		return "error-active";
	case CAN_STATE_ERROR_WARNING:
		return "error-warning";
	case CAN_STATE_ERROR_PASSIVE:
		return "error-passive";
	case CAN_STATE_BUS_OFF:
		return "bus-off";
	case CAN_STATE_STOPPED:
		return "stopped";
	default:
		return "unknown";
	}
}

static void can_frame_send_thread(void *unused1, void *unused2, void *unused3)
{
	static struct can_frame tx_frame;
	struct can_bus_err_cnt err_cnt = {0, 0};
	enum can_state state;

	while(1){
		if(k_msgq_get(&tx_msgq, &tx_frame, K_FOREVER) == 0){
			int err = can_get_state(can_dev, &state, &err_cnt);
			if(err != 0){
				printf("Can't get CAN state\n");
				continue;
			}

			if(state == CAN_STATE_BUS_OFF){
				printf("CAN bus off, dropping packet\n");
				continue;
			}

			int stat = can_send(can_dev, &tx_frame, K_FOREVER, NULL, NULL );
			if(stat < 0){
				printf("Unable to send: %d\n", stat);
			}
		}
	}
}

static int lcc_write_cb(struct lcc_context*, struct lcc_can_frame* lcc_frame){
	static struct can_frame zephyr_can_frame_tx;
	memset(&zephyr_can_frame_tx, 0, sizeof(zephyr_can_frame_tx));
	zephyr_can_frame_tx.id = lcc_frame->can_id;
	zephyr_can_frame_tx.dlc = lcc_frame->can_len;
	zephyr_can_frame_tx.flags = CAN_FRAME_IDE;
	memcpy(zephyr_can_frame_tx.data, lcc_frame->data, 8);

	if(k_msgq_put(&tx_msgq, &zephyr_can_frame_tx, K_NO_WAIT) < 0){
		return LCC_ERROR_TX;
	}

	return LCC_OK;
}

static void init_can_txrx(){
	const struct can_filter filter = {
			.flags = CAN_FILTER_IDE,
			.id = 0x0,
			.mask = 0
	};
	int filter_id;

	filter_id = can_add_rx_filter_msgq(can_dev, &rx_msgq, &filter);
	printf("Filter ID: %d\n", filter_id);

	tx_thread_tid = k_thread_create(&tx_thread_data,
				tx_stack,
				K_THREAD_STACK_SIZEOF(tx_stack),
				can_frame_send_thread, NULL, NULL, NULL,
				0, 0,
				K_NO_WAIT);
	if (!tx_thread_tid) {
		printf("ERROR spawning tx thread\n");
	}
}

static void update_power_readings(){
	// Get a new reading and convert it to big-endian LCC format
	powerhandle_current_volts_mv(&power_readings);
	power_readings.current = __builtin_bswap32(power_readings.current);
	power_readings.vin_mv = __builtin_bswap32(power_readings.vin_mv);
	power_readings.volts_mv = __builtin_bswap32(power_readings.volts_mv);
}

static void reboot(struct lcc_memory_context* ctx){
	configuration_flusher_force_write_if_dirty(&servo16_state.config_flusher);
	sys_reboot(SYS_REBOOT_COLD);
}

static void factory_reset(struct lcc_memory_context* ctx){
	struct Servo16PlusGlobals global;

	if(partition_util_load_eeprom(64, &global, sizeof(global)) < 0){
		printf("ERR: unable to load from EEPROM!  Will not do a factory reset\n");
		return;
	}

	if(global.base_lcc_event_address == 0 || global.base_lcc_event_address == 0xFFFFFFFFFFFFFFFFull){
		global.base_lcc_event_address = servo16_state.lcc_id << 16;
	}

	memset(&servo16_state.pwm_boards_config, 0, sizeof(servo16_state.pwm_boards_config));
	memset(&servo16_state.servo_config, 0, sizeof(servo16_state.servo_config));
	memset(&servo16_state.led_config, 0, sizeof(servo16_state.led_config));
	memset(&servo16_state.name_desc, 0, sizeof(servo16_state.name_desc));

	for(int x = 0; x < NUM_EXPANSION_BOARDS; x++){
		servo16_state.pwm_boards_config[x].address = 0x40 + x;
		servo16_state.pwm_boards_config[x].board_type = BOARD_TYPE_SERVO;

		for(int output = 0; output < 16; output++){
			for(int event = 0; event < 6; event++){
				servo16_state.servo_config[x][output].events[event].BE_event_id = __builtin_bswap64(global.base_lcc_event_address++);
				servo16_state.servo_config[x][output].events[event].BE_servo_position = __builtin_bswap16(1000);

				servo16_state.led_config[x][output].events[event].BE_event_id = __builtin_bswap64(global.base_lcc_event_address++);
			}
		}
	}

	if(partition_util_save_eeprom(servo16_state.eeprom_offsets.lcc_event_offset, &global, sizeof(global)) < 0){
		LOG_ERR("Unable to save EEPROM");
	}
	if(partition_util_save_eeprom(servo16_state.eeprom_offsets.segment_253_offset, &servo16_state.pwm_boards_config, sizeof(servo16_state.pwm_boards_config)) < 0){
		LOG_ERR("Unable to save EEPROM");
	}
	if(partition_util_save_eeprom(servo16_state.eeprom_offsets.segment_251_offset, &servo16_state.name_desc, sizeof(servo16_state.name_desc)) < 0){
		LOG_ERR("Unable to save EEPROM");
	}
	if(partition_util_save_eeprom(servo16_state.eeprom_offsets.segment_250_offset, &servo16_state.servo_config, sizeof(servo16_state.servo_config)) < 0){
		LOG_ERR("Unable to save EEPROM");
	}
	if(partition_util_save_eeprom(servo16_state.eeprom_offsets.segment_249_offset, &servo16_state.led_config, sizeof(servo16_state.led_config)) < 0){
		LOG_ERR("Unable to save EEPROM");
	}
}

static uint64_t load_lcc_id(){
	uint64_t ret = 0;
	int do_reboot = 0;

	const struct flash_area* lcc_storage_area = NULL;
	int id = FIXED_PARTITION_ID(lcc_partition);

	if(flash_area_open(id, &lcc_storage_area) < 0){
		return 1;
	}

	if(flash_area_read(lcc_storage_area, 0, &ret, sizeof(ret)) < 0){
		return 1;
	}

	// Check to see if the first 8 bytes are 0xFF.  If so, we assume the data is uninitialized
	const uint8_t mem[8] = {
			0xFF, 0xFF, 0xFF, 0xFF,
			0xFF, 0xFF, 0xFF, 0xFF
	};
	if(memcmp(&ret, mem, 8) == 0){
		uint64_t new_id = 0;
		int valid = 0;

		console_getline_init();

		// Do any birthing checks here to see if it's good or bad

		while(!valid){
			printf("LCC ID blank!  Please input lower 2 bytes of LCC ID as a single hex string followed by enter:\n");
			char id_buffer[32];
			char* console_data = console_getline();
			printf("console line: %s\n", console_data);
			new_id = strtoull(console_data, NULL, 16);
			new_id = new_id & 0xFFFF;
			new_id = new_id | (0x02020204ull << 16);
			lcc_node_id_to_dotted_format(new_id, id_buffer, sizeof(id_buffer));

			printf("New node ID will be %s.  Type 'y'<ENTER> to accept\n", id_buffer);
			console_data = console_getline();
			printf("response: %s\n", console_data);
			if(console_data[0] == 'y'){
				valid = 1;
				ret = new_id;
			}
		}

		flash_area_write(lcc_storage_area, 0, &ret, sizeof(ret));

		// Do a 'factory reset' to make sure everything is initialized
		factory_reset(NULL);
		do_reboot = 1;
	}

out:
	flash_area_close(lcc_storage_area);

	if(do_reboot){
		printf("Birthing complete, rebooting...\n");
		sys_reboot(SYS_REBOOT_COLD);
	}

	return ret;
}

static void parse_button(uint8_t* button){
	if(button[0] != (~button[1])){
		printf("bytes are not complements: ignore\n");
		return;
	}

	int button_up = button[0] & (0x01 << 7);
	int button_number = button[0] & 0x0F;

	printf("Button number %d is: %s\n", button_number, button_up ? "up" : "down");
}

static void main_loop(){
	enum btn_parse_state{
		BUTTON_BYTE0,
		BUTTON_BYTE1
	};

	struct k_poll_event poll_data[3];
	struct k_timer alias_timer;
	struct can_frame rx_frame;
	uint8_t button_bytes[2];
	enum btn_parse_state button_parse_state = BUTTON_BYTE0;
	struct k_timer button_clear_timer;
	struct k_timer query_power_timer;

	k_poll_event_init(&poll_data[0],
			K_POLL_TYPE_MSGQ_DATA_AVAILABLE,
			K_POLL_MODE_NOTIFY_ONLY,
			&rx_msgq);
	k_poll_event_init(&poll_data[1],
			K_POLL_TYPE_MSGQ_DATA_AVAILABLE,
			K_POLL_MODE_NOTIFY_ONLY,
			&servo16_state.dcc_decoder_stm32.readings);
	k_poll_event_init(&poll_data[2],
			K_POLL_TYPE_MSGQ_DATA_AVAILABLE,
			K_POLL_MODE_NOTIFY_ONLY,
			&button_msgq);

	k_timer_init(&alias_timer, NULL, NULL);
	k_timer_start(&alias_timer, K_MSEC(250), K_NO_WAIT);
	k_timer_init(&button_clear_timer, NULL, NULL);
	k_timer_init(&query_power_timer, NULL, NULL);
	k_timer_start(&query_power_timer, K_MSEC(250), K_MSEC(250));

	while (1) {
		int rc = k_poll(poll_data, ARRAY_SIZE(poll_data), K_MSEC(250));

		if(k_timer_status_get(&button_clear_timer) > 0){
			// Timer expired, clear out our parsing state for the button
			button_parse_state = BUTTON_BYTE0;
		}

		if(k_timer_status_get(&query_power_timer) > 0){
			update_power_readings();
		}

		if(poll_data[0].state == K_POLL_STATE_MSGQ_DATA_AVAILABLE){
			// Receive a CAN frame if there is any
			while(k_msgq_get(&rx_msgq, &rx_frame, K_NO_WAIT) == 0){
				memset(&lcc_rx, 0, sizeof(lcc_rx));
				lcc_rx.can_id = rx_frame.id;
				lcc_rx.can_len = rx_frame.dlc;
				memcpy(lcc_rx.data, rx_frame.data, 8);

				lcc_context_incoming_frame(lcc_ctx, &lcc_rx);
			}
			poll_data[0].state = K_POLL_STATE_NOT_READY;
		}else if(poll_data[1].state == K_POLL_STATE_MSGQ_DATA_AVAILABLE){
			uint32_t timediff;
			while(k_msgq_get(&servo16_state.dcc_decoder_stm32.readings, &timediff, K_NO_WAIT) == 0){
				if(dcc_decoder_polarity_changed(servo16_state.dcc_decoder_stm32.dcc_decoder, timediff) == 1){
					dcc_decoder_pump_packet(servo16_state.dcc_decoder_stm32.dcc_decoder);
				}
			}
			poll_data[1].state = K_POLL_STATE_NOT_READY;
		}else if(poll_data[2].state == K_POLL_STATE_MSGQ_DATA_AVAILABLE){
			uint8_t byte;
			while(k_msgq_get(&button_msgq, &byte, K_NO_WAIT) == 0){
				if(button_parse_state == BUTTON_BYTE0){
					button_bytes[0] = byte;
					button_parse_state = BUTTON_BYTE1;
				}else{
					button_bytes[1] = byte;
					parse_button(button_bytes);
					button_parse_state = BUTTON_BYTE0;
				}

				k_timer_start(&button_clear_timer, K_MSEC(500), K_NO_WAIT);
				poll_data[2].state = K_POLL_STATE_NOT_READY;
			}
		}

		if(k_timer_status_get(&alias_timer) > 0 &&
		    lcc_context_current_state(lcc_ctx) == LCC_STATE_INHIBITED){
		    int stat = lcc_context_claim_alias(lcc_ctx);
		    if(stat == LCC_ERROR_ALIAS_TX_NOT_EMPTY){
		    	k_timer_start(&alias_timer, K_MSEC(500), K_NO_WAIT);
		    	continue;
		    }
		    if(stat != LCC_OK){
		      // If we were unable to claim our alias, we need to generate a new one and start over
		      lcc_context_generate_alias(lcc_ctx);
		    }else{
		      printf("Claimed alias %X\n", lcc_context_alias(lcc_ctx) );
		    }
		}
	}
}

static int tx_queue_size_cb(struct lcc_context*){
	return k_msgq_num_free_get(&tx_msgq);
}

static void splash(){
	printf("lcc-servo-16plus\n");
	printf("  Version: " APP_VERSION_STRING);
	printf("  Rev: R" CONFIG_BOARD_REVISION "\n");

	struct mcuboot_img_header versions[2];
	struct mcuboot_img_sem_ver semver[2] = {0};

	if(boot_read_bank_header(FIXED_PARTITION_ID(slot0_partition), &versions[0], sizeof(struct mcuboot_img_header)) == 0){
	  semver[0] = versions[0].h.v1.sem_ver;
	}
	if(boot_read_bank_header(FIXED_PARTITION_ID(slot1_partition), &versions[1], sizeof(struct mcuboot_img_header)) == 0){
	  semver[1] = versions[1].h.v1.sem_ver;
	}

	printf("  This slot version: %d.%d.%d\n", semver[0].major, semver[0].minor, semver[0].revision);
	printf("  Secondary slot version: %d.%d.%d\n", semver[1].major, semver[1].minor, semver[1].revision);
}

static int test_servo(){
	const struct pwm_dt_spec pwm = PWM_DT_SPEC_GET_BY_IDX(DT_NODELABEL(builtin), 0);
	const struct pwm_dt_spec pwm2 = PWM_DT_SPEC_GET_BY_IDX(DT_NODELABEL(builtin), 2);
	const struct gpio_dt_spec oe_pin = GPIO_DT_SPEC_GET(DT_PATH(zephyr_user), oe_gpios);
//	const struct led_dt_spec pwm_led = LED_DT_SPEC_GET_BY_IDX(DT_NODELABEL(n2), 0);
	int DOWN = 0;
	int dir = 0;
	int UP = 1;
	int min_pulse = PWM_USEC(700);
	int max_pulse = PWM_USEC(2500);
	int STEP = PWM_USEC(100);
	int pulse_width = min_pulse;
	int ret;

	gpio_pin_configure_dt(&oe_pin, GPIO_OUTPUT_INACTIVE);

	gpio_pin_set_dt(&oe_pin, 1);

	if (!pwm_is_ready_dt(&pwm)) {
		printf("Error: PWM device %s is not ready\n", pwm.dev->name);
		return 0;
	}

	while (1) {
//		printf("setting pulse %d\n", pulse_width);
//		ret = pwm_set_pulse_dt(&pwm, pulse_width);
		if (ret < 0) {
			printf("Error %d: failed to set pulse width\n", ret);
			return 0;
		}

		if (dir == DOWN) {
			pwm_set_pulse_dt(&pwm, min_pulse);
			pwm_set_pulse_dt(&pwm2, min_pulse);
//			if (pulse_width <= min_pulse) {
//				dir = UP;
//				pulse_width = min_pulse;
//			} else {
//				pulse_width -= STEP;
//			}
		} else {
			pwm_set_pulse_dt(&pwm, max_pulse);
			pwm_set_pulse_dt(&pwm2, max_pulse);
//			pulse_width += STEP;
//
//			if (pulse_width >= max_pulse) {
//				dir = DOWN;
//				pulse_width = max_pulse;
//			}
		}
		dir = !dir;

		k_sleep(K_SECONDS(3));
	}

	return 1;
}

static void incoming_event(struct lcc_context* ctx, uint64_t event_id){
//	pca9685_board_handle_event(&servo16_state.boards[0], event_id);
	for(int idx = 0; idx < 4; idx++){
		struct Board* board = &servo16_state.boards[idx];
		int board_type = board->config->board_type;

		if(!board->ok){
			continue;
		}

		for(int out = 0; out < 16; out++){
//			output_state_perform_action(&board->output_state[out], board_type, event_id);
		}
	}
}

static void incoming_dcc(struct dcc_decoder* decoder, const uint8_t* packet_bytes, int len){
	servo16_state.last_rx_dcc_message = k_cycle_get_32();
}

static void accy_cb(struct dcc_packet_parser* parser, uint16_t accy_number, enum dcc_accessory_direction accy_dir){
	printf("Accy %d to dir %d\n", accy_number, accy_dir);
}

static void blue_button_pressed(const struct device *dev, struct gpio_callback *cb,
		    uint32_t pins)
{
	int blue_value = gpio_pin_get_dt(&servo16_state.blue_button);

	printf("blue %d\n", blue_value);
}

static void gold_button_pressed(const struct device *dev, struct gpio_callback *cb,
		    uint32_t pins)
{
	int gold_value = gpio_pin_get_dt(&servo16_state.gold_button);

	printf("gold %d\n", gold_value);
}

static void enable_powersupplies(){
	struct gpio_dt_spec oe_gpio = GPIO_DT_SPEC_GET(DT_PATH(zephyr_user), oe_gpios);
	struct gpio_dt_spec powersupply_gpio = GPIO_DT_SPEC_GET(DT_PATH(zephyr_user), powersupply_gpios);
	struct gpio_dt_spec i2c_enable_gpio = GPIO_DT_SPEC_GET(DT_PATH(zephyr_user), i2c_enable_gpios);

	gpio_pin_configure_dt(&oe_gpio, GPIO_OUTPUT_INACTIVE);
	gpio_pin_configure_dt(&powersupply_gpio, GPIO_OUTPUT_INACTIVE);
	gpio_pin_configure_dt(&i2c_enable_gpio, GPIO_OUTPUT_INACTIVE);

	gpio_pin_set_dt(&oe_gpio, 1);
	gpio_pin_set_dt(&powersupply_gpio, 1);
	gpio_pin_set_dt(&i2c_enable_gpio, 1);
}

static void uart_irq_handler(const struct device* dev, void* user_data){
	static uint8_t buffer[8];

	while(uart_irq_update(dev) && uart_irq_is_pending(dev)){
		if(uart_irq_rx_ready(dev)){
			int recv_len = uart_fifo_read(dev, buffer, sizeof(buffer));
			if(recv_len < 0){
				continue;
			}

			for(int x = 0; x < recv_len; x++){
				k_msgq_put(&button_msgq, &buffer[x], K_NO_WAIT);
			}
		}
	}
}

static void initialize_button_board(){
	const struct device* const button_uart = DEVICE_DT_GET(DT_NODELABEL(usart1));

	if (!device_is_ready(button_uart)) {
		printf("Button UART not ready\n");
		return;
	}

	uart_irq_callback_set(button_uart, uart_irq_handler);
	uart_irq_rx_enable(button_uart);
}

static void memory_space_written(struct lcc_memory_map* map, uint8_t space, uint32_t offset, uint32_t len){
	configuration_flusher_set_dirty(&servo16_state.config_flusher, space);

	if(space == 253){
		add_all_events_consumed(lcc_context_get_event_context(lcc_ctx));
	}else if(space == 251){
		lcc_context_set_simple_node_name_description(lcc_ctx,
				servo16_state.name_desc.node_name,
				servo16_state.name_desc.node_description);
	}
}

static void write_dirty_segment(int space){
	LOG_INF("Writing dirty segment %d", space);
	if(space == 253){
		partition_util_save(FIXED_PARTITION_ID(segment_253),
				&servo16_state.pwm_boards_config,
				sizeof(servo16_state.pwm_boards_config));
	}else if(space == 251){
		partition_util_save(FIXED_PARTITION_ID(segment_251),
				&servo16_state.name_desc,
				sizeof(servo16_state.name_desc));
	}
}

static void test_eeprom(){
	static char foo_data[64];
	const char* fake_data = "farts farts farts";

	const struct device* const dev = DEVICE_DT_GET(DT_ALIAS(eeprom_0));
	if(!dev){
		printf("can't find eeprom??\n");
		return;
	}

	// read memory
	eeprom_read(dev, 0, &foo_data, sizeof(foo_data));
	foo_data[63] = 0;
	printf("eeprom memory: %s\n", foo_data);

	// write out memory
	memset(foo_data, 0, sizeof(foo_data));
	strcpy(foo_data, fake_data);
	eeprom_write(dev, 0, foo_data, strlen(foo_data));


	// zero out our memory and then read it back
	memset(foo_data, 0, sizeof(foo_data));
	eeprom_read(dev, 0, &foo_data, sizeof(foo_data));

	printf("foo data: %s\n", foo_data);
}

int main(void)
{
	int ret;

	// Sleep for a bit before we start to allow power to become stable and
	// to make sure that our daughter boards come up
	// This is probably not needed, but it shouldn't hurt.
	// This will also give other devices on the network a chance to come up.
	k_sleep(K_MSEC(500));

	splash();
	uint64_t lcc_id = load_lcc_id();

	enable_powersupplies();

	if (!device_is_ready(can_dev)) {
		printf("CAN: Device %s not ready.\n", can_dev->name);
		return 0;
	}

	ret = can_start(can_dev);
	if(ret != 0){
		printf("Can't start CAN\n");
		return 0;
	}

	init_can_txrx();

	struct lcc_context* ctx = lcc_context_new();
	lcc_ctx = ctx;
	lcc_context_set_unique_identifer( ctx,
			lcc_id );
	lcc_context_set_simple_node_information(ctx,
			"Snowball Creek Electronics",
			"Servo16 Plus",
			"R" CONFIG_BOARD_REVISION,
			APP_VERSION_STRING);

	lcc_context_set_write_function( ctx, lcc_write_cb, tx_queue_size_cb );
	struct lcc_event_context* evt_ctx = lcc_event_new(ctx);

	lcc_event_set_incoming_event_function(evt_ctx, incoming_event);

	lcc_datagram_context_new(ctx);
	struct lcc_memory_context* mem_ctx = lcc_memory_new(ctx);
	lcc_memory_set_cdi(mem_ctx, cdi, sizeof(cdi), 0);
	lcc_memory_set_reboot_function(mem_ctx, reboot);
	lcc_memory_set_factory_reset_function(mem_ctx, factory_reset);
	struct lcc_memory_map* mem_map = lcc_memory_map_new(mem_ctx, memory_segments);
	lcc_memory_map_set_written_callback(mem_map, memory_space_written);

	firmware_upgrade_init(ctx);

	configuration_flusher_init(&servo16_state.config_flusher, memory_segments, ARRAY_SIZE(memory_segments));
	configuration_flusher_set_write_callback(&servo16_state.config_flusher, write_dirty_segment);

	int stat = lcc_context_generate_alias( ctx );
	if(stat < 0){
		printf("error: can't gen alias: %d\n", stat);
		return 0;
	}

	init_state(lcc_id);

	// Init our callbacks
	//gpio_init_callback(&gold_button_cb_data, gold_button_pressed, BIT(lcc_tortoise_state.gold_button.pin));
	//gpio_add_callback(lcc_tortoise_state.gold_button.port, &gold_button_cb_data);
	//gpio_init_callback(&blue_button_cb_data, blue_button_pressed, BIT(lcc_tortoise_state.blue_button.pin));
	//gpio_add_callback(lcc_tortoise_state.blue_button.port, &blue_button_cb_data);

	// Load all of our configs
	if(load_config_from_flash() == 2){
		// flash is empty, do a factory reset
		factory_reset(NULL);
	}
	if(load_global_config_from_flash() == 2){
		memset(&servo16_state.name_desc, 0, sizeof(servo16_state.name_desc));
	}

	// inintialize all of our daughterboards now that we have loaded the config
	// that includes their address
	init_all_daughterboards();

	// Initialize the starting state of all of the outputs
	init_start_state();

	// Now that we have initialized the outputs, enable the outputs on the PCA9685
	output_enable();

	lcc_context_set_simple_node_name_description(lcc_ctx,
			servo16_state.name_desc.node_name,
			servo16_state.name_desc.node_description);
	add_all_events_consumed(evt_ctx);

	dcc_decoder_init(&servo16_state.dcc_decoder_stm32);
	dcc_decoder_set_packet_callback(servo16_state.dcc_decoder_stm32.dcc_decoder, incoming_dcc);
	dcc_decoder_set_packet_parser(servo16_state.dcc_decoder_stm32.dcc_decoder, servo16_state.dcc_decoder_stm32.packet_parser);

	dcc_packet_parser_set_accessory_cb(servo16_state.dcc_decoder_stm32.packet_parser, accy_cb);

	powerhandle_init();

	// initialize the button board
	initialize_button_board();

	// Init button callbacks
	gpio_init_callback(&gold_button_cb_data, gold_button_pressed, BIT(servo16_state.gold_button.pin));
	gpio_add_callback(servo16_state.gold_button.port, &gold_button_cb_data);
	gpio_init_callback(&blue_button_cb_data, blue_button_pressed, BIT(servo16_state.blue_button.pin));
	gpio_add_callback(servo16_state.blue_button.port, &blue_button_cb_data);

	printf("board 0 type: %d\n", servo16_state.boards[0].config->board_type);

//	test_eeprom();

//	printf("servooutput: %d\n", sizeof(struct BoardOutput));
//	printf("servoevent: %d\n", sizeof(struct BoardEvent));
//	printf("minpulse offset: %d\n", offsetof(struct BoardOutput, BE_min_pulse));
//	printf("maxpulse offset: %d\n", offsetof(struct BoardOutput, BE_max_pulse));
//	printf("events offset: %d\n", offsetof(struct BoardOutput, events));
//	printf("events size: %d\n", sizeof(servo16_state.pwm_boards_config[0].outputs[0].events));
//	printf("outputs offset:%d\n", offsetof(struct BoardConfig, outputs));

	main_loop();
//	test_servo();

	return 0;
}
```

## src/cdi.h
```c
/*
 * cdi.h
 *
 *  Created on: Oct 23, 2025
 *      Author: robert
 */

#ifndef LCC_SERVO16_PLUS_SRC_CDI_H_
#define LCC_SERVO16_PLUS_SRC_CDI_H_

const char* cdi = "<?xml version='1.0'?> \
<cdi xmlns:xsi='http://www.w3.org/2001/XMLSchema-instance' xsi:noNamespaceSchemaLocation='http://openlcb.org/schema/cdi/1/1/cdi.xsd'> \
<identification> \
<manufacturer>Snowball Creek Electronics</manufacturer> \
<model>Servo 16 Plus</model> \
<hardwareVersion>0</hardwareVersion> \
<softwareVersion>0</softwareVersion> \
</identification> \
<acdi/> \
<segment space='251'> \
<name>Node ID</name> \
<group> \
<name>Your name and description for this node</name> \
<string size='63'> \
<name>Node Name</name> \
</string> \
<string size='64' offset='1'> \
<name>Node Description</name> \
</string> \
</group> \
</segment> \
<segment space='253'> \
<name>Outputs</name> \
<group replication='4'> \
<repname>PCA9685 Board </repname> \
<int size='1'> \
<name>Board address</name> \
</int> \
<int size='1'> \
<name>Board Type</name> \
<description>Select what this board is controlling(servos or LEDs).  Requires reboot to take effect</description> \
<map> \
<relation> \
<property>0</property> \
<value>Servo Control</value> \
</relation> \
<relation> \
<property>1</property> \
<value>LED Control</value> \
</relation> \
</map> \
</int> \
<!-- six bytes of buffer --> \
<group offset='6'/> \
<group replication='16'> \
<name>OUT</name> \
<repname>Output </repname> \
<string size='32'> \
<name>Output Name</name> \
<description>What this output is for(optional)</description> \
</string> \
<group> \
<name>Servo Settings</name> \
<int size='2'> \
<name>Servo min pulse time(us)</name> \
<description>The minimum servo pulse time.  By convention, this is 1ms(1000us).  Other servos may use a different value.</description> \
<min>700</min> \
<max>1500</max> \
</int> \
<int size='2'> \
<name>Servo max pulse time(us)</name> \
<description>The maximum servo pulse time.  By convention, this is 2ms(2000us).  Other servos may use a different value.</description> \
<min>1500</min> \
<max>2500</max> \
</int> \
<int size='1'> \
<name>Servo Speed</name> \
</int> \
</group> \
<int size='1'> \
<name>Default Setting</name> \
<description>Select which of the 6 event inputs will be the 'default' state of this output</description> \
<map> \
<relation> \
<property>0</property> \
<value>Event Input 1</value> \
</relation> \
<relation> \
<property>1</property> \
<value>Event Input 2</value> \
</relation> \
<relation> \
<property>2</property> \
<value>Event Input 3</value> \
</relation> \
<relation> \
<property>3</property> \
<value>Event Input 4</value> \
</relation> \
<relation> \
<property>4</property> \
<value>Event Input 5</value> \
</relation> \
<relation> \
<property>5</property> \
<value>Event Input 6</value> \
</relation> \
</map> \
</int> \
<!-- 10 reserved bytes --> \
<group offset='10'/> \
<group replication='6'> \
<name>Event Inputs(Consumers)</name> \
<repname>Input </repname> \
<eventid> \
<name>EventID</name> \
<description>Event ID that will be consumed to set output to the given value</description> \
</eventid> \
<int size='2'> \
<name>Argument 1</name> \
<description>When board is used as servo, sets percentage of movement that servo is set to.  When set to LED, first argument(see manual)</description> \
</int> \
<int size='2'> \
<name>Argument 2</name> \
<description>When board is used as servo this argument is ignored.  When set to LED, second argument(see manual)</description> \
</int> \
<int size='1'> \
<name>LED state</name> \
<description>Only relevant if board drives LEDs.  When this event is consumed, the LED will go to this given state</description> \
<map> \
<relation> \
<property>0</property> \
<value>Off</value> \
</relation> \
<relation> \
<property>1</property> \
<value>Steady on</value> \
</relation> \
<relation> \
<property>2</property> \
<value>Pulse Slow</value> \
</relation> \
<relation> \
<property>3</property> \
<value>Pulse Medium</value> \
</relation> \
<relation> \
<property>4</property> \
<value>Pulse Fast</value> \
</relation> \
<relation> \
<property>5</property> \
<value>Fade Up</value> \
</relation> \
<relation> \
<property>6</property> \
<value>Fade Down</value> \
</relation> \
</map> \
</int> \
<group offset='3'/> \
</group> \
</group> \
</group> \
</segment> \
<!-- \
	<segment space='250'> \
		<name>Global Config</name> \
	</segment> \
 \
	<segment space='249'> \
		<name>Firmware Versions</name> \
		<group> \
			<name>Primary version</name> \
			<int size='1'> \
				<name>Major</name> \
			</int> \
			<int size='1'> \
				<name>Minor</name> \
			</int> \
			<int size='2'> \
				<name>Revision</name> \
			</int> \
			<int size='4'> \
				<name>Build Number</name> \
			</int> \
		</group> \
		<group> \
			<name>Secondary version</name> \
			<int size='1'> \
				<name>Major</name> \
			</int> \
			<int size='1'> \
				<name>Minor</name> \
			</int> \
			<int size='2'> \
				<name>Revision</name> \
			</int> \
			<int size='4'> \
				<name>Build Number</name> \
			</int> \
		</group> \
	</segment> \
--> \
<segment space='248'> \
<name>Power information</name> \
<int size='4'> \
<name>Output Voltage(mv)</name> \
</int> \
<int size='4'> \
<name>Input Voltage(mv)</name> \
<description>Input voltage to the unit.  Depending on board configuration, comes from the LCC bus or the barrel connector</description> \
</int> \
<int size='4'> \
<name>Current (ma)</name> \
<description>How much current is being used by the unit</description> \
</int> \
</segment> \
</cdi>";

#endif /* LCC_SERVO16_PLUS_SRC_CDI_H_ */
```

## src/pca9685_board.c
```c
/*
 * pca9685_board.c
 *
 *  Created on: Oct 24, 2025
 *      Author: robert
 */
#include "pca9685_board.h"
#include "servo16-config.h"

static void pca9685_actuate_servo(struct OutputState* output_state, uint64_t event_id){
	struct BoardEvent* event = NULL;
	uint64_t BE_event_id = __builtin_bswap64(event_id);

	for(int x = 0; x < 6; x++){
		if(output_state->output_config->events[x].BE_event_id == BE_event_id){
			event = &output_state->output_config->events[x];
		}
	}

	int LE_min_pulse = __builtin_bswap16(output_state->output_config->BE_min_pulse);
	int LE_max_pulse = __builtin_bswap16(output_state->output_config->BE_max_pulse);
	int diff = LE_max_pulse - LE_min_pulse;
	int val_to_change_by = (float)diff * (float)event->arg1 / 1000.0;
	int new_val = LE_min_pulse + val_to_change_by;

	printf("Actuate output %s to percent %d val: %d\n", output_state->output_config->description, event->arg1, new_val);

	pwm_set_pulse_dt(&output_state->pwm_output, PWM_USEC(new_val));
}

static void pca9685_led(const struct pwm_dt_spec* spec, struct BoardOutput* output, struct BoardEvent* event){
	const uint32_t period = PWM_MSEC(1);
	uint32_t new_pulse = 0;

	switch(event->led_function){
	case LED_FUNC_OFF:
		new_pulse = 0;
		break;
	case LED_FUNC_STEADY_ON:
		new_pulse = PWM_MSEC(1) * (float)event->arg1 / 1000.0;
		break;
	}

	printf("Set LED %s to function %d(%d%%)\n", output->description, event->led_function, event->arg1);
	pwm_set_dt(spec, period, new_pulse);
}

int pca9685_board_handle_event(struct Board* board, uint64_t event_id){
	uint64_t BE_event_id = __builtin_bswap64(event_id);
	int handled = 0;

//	for(int output = 0; output < 16; output++){
//		for(int event_idx = 0; event_idx < 6; event_idx++){
//			if(board->config->board_type == BOARD_TYPE_SERVO &&
//					board->config->outputs[output].events[event_idx].BE_event_id == BE_event_id){
//				// okay, we can make this guy do things
//				handled = 1;
////				pca9685_actuate_servo(&board->pwm_outputs[output], &board->config->outputs[output], &board->config->outputs[output].events[event_idx]);
//				pca9685_actuate_servo(&board->output_state[output], event_id);
//			}else if(board->config->board_type == BOARD_TYPE_LED &&
//					board->config->outputs[output].events[event_idx].BE_event_id == BE_event_id){
//				handled = 1;
////				pca9685_led(&board->pwm_outputs[output], &board->config->outputs[output], &board->config->outputs[output].events[event_idx]);
//			}
//		}
//	}

	return handled;
}
```

## src/pca9685_board.h
```c
/*
 * pca9685_board.h
 *
 *  Created on: Oct 24, 2025
 *      Author: robert
 */

#ifndef LCC_SERVO16_PLUS_SRC_PCA9685_BOARD_H_
#define LCC_SERVO16_PLUS_SRC_PCA9685_BOARD_H_

#include <stdint.h>

struct Board;

/**
 * For this board, handle the event and see if it should do anything.
 *
 * Returns 1 if the event was handled, 0 if not
 */
int pca9685_board_handle_event(struct Board* board, uint64_t event_id);

#endif /* LCC_SERVO16_PLUS_SRC_PCA9685_BOARD_H_ */
```

## src/power-handler.c
```c
/*
 * power-handler.c
 *
 *  Created on: Aug 11, 2024
 *      Author: robert
 */
#include <zephyr/kernel.h>
#include <zephyr/drivers/gpio.h>
#include <zephyr/storage/flash_map.h>
#include <zephyr/drivers/adc.h>
#include <gpio/gpio_mcp23xxx.h>
#include <stm32g0xx_ll_adc.h>
#include <stm32g0xx_ll_gpio.h>

#include "dcc-decode-stm32.h"
#include "power-handler.h"
#include "adc_utils.h"
#include "servo16-config.h"

#define DT_SPEC_AND_COMMA(node_id, prop, idx) \
	ADC_DT_SPEC_GET_BY_IDX(node_id, idx),

static const struct adc_dt_spec adc_channels[] = {
	DT_FOREACH_PROP_ELEM(DT_PATH(zephyr_user), io_channels,
			     DT_SPEC_AND_COMMA)
};

static int powerhandle_vrefint;

static void adc_irq_fn(void* arg)
{
	if(LL_ADC_IsActiveFlag_AWD1(ADC1)){
		LL_ADC_ClearFlag_AWD1(ADC1);

		dcc_decoder_disable();

		configuration_flusher_force_write_if_dirty(&servo16_state.config_flusher);
	}
}

void powerhandle_check_if_save_required(){

}

static uint32_t adc_value(int channel){
	LL_ADC_REG_SetSequencerChannels(ADC1, channel);
	LL_ADC_ClearFlag_EOC(ADC1);
	LL_ADC_REG_StartConversion(ADC1);

	while(!LL_ADC_IsActiveFlag_EOC(ADC1)){}
	uint32_t reading = LL_ADC_REG_ReadConversionData12(ADC1);
	printf("0x%X - 0x%08X\n", channel, reading);
	while(!LL_ADC_IsActiveFlag_EOS(ADC1)){}

	return reading;
}

void powerhandle_current_volts_mv(struct adc_readings* readings){
	int err;
	uint32_t count = 0;
	uint16_t buf;
	struct adc_sequence sequence = {
		.buffer = &buf,
		/* buffer size in bytes, not number of samples */
		.buffer_size = sizeof(buf),
	};

	/* Configure channels individually prior to sampling. */
	for (size_t i = 0U; i < ARRAY_SIZE(adc_channels); i++) {
		if (!adc_is_ready_dt(&adc_channels[i])) {
			printk("ADC controller device %s not ready\n", adc_channels[i].dev->name);
			return 0;
		}
	}

	for (size_t i = 0U; i < ARRAY_SIZE(adc_channels); i++) {
		int32_t val_mv;

		(void)adc_sequence_init_dt(&adc_channels[i], &sequence);

		err = adc_read_dt(&adc_channels[i], &sequence);
		if (err < 0) {
			printk("Could not read (%d)\n", err);
			continue;
		}

		/*
		 * If using differential mode, the 16 bit value
		 * in the ADC sample buffer should be a signed 2's
		 * complement value.
		 */
		if (adc_channels[i].channel_cfg.differential) {
			val_mv = (int32_t)((int16_t)buf);
		} else {
			val_mv = (int32_t)buf;
		}
		err = adc_raw_to_millivolts_dt(&adc_channels[i],
						   &val_mv);

		if(i == 0){
			readings->volts_mv = adc_util_voltage_divider_input_voltage(10000, 2700, val_mv);
		}else if(i == 1){
			readings->vin_mv = adc_util_voltage_divider_input_voltage(56000, 7500, val_mv);
		}else if(i == 2){
			readings->current = (int)((float)val_mv / 1.65);
		}
	}
}

void powerhandle_init(){}
```

## src/power-handler.h
```c
/*
 * power-handler.h
 *
 *  Created on: Aug 11, 2024
 *      Author: robert
 */

#ifndef LCC_TORTOISE_SRC_POWER_HANDLER_H_
#define LCC_TORTOISE_SRC_POWER_HANDLER_H_

struct adc_readings{
	int volts_mv;
	int vin_mv;
	int current;
};

void powerhandle_init();

/**
 * When settings change, call this function to configure the power handling.
 * This is needed so that we don't write to the flash if we don't need to.
 */
void powerhandle_check_if_save_required();

void powerhandle_current_volts_mv(struct adc_readings*);

#endif /* LCC_TORTOISE_SRC_POWER_HANDLER_H_ */
```

## src/servo16-config.h
```c
/*
 * servo16-config.h
 *
 *  Created on: Oct 18, 2025
 *      Author: robert
 */

#ifndef LCC_SERVO16_PLUS_SRC_SERVO16_CONFIG_H_
#define LCC_SERVO16_PLUS_SRC_SERVO16_CONFIG_H_

#include <stdint.h>
#include <zephyr/drivers/gpio.h>
#include <zephyr/drivers/pwm.h>
#include <zephyr/kernel.h>
#include "dcc-decode-stm32.h"
#include "dcc-decoder.h"

#include "servo16-output-state.h"
#include "configuration_flusher.h"

struct lcc_event_context;

enum LEDFunctions{
	LED_FUNC_OFF,
	LED_FUNC_STEADY_ON,
	LED_FUNC_PULSE_SLOW, // 1hz
	LED_FUNC_PULSE_MED, // 2hz
	LED_FUNC_PULSE_FAST, // 4hz
	LED_FUNC_FADE_UP,
	LED_FUNC_FADE_DOWN,
};

enum BoardType{
	BOARD_TYPE_SERVO,
	BOARD_TYPE_LED,
	BOARD_TYPE_SIGNAL_LED,
};

/**
 * Board Event information
 *
 * Read from EPROM.
 */
struct BoardEvent{
	uint64_t BE_event_id;
	uint16_t arg1;
	uint16_t arg2;
	uint8_t led_function;
	uint8_t reserved[3];
};
_Static_assert(sizeof(struct BoardEvent) == 16, "bad size for BoardEvent");

/**
 * Board Output configuration
 *
 * Read from EPROM
 */
struct BoardOutput{
	char description[32];

	// Servo specific settings
	uint16_t BE_min_pulse;
	uint16_t BE_max_pulse;
	uint8_t servo_speed;

	uint8_t default_startup_event;

	uint8_t reserved[26];
	struct BoardEvent events[6];
};
_Static_assert(sizeof(struct BoardOutput) == 160, "bad size for BoardOutput");

/**
 * Board configuration - space 253
 */
struct BoardConfig{
	uint8_t address;
	uint8_t board_type;
	uint8_t reserved[30];
};
_Static_assert(sizeof(struct BoardConfig) == 32, "bad size for BoardConfig");

struct ServoEvent{
	uint64_t BE_event_id;
	uint16_t BE_servo_position;
	char reserved[14];
};
_Static_assert(sizeof(struct ServoEvent) == 24, "bad size for ServoEvent");

/**
 * Servo configuration - one for each output
 */
struct ServoConfig{
	char servo_name[32];
	uint8_t servo_speed;
	uint8_t default_output;
	char reserved[30];
	struct ServoEvent events[6];
};
_Static_assert(sizeof(struct ServoConfig) == 208, "bad size for ServoConfig");

struct LEDEvent{
	uint64_t BE_event_id;
	uint16_t BE_argument1;
	uint16_t BE_argument2;
	uint8_t led_state;
	char reserved[11];
};
_Static_assert(sizeof(struct LEDEvent) == 24, "bad size for LEDEvent");

/**
 * LED configuration - one for each output
 */
struct LEDConfiguration{
	char servo_name[32];
	uint8_t default_output;
	char reserved[31];
	struct LEDEvent events[6];
};
_Static_assert(sizeof(struct LEDConfiguration) == 208, "bad size for LEDConfiguration");

struct Board{
	// Configuration that comes from EEPROM for this board
	struct BoardConfig* config;

	union {
		// If the board is set to do servos, the configuration
		struct ServoConfig* servo_config;
		// If the board is set to do LEDs, the configuration
		struct LEDConfiguration* led_config;
	};

	// Runtime state information
//	struct OutputState output_state[16];

	uint8_t ok;
};

struct Servo16PlusNameDescription {
	char node_name[64];
	char node_description[64];
};

#define NUM_EXPANSION_BOARDS 4

struct Servo16PlusState{
	uint64_t lcc_id;

	// Segment 253
	struct BoardConfig pwm_boards_config[NUM_EXPANSION_BOARDS];
	// Segment 250
	struct ServoConfig servo_config[NUM_EXPANSION_BOARDS][16];
	// Segment 249
	struct LEDConfiguration led_config[NUM_EXPANSION_BOARDS][16];

	struct Board boards[4];
	const struct gpio_dt_spec oe_pin;
	const struct gpio_dt_spec green_led;
	const struct gpio_dt_spec blue_led;
	const struct gpio_dt_spec gold_led;
	const struct gpio_dt_spec blue_button;
	const struct gpio_dt_spec gold_button;

	// Segment 251
	struct Servo16PlusNameDescription name_desc;

	struct configuration_flusher config_flusher;

	// DCC Decoding variables
	struct dcc_decoder_stm32 dcc_decoder_stm32;
	uint32_t last_rx_dcc_message;

	struct {
		uint32_t lcc_offset;
		uint32_t lcc_event_offset;
		uint32_t segment_253_offset;
		uint32_t segment_251_offset;
		uint32_t segment_250_offset;
		uint32_t segment_249_offset;
	} eeprom_offsets;
};

extern struct Servo16PlusState servo16_state;

struct Servo16PlusGlobals {
	uint64_t base_lcc_event_address;
};

int init_state(uint64_t board_id);
void init_all_daughterboards();
void init_start_state();

void output_enable(void);

int save_config_to_flash();
int load_config_from_flash();
int save_globals_to_flash();
int load_global_config_from_flash();
void add_all_events_consumed(struct lcc_event_context* ctx);

#endif /* LCC_SERVO16_PLUS_SRC_SERVO16_CONFIG_H_ */
```

## src/servo16-output-state.c
```c
/*
 * servo16-output-state.c
 *
 *  Created on: Nov 20, 2025
 *      Author: robert
 */

#include "servo16-output-state.h"
#include "servo16-config.h"

static void output_state_led(struct OutputState* output_state, struct BoardEvent* event){
	int LE_arg1 = __builtin_bswap16(event->arg1);
	int LE_arg2 = __builtin_bswap16(event->arg2);
	int arg1_percent = PWM_MSEC(1) * (float)LE_arg1 / 1000.0;
	int arg2_percent = PWM_MSEC(1) * (float)LE_arg2 / 1000.0;

	output_state->moving = 2;
	output_state->current_led_func = event->led_function;
	output_state->led_arg1 = arg1_percent;
	output_state->led_arg2 = arg2_percent;

	switch(event->led_function){
	case LED_FUNC_OFF:
		output_state->led_process_func = led_process_off;
		break;
	case LED_FUNC_STEADY_ON:
		output_state->led_process_func = led_process_on;
		break;
	case LED_FUNC_PULSE_SLOW:
		output_state->led_process_func = led_process_pulse_slow;
		break;
	case LED_FUNC_PULSE_MED:
		output_state->led_process_func = led_process_pulse_medium;
		break;
	case LED_FUNC_PULSE_FAST:
		output_state->led_process_func = led_process_pulse_fast;
		break;
	case LED_FUNC_FADE_UP:
		output_state->led_process_func = led_process_fade_up;
		break;
	case LED_FUNC_FADE_DOWN:
		output_state->led_process_func = led_process_fade_down;
		break;
	}

	printf("Set LED %s to function %d(%d%%)\n", output_state->output_config->description, event->led_function, LE_arg1 / 1000);

	k_timer_stop(&output_state->output_change_timer);
	k_timer_start(&output_state->output_change_timer, K_NO_WAIT, K_MSEC(60));
}

static int output_state_calculate_servo_step_size(int speed, int min_pulse, int max_pulse){
	// For the servos, we want to have several different steps:
	// slowest = full rotation in ??? TODO: need to figure out what a reasonable speed is
	// fastest = no periodic PWM change, just move directly to the given value
	// The output to the PWM is updated every 60ms
	const int diff = max_pulse - min_pulse;
	const int base_speed = 5;

	switch(speed){
	case 1:
		return base_speed;
	case 2:
		return base_speed * 5;
	case 3:
		return base_speed * 8;
	case 4:
		return base_speed * 16;
	case 5:
		return base_speed * 25;
	default:
		return diff;
	}
}

static void output_state_actuate_servo(struct OutputState* output_state, struct BoardEvent* event){
	int LE_min_pulse = __builtin_bswap16(output_state->output_config->BE_min_pulse);
	int LE_max_pulse = __builtin_bswap16(output_state->output_config->BE_max_pulse);
	int diff = LE_max_pulse - LE_min_pulse;
	int val_to_change_by = (float)diff * (float)event->arg1 / 1000.0;
	int new_val = LE_min_pulse + val_to_change_by;

	k_timer_stop(&output_state->output_change_timer);
	printf("Actuate output %s to percent %d val: %d\n", output_state->output_config->description, event->arg1, new_val);

	output_state->moving = 1;
	output_state->target_position = new_val;
	output_state->step_size = output_state_calculate_servo_step_size(output_state->output_config->servo_speed, LE_min_pulse, LE_max_pulse);
	if(output_state->target_position < output_state->current_position){
		output_state->step_size *= -1;
	}
	k_timer_start(&output_state->output_change_timer, K_NO_WAIT, K_MSEC(60));
}

static void output_state_timer_fired(struct k_timer* timer){
	struct OutputState* state =
			CONTAINER_OF(timer, struct OutputState, output_change_timer);

	k_work_submit(&state->output_change_work);
}

static void output_state_work_func(struct k_work* work){
	struct OutputState* state =
			CONTAINER_OF(work, struct OutputState, output_change_work);

	if(state->moving == 1 /* servo */){
		int LE_min_pulse = __builtin_bswap16(state->output_config->BE_min_pulse);
		int LE_max_pulse = __builtin_bswap16(state->output_config->BE_max_pulse);

		state->current_position += state->step_size;
		if(state->step_size > 0 &&
				state->current_position >= LE_max_pulse){
			k_timer_stop(&state->output_change_timer);
			state->current_position = LE_max_pulse;
			state->moving = 0;
		}else if(state->step_size < 0 &&
				state->current_position <= LE_min_pulse){
			k_timer_stop(&state->output_change_timer);
			state->current_position = LE_min_pulse;
			state->moving = 0;
		}

		pwm_set_pulse_dt(&state->pwm_output, PWM_USEC(state->current_position));
	}else if(state->moving == 2 /* LED */){
		int keep_calling = state->led_process_func(state);
		if(!keep_calling){
			k_timer_stop(&state->output_change_timer);
			state->moving = 0;
		}
		pwm_set_dt(&state->pwm_output, PWM_MSEC(1), state->current_position);
	}
}

void output_state_init(struct OutputState* state, struct BoardOutput* output){
	state->output_config = output;
	state->moving = 0;
	state->step_size = 0;

	k_timer_init(&state->output_change_timer, output_state_timer_fired, NULL);
	k_work_init(&state->output_change_work, output_state_work_func);
}

int output_state_perform_action(struct OutputState* state, uint8_t board_type, uint64_t event_id){
	uint64_t BE_event_id = __builtin_bswap64(event_id);
	int handled = 0;

	for(int event_idx = 0; event_idx < 6; event_idx++){
		struct BoardEvent* board_event = &state->output_config->events[event_idx];
		if(board_type == BOARD_TYPE_SERVO &&
				board_event->BE_event_id == BE_event_id){
			// okay, we can make this guy do things
			handled = 1;
//				pca9685_actuate_servo(&board->pwm_outputs[output], &board->config->outputs[output], &board->config->outputs[output].events[event_idx]);
			output_state_actuate_servo(state, board_event);
		}else if(board_type == BOARD_TYPE_LED &&
				board_event->BE_event_id == BE_event_id){
			handled = 1;
			output_state_led(state, board_event);
//				pca9685_led(&board->pwm_outputs[output], &board->config->outputs[output], &board->config->outputs[output].events[event_idx]);
		}
	}

	return handled;
}
```

## src/servo16-output-state.h
```c
/*
 * servo16-output-state.h
 *
 *  Created on: Nov 20, 2025
 *      Author: robert
 */

#ifndef LCC_SERVO16_PLUS_SRC_SERVO16_OUTPUT_STATE_H_
#define LCC_SERVO16_PLUS_SRC_SERVO16_OUTPUT_STATE_H_

#include <zephyr/drivers/pwm.h>
#include <zephyr/kernel.h>

#include "led-funcs/led-funcs.h"

struct BoardOutput;

struct OutputState{
	struct pwm_dt_spec pwm_output;
	struct k_timer output_change_timer;
	struct k_work output_change_work;
	struct BoardOutput* output_config;
	int current_position;
	int target_position;
	int step_size;
	int moving;

	// LED settings
	led_process_function led_process_func;
	int current_led_func;
	int led_arg1;
	int led_arg2;
};

void output_state_init(struct OutputState* state, struct BoardOutput* output);

/**
 * Perform the action as specified by the given Event ID.
 * If the event ID is not consumed by this output, nothing happens.
 */
int output_state_perform_action(struct OutputState* state, uint8_t board_type, uint64_t event_id);

/**
 * For the given output state, perform whatever action is the 'startup'/'initial' action
 */
int output_state_perform_initial(struct OutputState* state, uint8_t board_type, uint8_t initial_output);

#endif /* LCC_SERVO16_PLUS_SRC_SERVO16_OUTPUT_STATE_H_ */
```
