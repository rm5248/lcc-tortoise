## CMakeLists.txt
```
# SPDX-License-Identifier: Apache-2.0

cmake_minimum_required(VERSION 3.20.0)
find_package(Zephyr REQUIRED HINTS $ENV{ZEPHYR_BASE})
project(LCC-Link)

# Bring in the LCC library
#set(LIBLCC_ENABLE_STATIC_CONTEXT ON)
#add_subdirectory(TrainUtils/LCC)

# Zephyr does not want to play with third party libraries nicely:
# https://github.com/zephyrproject-rtos/zephyr/issues/8439
# So we do the highly annoying thing here of re-creating part of the liblcc cmake file
# in order to bring in all of the sources that we need
set(TRAINUTILS_DIR "${CMAKE_CURRENT_SOURCE_DIR}/../TrainUtils")
include(${TRAINUTILS_DIR}/LCC/lcc-version)

file(GLOB lcc-sources
    ${TRAINUTILS_DIR}/LCC/*.c
    ${TRAINUTILS_DIR}/LCC/*.h
    ${TRAINUTILS_DIR}/DCC/*.h
    ${TRAINUTILS_DIR}/DCC/*.c
)

target_sources(app PRIVATE 
	src/main.c 
	src/computer_to_can.c
	src/can_to_computer.c
	src/dcc_to_computer.c
	src/cdi.h
	${lcc-sources}
	../common/partition_utils.c
	../common/firmware_upgrade.c
	../common/dcc-decode-stm32.c
)
target_include_directories(app PRIVATE
	${TRAINUTILS_DIR}/LCC
	${CMAKE_CURRENT_BINARY_DIR}/TrainUtils/LCC
	${TRAINUTILS_DIR}/DCC
	../common
)


string(REPLACE "." ";" VERSION_LIST ${LIBLCC_VERSION})
list(GET VERSION_LIST 0 LCC_VERSION_MAJOR)
list(GET VERSION_LIST 1 LCC_VERSION_MINOR)
list(GET VERSION_LIST 2 LCC_VERSION_PATCH)
target_compile_definitions(app PRIVATE
    LIBLCC_BUILD
)
set(LIBLCC_DEBUG 0)
set(LIBLCC_ENABLE_STATIC_CONTEXT 1)
set(LIBLCC_EVENT_LIST_STATIC_SIZE 20)
set(PROJECT_VERSION_MAJOR ${LCC_VERSION_MAJOR})
set(PROJECT_VERSION_MINOR ${LCC_VERSION_MINOR})
set(PROJECT_VERSION_PATCH ${LCC_VERSION_PATCH})
configure_file( ${TRAINUTILS_DIR}/LCC/lcc-config.h.cmake TrainUtils/LCC/lcc-config.h )
```

## Kconfig
```
mainmenu "LCC Link"

source "Kconfig.zephyr"
config LCC_LINK
	default y
	bool
	select USE_STM32_LL_USB
	select USE_STM32_HAL_PCD
	select USE_STM32_HAL_PCD_EX
```

## sysbuild.conf
```
# Sysbuild configuration file.

# Enable MCUboot per default for this sample.
SB_CONFIG_BOOTLOADER_MCUBOOT=y
#SB_CONFIG_BOOT_SIGNATURE_TYPE_NONE=y
SB_CONFIG_BOOT_SIGNATURE_KEY_FILE="${APP_DIR}/lcc-link.pem"
```

## prj.conf
```kconfig
CONFIG_SERIAL=y
CONFIG_SYS_CLOCK_HW_CYCLES_PER_SEC=32000000
CONFIG_FLASH_SIZE=512
CONFIG_FLASH_BASE_ADDRESS=0x8000000
CONFIG_SYS_CLOCK_TICKS_PER_SEC=100000
CONFIG_GPIO=y
CONFIG_CONSOLE=y
CONFIG_ARM_MPU=y
CONFIG_SRAM_SIZE=144
CONFIG_SRAM_BASE_ADDRESS=0x20000000
CONFIG_POLL=y
CONFIG_FLASH=y
CONFIG_CAN=y
CONFIG_UART_CONSOLE=y
CONFIG_UART_LINE_CTRL=y
CONFIG_NET_BUF=y
CONFIG_FLASH_MAP=y
CONFIG_USB_DEVICE_STACK_NEXT=y
CONFIG_USBD_CDC_ACM_CLASS=y
CONFIG_CDC_ACM_SERIAL_INITIALIZE_AT_BOOT=n
CONFIG_ROM_END_OFFSET=0x1800
CONFIG_BOOTLOADER_MCUBOOT=y
CONFIG_IMG_MANAGER=y
CONFIG_STREAM_FLASH=y
CONFIG_KERNEL_BIN_NAME="lcc-link"
CONFIG_REBOOT=y
CONFIG_MCUBOOT_SIGNATURE_KEY_FILE="/home/robert/lcc-workspace/lcc-tortoise/lcc-link/lcc-link.pem"
CONFIG_CONSOLE=y
CONFIG_CONSOLE_SUBSYS=y
CONFIG_CONSOLE_GETLINE=y
```

## src/main.c
```c
/*
 * SPDX-License-Identifier: GPL-2.0
 */

#include <stdio.h>
#include <zephyr/kernel.h>
#include <zephyr/drivers/gpio.h>
#include <zephyr/drivers/can.h>
#include <zephyr/kernel.h>
#include <zephyr/sys/ring_buffer.h>
#include <zephyr/usb/usbd.h>
#include <zephyr/drivers/uart.h>
#include <zephyr/dfu/mcuboot.h>
#include <zephyr/storage/flash_map.h>
#include <zephyr/sys/reboot.h>
#include <zephyr/console/console.h>

#include "lcc-gridconnect.h"
#include "computer_to_can.h"
#include "can_to_computer.h"
#include "dcc-decode-stm32.h"
#include "dcc_to_computer.h"
#include "firmware_upgrade.h"

#include "lcc.h"
#include "lcc-common.h"
#include "lcc-memory.h"
#include "lcc-datagram.h"
#include "lcc-memory-map.h"
#include "cdi.h"

#include "partition_utils.h"
#include "dcc-decoder.h"
#include "dcc-packet-parser.h"
#include "lcc-link-config.h"

#include "app_version.h"

USBD_DEVICE_DEFINE(lcc_link_usbd,
		   DEVICE_DT_GET(DT_NODELABEL(zephyr_udc0)),
		   0x0483, 0x5740);

USBD_DESC_LANG_DEFINE(lcc_link_lang);
USBD_DESC_MANUFACTURER_DEFINE(lcc_link_mfr, "Snowball Creek Electronics");
USBD_DESC_PRODUCT_DEFINE(lcc_link_product, "LCC Link");

USBD_DESC_CONFIG_DEFINE(lcc_link_fs_cfg_desc, "FS Configuration");
USBD_CONFIGURATION_DEFINE(lcc_link_fs_config, 0, 100, &lcc_link_fs_cfg_desc);

struct tx_remain_buffer{
	uint8_t buffer[64];
	int len;
};

const struct device *const can_dev = DEVICE_DT_GET(DT_CHOSEN(zephyr_canbus));
const struct device *const can_usb_dev = DEVICE_DT_GET(DT_NODELABEL(cdc_acm_can));
const struct device *const dcc_usb_dev = DEVICE_DT_GET(DT_NODELABEL(cdc_acm_dcc));
const struct device *const console_dev = DEVICE_DT_GET(DT_CHOSEN(zephyr_console));

static struct computer_to_can computer_to_can;
static struct can_to_computer can_to_computer;
static struct dcc_to_computer dcc_to_computer;
static uint32_t last_rx_dcc_msg;
static uint32_t last_rx_can_msg = 0;
static uint32_t last_tx_can_msg = 0;
struct lcc_context* lcc_ctx = NULL;
struct dcc_decoder_stm32 dcc_decode_ctx;
struct lcc_link_config lcc_link_data;
struct tx_remain_buffer tx_remain;

static void blink_status_led();
static void blink_activity_led();
K_THREAD_DEFINE(status_blink, 512, blink_status_led, NULL, NULL, NULL,
		7, 0, 0);
K_THREAD_DEFINE(activity_blink, 512, blink_activity_led, NULL, NULL, NULL,
		7, 0, 0);

//struct lcc_memory_segment{
//    uint8_t space;
//    uint8_t space_flags;
//    uint32_t low_address;
//    uint32_t high_address;
//    void* memory;
//};
const struct lcc_memory_segment memory_segments[] = {
		{
				.space = 251,
				.space_flags = 0,
				.low_address = 0,
				.high_address = sizeof(struct node_info_segment),
				.memory = &lcc_link_data.node_info,
		},
		{
				.space = 253,
				.space_flags = 0,
				.low_address = 0,
				.high_address = 1, //sizeof(struct dcc_decoding_info), // <-- min size to write needs to be 8, but we only have 1 byte
				.memory = &lcc_link_data.dcc_decoding_info,
		},
		{
				.space = 0,
				.space_flags = 0,
				.low_address = 0,
				.high_address = 0,
				.memory = NULL,
		}
};
static void memory_space_written(struct lcc_memory_map* map, uint8_t space);

// VID:PID
// 0483:5740
// This VID/PID combination is what is used by ST for their 'Virtual COM port'
// it is also used by RR-cirkits

static void irq_handler_can_usb(const struct device *dev, void *user_data){
	static uint8_t buffer[64];
	struct tx_remain_buffer* remain_buffer = user_data;

	while (uart_irq_update(dev) && uart_irq_is_pending(dev)) {
		if (uart_irq_rx_ready(dev)) {
				int recv_len, rb_len;

				recv_len = uart_fifo_read(dev, buffer, sizeof(buffer));
				if (recv_len < 0) {
//						LOG_ERR("Failed to read UART FIFO");
					recv_len = 0;
				}

				rb_len = computer_to_can_append_data(&computer_to_can, buffer, recv_len);
				if (rb_len < recv_len) {
					printf("Drop %u rx bytes.  recv len %d rb len %d\n", recv_len - rb_len, recv_len, rb_len);
				}
		}

		if (uart_irq_tx_ready(dev)) {
			int rb_len, send_len;

			if(remain_buffer->len){
				rb_len = remain_buffer->len;
				memcpy(buffer, remain_buffer->buffer, rb_len);
			}else{
				rb_len = ring_buf_get(&can_to_computer.ringbuf_outgoing, buffer, sizeof(buffer));
				if (!rb_len) {
	//				printf("Ring buffer empty, disable TX IRQ");
					uart_irq_tx_disable(dev);
					continue;
				}
			}

			send_len = uart_fifo_fill(dev, buffer, rb_len);
			if (send_len < rb_len) {
				int bytes_remain = rb_len - send_len;
				memcpy(remain_buffer->buffer, buffer + sizeof(buffer) - bytes_remain, bytes_remain);
				remain_buffer->len = bytes_remain;
			}else{
				// data was able to be transmitted
				memset(remain_buffer, 0, sizeof(struct tx_remain_buffer));
			}
		}
	}
}

static void irq_handler_dcc_usb(const struct device *dev, void *user_data){
	static uint8_t buffer[64];

	while (uart_irq_update(dev) && uart_irq_is_pending(dev)) {
			if (uart_irq_rx_ready(dev)) {
					int recv_len, rb_len;

					recv_len = uart_fifo_read(dev, buffer, sizeof(buffer));
					if (recv_len < 0) {
	//						LOG_ERR("Failed to read UART FIFO");
						recv_len = 0;
					};
					// Drop it on the floor, since we can't do anything with DCC data(yet).
					// We may eventually allow you to configure the DCC packet filter
			}


			if (uart_irq_tx_ready(dev)) {
				int rb_len, send_len;

				rb_len = ring_buf_get(&dcc_to_computer.ringbuf_outgoing, buffer, sizeof(buffer));
				if (!rb_len) {
	//				printf("Ring buffer empty, disable TX IRQ");
					uart_irq_tx_disable(dev);
					continue;
				}

				send_len = uart_fifo_fill(dev, buffer, rb_len);
				if (send_len < rb_len) {
					printf("Drop %d bytes\n", rb_len - send_len);
				}

	//			printf("ringbuf -> tty fifo %d bytes\n", send_len);
			}
		}
}

static void blink_status_led(){
	const struct gpio_dt_spec status_led = GPIO_DT_SPEC_GET(DT_NODELABEL(status_led), gpios);

	while(1){
		uint64_t diff = k_cycle_get_32() - last_rx_dcc_msg;

		if(k_cyc_to_ms_ceil32(diff) < 500){
			// Receiving DCC signal, double blink
			gpio_pin_set_dt(&status_led, 1);
			k_sleep(K_MSEC(100));
			gpio_pin_set_dt(&status_led, 0);
			k_sleep(K_MSEC(100));
			gpio_pin_set_dt(&status_led, 1);
			k_sleep(K_MSEC(100));
			gpio_pin_set_dt(&status_led, 0);
			k_sleep(K_MSEC(1500));
		}else{
			// No DCC signal, single blink
			gpio_pin_set_dt(&status_led, 1);
			k_sleep(K_MSEC(100));
			gpio_pin_set_dt(&status_led, 0);
			k_sleep(K_MSEC(1500));
		}
	}
}

static void blink_activity_led(){
	const struct gpio_dt_spec rx_led = GPIO_DT_SPEC_GET(DT_NODELABEL(rx_led), gpios);
	const struct gpio_dt_spec tx_led = GPIO_DT_SPEC_GET(DT_NODELABEL(tx_led), gpios);

	if (!gpio_is_ready_dt(&rx_led)) {
		return;
	}

	if (!gpio_is_ready_dt(&tx_led)) {
		return;
	}

	if(gpio_pin_configure_dt(&rx_led, GPIO_OUTPUT) < 0){
		return;
	}
	if(gpio_pin_configure_dt(&tx_led, GPIO_OUTPUT) < 0){
		return;
	}

	while(1){
		uint64_t diff_tx = k_cycle_get_32() - last_tx_can_msg;
		uint64_t diff_rx = k_cycle_get_32() - last_rx_can_msg;
		int blinked = 0;

		if(k_cyc_to_ms_ceil32(diff_tx) < 25){
			gpio_pin_set_dt(&tx_led, 1);
			blinked = 1;
		}
		if(k_cyc_to_ms_ceil32(diff_rx) < 25){
			gpio_pin_set_dt(&rx_led, 1);
			blinked = 1;
		}

		if(blinked){
			k_sleep(K_MSEC(50));
			gpio_pin_set_dt(&tx_led, 0);
			gpio_pin_set_dt(&rx_led, 0);
		}
		k_sleep(K_MSEC(20));
	}
}

static void incoming_dcc(struct dcc_decoder* decoder, const uint8_t* packet_bytes, int len){
	last_rx_dcc_msg = k_cycle_get_32();

	// Check to see if we should add this packet
	if(len == 3 && !lcc_link_data.dcc_decoding_info.pass_idle_packets){
		// if this is an idle packet, drop it
		const uint8_t idle_packet[] = { 0xFF, 0x00, 0xFF };
		if(memcmp(packet_bytes, idle_packet, 3) == 0){
			return;
		}
	}

	dcc_to_computer_add_packet(&dcc_to_computer, packet_bytes, len);
}

static int do_usb_init(){
	int ret;

	if (!device_is_ready(can_usb_dev)) {
		printf("CDC ACM device not ready\n");
		return -1;
	}

	if (!device_is_ready(dcc_usb_dev)) {
		printf("CDC ACM device not ready\n");
		return -1;
	}

	ret = usbd_add_descriptor(&lcc_link_usbd, &lcc_link_lang);
	if (ret) return ret;

	ret = usbd_add_descriptor(&lcc_link_usbd, &lcc_link_mfr);
	if (ret) return ret;

	ret = usbd_add_descriptor(&lcc_link_usbd, &lcc_link_product);
	if (ret) return ret;

	ret = usbd_add_configuration(&lcc_link_usbd, USBD_SPEED_FS, &lcc_link_fs_config);
	if (ret) return ret;

	ret = usbd_register_all_classes(&lcc_link_usbd, USBD_SPEED_FS, 1, NULL);
	if (ret) return ret;

	usbd_device_set_code_triple(&lcc_link_usbd, USBD_SPEED_FS,
				    USB_BCC_MISCELLANEOUS, 0x02, 0x01);

	ret = usbd_init(&lcc_link_usbd);
	if (ret) return ret;

	ret = usbd_enable(&lcc_link_usbd);
	return ret;
}

static void reboot(struct lcc_memory_context* ctx){
	sys_reboot(SYS_REBOOT_COLD);
}

static void factory_reset(struct lcc_memory_context* ctx){
	memset(&lcc_link_data.dcc_decoding_info, 0, sizeof(lcc_link_data.dcc_decoding_info));
	memset(&lcc_link_data.node_info, 0, sizeof(lcc_link_data.node_info));

	lcc_link_data.dcc_decoding_info.pass_idle_packets = 1;
	memory_space_written(NULL, 251);
	memory_space_written(NULL, 253);
}

static uint64_t load_lcc_id(){
	uint64_t ret = 0;
	int do_reboot = 0;

	const struct flash_area* lcc_storage_area = NULL;
	int id = FIXED_PARTITION_ID(lcc_partition);

	if(flash_area_open(id, &lcc_storage_area) < 0){
		return 1;
	}

	if(flash_area_read(lcc_storage_area, 0, &ret, sizeof(ret)) < 0){
		return 1;
	}

	// Check to see if the first 8 bytes are 0xFF.  If so, we assume the data is uninitialized
	const uint8_t mem[8] = {
			0xFF, 0xFF, 0xFF, 0xFF,
			0xFF, 0xFF, 0xFF, 0xFF
	};
	if(memcmp(&ret, mem, 8) == 0){
		uint64_t new_id = 0;
		int valid = 0;

		console_getline_init();

		// Do our birthing checks to validate that the outputs and inputs are working
//		smtc8_birthing();

		while(!valid){
			printf("LCC ID blank!  Please input lower 2 bytes of LCC ID as a single hex string followed by enter:\n");
			char id_buffer[32];
			char* console_data = console_getline();
			printf("console line: %s\n", console_data);
			new_id = strtoull(console_data, NULL, 16);
			new_id = new_id & 0xFFFF;
			new_id = new_id | (0x02020202ull << 16);
			lcc_node_id_to_dotted_format(new_id, id_buffer, sizeof(id_buffer));

			printf("New node ID will be %s.  Type 'y'<ENTER> to accept\n", id_buffer);
			console_data = console_getline();
			printf("response: %s\n", console_data);
			if(console_data[0] == 'y'){
				valid = 1;
				ret = new_id;
			}
		}

		flash_area_write(lcc_storage_area, 0, &ret, sizeof(ret));

		// Do a 'factory reset' to make sure everything is initialized
		factory_reset(NULL);
		do_reboot = 1;
	}

out:
	flash_area_close(lcc_storage_area);

	if(do_reboot){
		printf("Birthing complete, rebooting...\n");
		sys_reboot(SYS_REBOOT_COLD);
	}

	return ret;
}

static void splash(){
	printf("LCC-Link starting up\n");
	printf("  Version: " APP_VERSION_STRING "\n");

	struct mcuboot_img_header versions[2];
	struct mcuboot_img_sem_ver semver[2] = {0};

	if(boot_read_bank_header(FIXED_PARTITION_ID(slot0_partition), &versions[0], sizeof(struct mcuboot_img_header)) == 0){
	  semver[0] = versions[0].h.v1.sem_ver;
	}
	if(boot_read_bank_header(FIXED_PARTITION_ID(slot1_partition), &versions[1], sizeof(struct mcuboot_img_header)) == 0){
	  semver[1] = versions[1].h.v1.sem_ver;
	}

	printf("  This slot version: %d.%d.%d\n", semver[0].major, semver[0].minor, semver[0].revision);
	printf("  Secondary slot version: %d.%d.%d\n", semver[1].major, semver[1].minor, semver[1].revision);
}

static void init_dcc(){
	dcc_to_computer_init(&dcc_to_computer, dcc_usb_dev);
	dcc_decoder_init(&dcc_decode_ctx);
//	dcc_decoder_set_packet_callback(dcc_decode_ctx.dcc_decoder, incoming_dcc);
	uart_irq_callback_set(dcc_usb_dev, irq_handler_dcc_usb);

	dcc_decoder_set_packet_callback(dcc_decode_ctx.dcc_decoder, incoming_dcc);
}

static void parse_from_computer(struct computer_to_can* computer_to_can){
	static struct can_frame rx_frame;
	static struct lcc_can_frame lcc_rx;

	while(k_msgq_get(computer_to_can_parsed_queue(computer_to_can), &rx_frame, K_NO_WAIT) == 0){
		memset(&lcc_rx, 0, sizeof(lcc_rx));
		lcc_rx.can_id = rx_frame.id;
		lcc_rx.can_len = rx_frame.dlc;
		memcpy(lcc_rx.data, rx_frame.data, 8);

		// Send out to CAN
		computer_to_can_tx_frame(computer_to_can, &rx_frame);

		lcc_context_incoming_frame(lcc_ctx, &lcc_rx);
	}
}

static void main_loop(struct computer_to_can* computer_to_can, struct can_to_computer* can_to_computer){
	static struct k_poll_event poll_data[3] = {0};
	static struct k_timer alias_timer;

	k_timer_init(&alias_timer, NULL, NULL);
	k_timer_start(&alias_timer, K_MSEC(250), K_NO_WAIT);

	k_poll_event_init(&poll_data[0],
			K_POLL_TYPE_MSGQ_DATA_AVAILABLE,
			K_POLL_MODE_NOTIFY_ONLY,
			computer_to_can_parsed_queue(computer_to_can));
	k_poll_event_init(&poll_data[1],
			K_POLL_TYPE_MSGQ_DATA_AVAILABLE,
			K_POLL_MODE_NOTIFY_ONLY,
			can_to_computer_msgq(can_to_computer));
	k_poll_event_init(&poll_data[2],
			K_POLL_TYPE_MSGQ_DATA_AVAILABLE,
			K_POLL_MODE_NOTIFY_ONLY,
			&dcc_decode_ctx.readings);

	while (1) {
		int rc = k_poll(poll_data, ARRAY_SIZE(poll_data), K_MSEC(250));
		if(poll_data[0].state == K_POLL_STATE_MSGQ_DATA_AVAILABLE){
			// A frame has been parsed from the computer
			parse_from_computer(computer_to_can);
			poll_data[0].state = K_POLL_STATE_NOT_READY;
			last_tx_can_msg = k_cycle_get_32();
		}else if(poll_data[1].state == K_POLL_STATE_MSGQ_DATA_AVAILABLE){
			// A frame has been received from the CAN bus
			static struct can_frame rx_frame;
			static struct lcc_can_frame lcc_rx;
			while(k_msgq_get(can_to_computer_msgq(can_to_computer), &rx_frame, K_NO_WAIT) == 0){
				can_to_computer_send_frame(can_to_computer, &rx_frame);

				// also send it to our local processing so we do stuff too
				memset(&lcc_rx, 0, sizeof(lcc_rx));
				lcc_rx.can_id = rx_frame.id;
				lcc_rx.can_len = rx_frame.dlc;
				memcpy(lcc_rx.data, rx_frame.data, 8);

				lcc_context_incoming_frame(lcc_ctx, &lcc_rx);
			}
			poll_data[1].state = K_POLL_STATE_NOT_READY;
			last_rx_can_msg = k_cycle_get_32();
		}
		else if(poll_data[2].state == K_POLL_STATE_MSGQ_DATA_AVAILABLE){
			uint32_t timediff;
			while(k_msgq_get(&dcc_decode_ctx.readings, &timediff, K_NO_WAIT) == 0){
				if(dcc_decoder_polarity_changed(dcc_decode_ctx.dcc_decoder, timediff) == 1){
					dcc_decoder_pump_packet(dcc_decode_ctx.dcc_decoder);
				}
			}
			poll_data[2].state = K_POLL_STATE_NOT_READY;
		}

		if(k_timer_status_get(&alias_timer) > 0 &&
			lcc_context_current_state(lcc_ctx) == LCC_STATE_INHIBITED){
			int stat = lcc_context_claim_alias(lcc_ctx);
			if(stat == LCC_ERROR_ALIAS_TX_NOT_EMPTY){
				k_timer_start(&alias_timer, K_MSEC(500), K_NO_WAIT);
				continue;
			}
			if(stat != LCC_OK){
			  // If we were unable to claim our alias, we need to generate a new one and start over
			  lcc_context_generate_alias(lcc_ctx);
			}else{
			  printf("Claimed alias %X\n", lcc_context_alias(lcc_ctx) );
			}
		}
	}
}

static int lcc_write_cb(struct lcc_context*, struct lcc_can_frame* lcc_frame){
	static struct can_frame zephyr_can_frame_tx;
	memset(&zephyr_can_frame_tx, 0, sizeof(zephyr_can_frame_tx));
	zephyr_can_frame_tx.id = lcc_frame->can_id;
	zephyr_can_frame_tx.dlc = lcc_frame->can_len;
	zephyr_can_frame_tx.flags = CAN_FRAME_IDE;
	memcpy(zephyr_can_frame_tx.data, lcc_frame->data, 8);

	// Send the frame to the computer
	can_to_computer_send_frame(&can_to_computer, &zephyr_can_frame_tx);

	// also send it to the bus
	computer_to_can_tx_frame(&computer_to_can, &zephyr_can_frame_tx);

	return LCC_OK;
}

static void memory_space_written(struct lcc_memory_map*, uint8_t space){
	const struct flash_area* storage_area = NULL;
	int id;
	void* ram_location;
	uint32_t size;
	int ret = 0;

	if(space == 253){
		id = FIXED_PARTITION_ID(segment_253);
		ram_location = memory_segments[1].memory;
		size = 8; // memory_segments[1].high_address; // need to write at least 8 bytes
	}else if(space == 251){
		id = FIXED_PARTITION_ID(segment_251);
		ram_location = memory_segments[0].memory;
		size = memory_segments[0].high_address;
	}else{
		printf("Memory space %d written to, but no such space defined\n", space);
		return;
	}

	if(flash_area_open(id, &storage_area) < 0){
		return;
	}

	ret = flash_area_erase(storage_area, 0, storage_area->fa_size);
	if(ret){
		goto out;
	}

	ret = flash_area_write(storage_area, 0, ram_location, size);

out:
	if(ret){
		printf("Unable to save space %d to flash(reason: %d)\n", space, ret);
	}
	flash_area_close(storage_area);
}

static int load_global_config(){
	const struct flash_area* storage_area = NULL;
	int id = FIXED_PARTITION_ID(segment_253);
	int ret = 0;

	if(flash_area_open(id, &storage_area) < 0){
		return 1;
	}

	if(flash_area_read(storage_area, 0, &lcc_link_data.dcc_decoding_info, sizeof(struct dcc_decoding_info)) < 0){
		ret = 1;
	}

out:
	flash_area_close(storage_area);
	if(ret){
		printf("Unable to load global config\n");
	}

	return ret;
}

static int load_node_info(){
	const struct flash_area* storage_area = NULL;
	int id = FIXED_PARTITION_ID(segment_251);
	int ret = 0;

	if(flash_area_open(id, &storage_area) < 0){
		return 1;
	}

	if(flash_area_read(storage_area, 0, &lcc_link_data.node_info, sizeof(struct node_info_segment)) < 0){
		ret = 1;
	}

out:
	flash_area_close(storage_area);
	if(ret){
		printf("Unable to load global config\n");
	}

	return ret;
}

static int enable_status_led(){
	struct gpio_dt_spec status_led = GPIO_DT_SPEC_GET(DT_NODELABEL(status_led), gpios);

	if (!gpio_is_ready_dt(&status_led)) {
		return -1;
	}

	if(gpio_pin_configure_dt(&status_led, GPIO_OUTPUT_INACTIVE) < 0){
		return -1;
	}

	return 0;
}

static void fail_usb(){
	struct gpio_dt_spec status_led = GPIO_DT_SPEC_GET(DT_NODELABEL(status_led), gpios);

	while(1){
		gpio_pin_set_dt(&status_led, 1);
		k_msleep(50);
		gpio_pin_set_dt(&status_led, 0);
		k_msleep(250);
	}
}

int main(void)
{
	int ret;

	splash();

	if(enable_status_led() < 0){
		printf("unable to enable status LED\n");
		return -1;
	}

	if(do_usb_init() < 0){
		fail_usb();
	}

	if (!device_is_ready(can_dev)) {
		printf("CAN: Device %s not ready.\n", can_dev->name);
		return 0;
	}

	ret = can_start(can_dev);
	if(ret != 0){
		printf("Can't start CAN\n");
		return 0;
	}

	computer_to_can_init(&computer_to_can, can_dev);
	can_to_computer_init(&can_to_computer, can_dev, can_usb_dev);

	memset(&tx_remain, 0, sizeof(tx_remain));
	uart_irq_callback_user_data_set(can_usb_dev, irq_handler_can_usb, &tx_remain);
	uart_irq_rx_enable(can_usb_dev);

	init_dcc();

	lcc_ctx = lcc_context_new();
	if(lcc_ctx == NULL){
		// This uses only static data to initialize, so this should never happen.
		printf("error: unable to initialize! %d\n", __LINE__);
		return -1;
	}

	uint64_t lcc_id = load_lcc_id();
	lcc_context_set_unique_identifer( lcc_ctx,
			lcc_id );
	lcc_context_set_simple_node_information(lcc_ctx,
			"Snowball Creek Electronics",
			"LCC-Link",
			"R1",
			APP_VERSION_STRING);


	lcc_context_set_write_function(lcc_ctx, lcc_write_cb, 0);
	// need datagram context and memory context in order to support firmware upgrades
	lcc_datagram_context_new(lcc_ctx);
	struct lcc_memory_context* mem_ctx = lcc_memory_new(lcc_ctx);
	struct lcc_memory_map* mem_map = lcc_memory_map_new(mem_ctx, memory_segments);
	lcc_memory_map_set_written_callback(mem_map, memory_space_written);

	lcc_memory_set_factory_reset_function(mem_ctx, factory_reset);
	lcc_memory_set_reboot_function(mem_ctx, reboot);
	lcc_memory_set_cdi(mem_ctx, cdi, strlen(cdi), 0);

	firmware_upgrade_init(lcc_ctx);

	int stat = lcc_context_generate_alias(lcc_ctx);
	if(stat < 0){
		printf("error: can't gen alias: %d\n", stat);
		return 0;
	}

	load_global_config();
	load_node_info();

	lcc_context_set_simple_node_name_description(lcc_ctx,
			lcc_link_data.node_info.name,
			lcc_link_data.node_info.description);

	main_loop(&computer_to_can, &can_to_computer);

	return 0;
}
```

## src/can_to_computer.c
```c
/*
 * can_to_computer.c
 *
 *  Created on: Nov 4, 2024
 *      Author: robert
 */
#include <zephyr/drivers/uart.h>

#include "can_to_computer.h"
#include "lcc-gridconnect.h"

void can_to_computer_init(struct can_to_computer* can_to_computer, const struct device* can_dev, const struct device* computer_uart){
	can_to_computer->computer_uart = computer_uart;
	k_msgq_init(&can_to_computer->rx_msgq, can_to_computer->rx_msgq_data, sizeof(struct can_frame), 55);
	ring_buf_init(&can_to_computer->ringbuf_outgoing,
				sizeof(can_to_computer->ring_buffer_outgoing),
				can_to_computer->ring_buffer_outgoing);

	const struct can_filter filter = {
			.flags = CAN_FILTER_IDE,
			.id = 0x0,
			.mask = 0
	};
	int filter_id;

	filter_id = can_add_rx_filter_msgq(can_dev, &can_to_computer->rx_msgq, &filter);
	printf("Filter ID: %d\n", filter_id);
}

struct k_msgq* can_to_computer_msgq(struct can_to_computer* can_to_computer){
	return &can_to_computer->rx_msgq;
}

int can_to_computer_send_frame(struct can_to_computer* can_to_computer, struct can_frame* can_frame){
	struct lcc_can_frame frm = {0};
	frm.can_id = can_frame->id;
	frm.can_len = can_frame->dlc;
	memcpy(frm.data, can_frame->data, 8);

	return can_to_computer_send_lcc_frame(can_to_computer, &frm);
}

int can_to_computer_send_lcc_frame(struct can_to_computer* can_to_computer, struct lcc_can_frame* can_frame){
	char gridconnect_out_buffer[64];

	if(lcc_canframe_to_gridconnect(can_frame, gridconnect_out_buffer, sizeof(gridconnect_out_buffer)) != LCC_OK){
		return -1;
	}

	ring_buf_put(&can_to_computer->ringbuf_outgoing, gridconnect_out_buffer, strlen(gridconnect_out_buffer));
	ring_buf_put(&can_to_computer->ringbuf_outgoing, "\r\n", 2);
	uart_irq_tx_enable(can_to_computer->computer_uart);

	return 0;
}
```

## src/can_to_computer.h
```c
/*
 * can_to_computer.h
 *
 *  Created on: Nov 4, 2024
 *      Author: robert
 */

#ifndef LCC_LINK_SRC_CAN_TO_COMPUTER_H_
#define LCC_LINK_SRC_CAN_TO_COMPUTER_H_

#include <zephyr/drivers/can.h>
#include <zephyr/sys/ring_buffer.h>

struct lcc_can_frame;

struct can_to_computer{
	uint8_t ring_buffer_outgoing[1024];
	struct ring_buf ringbuf_outgoing;
	const struct device* computer_uart;
	struct can_frame rx_msgq_data[55];
	struct k_msgq rx_msgq;
};

void can_to_computer_init(struct can_to_computer*, const struct device* can_device, const struct device* computer_uart);

struct k_msgq* can_to_computer_msgq(struct can_to_computer*);

int can_to_computer_send_frame(struct can_to_computer* can_to_computer, struct can_frame* can_frame);

int can_to_computer_send_lcc_frame(struct can_to_computer* can_to_computer, struct lcc_can_frame* can_frame);

#endif /* LCC_LINK_SRC_CAN_TO_COMPUTER_H_ */
```

## src/cdi.h
```c
#ifndef CDI_H
#define CDI_H

#include "app_version.h"

const char cdi[] = {
"<?xml version='1.0'?> \
<cdi xmlns:xsi='http://www.w3.org/2001/XMLSchema-instance' xsi:noNamespaceSchemaLocation='http://openlcb.org/schema/cdi/1/1/cdi.xsd'> \
<identification> \
<manufacturer>Snowball Creek Electronics</manufacturer> \
<model>LCC-Link</model> \
<hardwareVersion>R1</hardwareVersion> \
<softwareVersion>" APP_VERSION_STRING "</softwareVersion> \
</identification> \
<acdi/> \
<segment space='251'> \
<name>Node ID</name> \
<group> \
<name>Your name and description for this node</name> \
<string size='63'> \
<name>Node Name</name> \
</string> \
<string size='64' offset='1'> \
<name>Node Description</name> \
</string> \
</group> \
</segment> \
<segment space='253'> \
<name>DCC Decoding</name> \
<int size='1'> \
<name>Pass Idle Packets</name> \
<description>Should DCC idle packets be forwarded to the computer?</description> \
<map> \
<relation> \
<property>0</property> \
<value>Disabled</value> \
</relation> \
<relation> \
<property>1</property> \
<value>Enabled</value> \
</relation> \
</map> \
</int> \
</segment> \
</cdi>"
};

#endif
```

## src/computer_to_can.c
```c
#include "computer_to_can.h"
#include "lcc-gridconnect.h"

K_THREAD_STACK_DEFINE(tx_stack, 512);
K_THREAD_STACK_DEFINE(parse_stack, 512);

static int computer_to_can_parse(struct computer_to_can* comp_to_can, struct can_frame* frame);

static void can_frame_send_thread(void *arg1, void *unused2, void *unused3)
{
	static struct can_frame tx_frame;
	struct computer_to_can* computer_to_can = arg1;
	struct can_bus_err_cnt err_cnt = {0, 0};
	enum can_state state;

	while(1){
		if(k_msgq_get(&computer_to_can->tx_msgq, &tx_frame, K_FOREVER) == 0){
			int err = can_get_state(computer_to_can->can_dev, &state, &err_cnt);
			if(err != 0){
				printf("Can't get CAN state\n");
				continue;
			}

			if(state == CAN_STATE_BUS_OFF){
				printf("CAN bus off, dropping packet\n");
				continue;
			}

			int stat = can_send(computer_to_can->can_dev, &tx_frame, K_FOREVER, NULL, NULL );
			if(stat < 0){
				printf("Unable to send: %d\n", stat);
			}
		}
	}
}

static void computer_to_can_parse_thread(void *arg1, void *unused2, void *unused3){
	struct computer_to_can* computer_to_can = arg1;
	struct can_frame frame;

	while(1){
		k_sem_take(&computer_to_can->parse_sem, K_FOREVER);
		int parsed = computer_to_can_parse(computer_to_can, &frame);
		if(parsed){
			if(k_msgq_put(&computer_to_can->parsed_msgq, &frame, K_NO_WAIT) < 0){
				printf("Overflow parsed message queue!\n");
			}
			// Give the semaphore back so that we try to parse a frame again.
			// If we can't parse a full frame, we effectively don't do anything.
			k_sem_give(&computer_to_can->parse_sem);
		}
	}
}

void computer_to_can_init(struct computer_to_can* computer_to_can, const struct device* can_dev){
	memset(computer_to_can->gridconnect_in, 0, sizeof(computer_to_can->gridconnect_in));
	computer_to_can->gridconnect_in_pos = 0;
	computer_to_can->can_dev = can_dev;

	ring_buf_init(&computer_to_can->ringbuf_incoming,
			sizeof(computer_to_can->ring_buffer_incoming),
			computer_to_can->ring_buffer_incoming);
	k_msgq_init(&computer_to_can->tx_msgq, computer_to_can->tx_msgq_data, sizeof(struct can_frame), 55);

	computer_to_can->tx_thread_tid = k_thread_create(&computer_to_can->tx_thread_data,
			tx_stack,
			K_THREAD_STACK_SIZEOF(tx_stack),
			can_frame_send_thread, computer_to_can, NULL, NULL,
			0, 0,
			K_NO_WAIT);
	if (!computer_to_can->tx_thread_tid) {
		printf("ERROR spawning tx thread\n");
	}

	k_msgq_init(&computer_to_can->parsed_msgq, computer_to_can->parsed_frames, sizeof(struct can_frame), ARRAY_SIZE(computer_to_can->parsed_frames));
	k_sem_init(&computer_to_can->parse_sem, 0, 1);
	computer_to_can->parse_thread_tid = k_thread_create(&computer_to_can->parse_thread_data,
			parse_stack,
			K_THREAD_STACK_SIZEOF(parse_stack),
			computer_to_can_parse_thread, computer_to_can, NULL, NULL,
			0, 0,
			K_NO_WAIT);
	if (!computer_to_can->parse_thread_tid) {
		printf("ERROR spawning parse thread\n");
	}
}

int computer_to_can_append_data(struct computer_to_can* comp_to_can, void* data, int len){
	int rb_len;

	rb_len = ring_buf_put(&comp_to_can->ringbuf_incoming, data, len);

	k_sem_give(&comp_to_can->parse_sem);

	return rb_len;
}

int computer_to_can_parse(struct computer_to_can* computer_to_can, struct can_frame* frame){
	char byte;
	static struct lcc_can_frame lcc_rx;

	// Rather stupid, but we will read bytes 1-by-1 until we have a full packet, discarding bytes
	// that are invalid.
	while(!ring_buf_is_empty(&computer_to_can->ringbuf_incoming)){
		ring_buf_get(&computer_to_can->ringbuf_incoming, &byte, 1);
		if(byte == ':'){
			computer_to_can->gridconnect_in_pos = 0;
		}

		computer_to_can->gridconnect_in[computer_to_can->gridconnect_in_pos] = byte;
		computer_to_can->gridconnect_in_pos++;

		if(computer_to_can->gridconnect_in_pos >= sizeof(computer_to_can->gridconnect_in)){
			computer_to_can->gridconnect_in_pos = 0;
		}

		if(byte == ';' && computer_to_can->gridconnect_in_pos > 0){
			// We have a full frame.  Parse and return the value
			int stat = lcc_gridconnect_to_canframe(computer_to_can->gridconnect_in, &lcc_rx);
			computer_to_can->gridconnect_in_pos = 0;
			if(stat == LCC_OK){
				// Convert into a zephyr CAN frame
				memset(frame, 0, sizeof(struct can_frame));
				frame->id = lcc_rx.can_id;
				frame->dlc = lcc_rx.can_len;
				frame->flags = CAN_FRAME_IDE;
				memcpy(frame->data, lcc_rx.data, 8);
				return 1;
			}
			return -1;
		}else if(byte == ';'){
			computer_to_can->gridconnect_in_pos = 0;
		}
	}

	return 0;
}

void computer_to_can_tx_frame(struct computer_to_can* comp_to_can, struct can_frame* frame){
	k_msgq_put(&comp_to_can->tx_msgq, frame, K_NO_WAIT);
}

struct k_msgq* computer_to_can_parsed_queue(struct computer_to_can* comp_to_can){
	return &comp_to_can->parsed_msgq;
}
```

## src/computer_to_can.h
```c
#ifndef COMPUTER_TO_CAN_H
#define COMPUTER_TO_CAN_H

#include <zephyr/drivers/can.h>
#include <zephyr/sys/ring_buffer.h>

/**
 * All of the variables required to turn a message from the computer
 * into a CAN message, and send it out
 */
struct computer_to_can{
	uint8_t ring_buffer_incoming[1024];
	struct ring_buf ringbuf_incoming;
	struct can_frame tx_msgq_data[55];
	struct can_frame parsed_frames[55];
	struct k_msgq tx_msgq;
	struct k_msgq parsed_msgq;
	k_tid_t tx_thread_tid;
	k_tid_t parse_thread_tid;
	char gridconnect_in[128];
	int gridconnect_in_pos;
	struct k_thread tx_thread_data;
	struct k_thread parse_thread_data;
	const struct device* can_dev;
	struct k_sem parse_sem;
};

/**
 * Init the computer to CAN.
 *
 * @param can_dev The CAN device to send data out on
 */
void computer_to_can_init(struct computer_to_can*, const struct device* can_dev);

/**
 * Append data to our buffer.  This data should be ASCII formatted gridconnect data
 */
int computer_to_can_append_data(struct computer_to_can* comp_to_can, void* data, int len);

/**
 * Attempt to transmit the given frame by putting it into the tx queue.
 */
void computer_to_can_tx_frame(struct computer_to_can* comp_to_can, struct can_frame* frame);

/**
 * Get the queue of parsed CAN frames that come from the gridconnect ASCII protocol.
 */
struct k_msgq* computer_to_can_parsed_queue(struct computer_to_can* comp_to_can);

#endif
```

## src/dcc-decode-stm32.c
```c
/*
 * dcc-decode.c
 *
 *  Created on: Jun 17, 2024
 *      Author: robert
 */
#include <stdint.h>
#include <zephyr/kernel.h>
#include <zephyr/drivers/gpio.h>
#include <stm32g0xx_ll_tim.h>
#include <stm32g0xx_ll_gpio.h>

#include "dcc-decoder.h"
#include "dcc-packet-parser.h"

#include "dcc-decode-stm32.h"
#include "dcc-decoder.h"

static uint32_t readings[1000];
static uint32_t pos = 0;
static uint32_t num_sr = 0;
static uint32_t num_bad_bits = 0;

struct dcc_decoder_stm32 dcc_decode_ctx;

static void debug_isr_halfbit(uint32_t cycle_time_usec){
	readings[pos++] = cycle_time_usec;
	if(pos == (sizeof(readings)/sizeof(readings[0]))){
		pos = 0;
//		printf("readings:\n");
		int num_readings_good = 0;
		int num_readings_bad = 0;
		for(int x = 0; x < sizeof(readings)/sizeof(readings[0]); x++){
			printf("%lu,", readings[x]);
			if(readings[x] >= 52 && readings[x] <= 64){
				num_readings_good++;
//				printf("1");
			}else if(readings[x] >= 90 && readings[x] <= 200){
				num_readings_good++;
//				printf("0");
			}else{
				num_readings_bad++;
//				printf("-");
			}
		}
		printf("good: %d bad: %d over: %d\n", num_readings_good, num_readings_bad, num_sr);
		num_sr = 0;
	}
}

static void debug_isr_fullbit(uint32_t cycle_time_usec){
	readings[pos++] = cycle_time_usec;
	if(pos == (sizeof(readings)/sizeof(readings[0]))){
		pos = 0;
//		printf("readings:\n");
		int num_readings_good = 0;
		int num_readings_bad = 0;
		for(int x = 0; x < sizeof(readings)/sizeof(readings[0]); x++){
			printf("%lu,", readings[x]);
			if(readings[x] >= (52*2) && readings[x] <= (64*2)){
				num_readings_good++;
//				printf("1");
			}else if(readings[x] >= (90*2) && readings[x] <= (200*2)){
				num_readings_good++;
//				printf("0");
			}else{
				num_readings_bad++;
//				printf("-");
			}
		}
		printf("good: %d bad: %d over: %d\n", num_readings_good, num_readings_bad, num_sr);
		num_sr = 0;
	}
}

ISR_DIRECT_DECLARE(tim2_irq_fn)
{
	ISR_DIRECT_HEADER();
	// Return 1 if a reschedule should be done, 0 if not
	int ret = 0;

	if (LL_TIM_IsActiveFlag_CC1(TIM2))
	{
		const uint32_t value = LL_TIM_IC_GetCaptureCH1(TIM2); // read value and clear the IRQ by reading CCR1
		// Timer should keep on running here.
		// We need to rebase the time on the counter such that 0 is the time that the value changed.
		// Since our IRQ doesn't happen immediately, calculate the new difference and set the timer
		// to that value.
		uint32_t new_value = LL_TIM_GetCounter(TIM2) - value;
		LL_TIM_SetCounter(TIM2, new_value);
		uint32_t sr = TIM2->SR;
		int overcap = sr & (0x01 << 9);
		if(overcap){
			num_sr++;
			sr &= ~(0x01 << 9);
			TIM2->SR = sr;
		}

		k_msgq_put(&dcc_decode_ctx.readings, &value, K_NO_WAIT);

		// We don't need to reschedule on every bit change, but we do need to do
		// it on a somewhat regular schedule.
		if(k_msgq_num_used_get(&dcc_decode_ctx.readings) >= 16){
			ret = 1;
		}
	}

	ISR_DIRECT_FOOTER(ret);
	return ret;
}

static int timer2_init(){
	// First enable the clock to the timer
	__HAL_RCC_TIM2_CLK_ENABLE();

	k_sleep(K_MSEC(1));

	// Set prescaler properly so we count every 1us
	LL_TIM_SetPrescaler(TIM2, 32);

	TIM2->CR1 = 0;
	TIM2->EGR = TIM_EGR_UG;

	// Steps are from RM0444, section 22.3.5
	// Step 1: Set TI1SEL bits to 0
	TIM2->TISEL = 0;
	// 2: select active input: TIM2_CCR1 must be linked to T1 input
	TIM2->CCMR1 = 1 | (0x2 << 4); // seems okay??
//	TIM2->CCMR1 = 1 | (0x3 << 4);
	// 3: set filter duration in CCMR1
	// 4: Set polarity of transitions.  We want both for DCC
	TIM2->CCER = 0xb; // both polarity
//	TIM2->CCER = 0x1; // rising only
	// 5: set input prescaler.  Leave at default values
	// 6: enable capture from counter into capture register
	// 7: enable the interrupt
	LL_TIM_EnableIT_CC1(TIM2);
	LL_TIM_EnableCounter(TIM2);

	return 0;
}

int dcc_decoder_init(struct dcc_decoder_stm32* decoder){
	k_msgq_init(&decoder->readings,
			decoder->readings_data,
			sizeof(uint32_t),
			ARRAY_SIZE(decoder->readings_data));

	timer2_init();

	// Configure the pin input for timer 2
	LL_GPIO_SetPinMode(GPIOA, LL_GPIO_PIN_15, LL_GPIO_MODE_ALTERNATE);
	LL_GPIO_SetPinPull(GPIOA, LL_GPIO_PIN_15, LL_GPIO_PULL_DOWN);
	LL_GPIO_SetAFPin_8_15(GPIOA, LL_GPIO_PIN_15, LL_GPIO_AF_2);

	// Custom IRQ handler for timer 2
	IRQ_DIRECT_CONNECT(TIM2_IRQn, 0, tim2_irq_fn, 0);
	irq_enable(TIM2_IRQn);

	// Configure and start timer2
	int res = timer2_init();
	if(res != 0){
		printf("can't init: %d\n", res);
	}

	decoder->packet_parser = dcc_packet_parser_new();
	if(decoder->packet_parser == NULL){
		// This uses only static data to initialize, so this should never happen.
		printf("error: unable to initialize! %d\n", __LINE__);
		return -1;
	}

	decoder->dcc_decoder = dcc_decoder_new(DCC_DECODER_IRQ_BOTH, DCC_DECODER_FLAG_EXPAND_ONE_BIT_DURATION);
	if(decoder->dcc_decoder == NULL){
		// This uses only static data to initialize, so this should never happen.
		printf("error: unable to initialize! %d\n", __LINE__);
		return -1;
	}

	return 0;
}

void dcc_decoder_disable(){
	irq_disable(TIM2_IRQn);
}
```

## src/dcc-decode-stm32.h
```c
/*
 * dcc-decode.h
 *
 *  Created on: Jun 17, 2024
 *      Author: robert
 */

#ifndef LCC_TORTOISE_ZEPHYR_SRC_DCC_DECODE_H_
#define LCC_TORTOISE_ZEPHYR_SRC_DCC_DECODE_H_

#include <zephyr/kernel.h>

struct dcc_decoder;
struct dcc_packet_parser;

struct dcc_decoder_stm32{
	struct k_msgq readings;
	uint32_t readings_data[128];
	struct dcc_decoder* dcc_decoder;
	struct dcc_packet_parser* packet_parser;
//	struct gpio_callback dcc_cb_data;
};

extern struct dcc_decoder_stm32 dcc_decode_ctx;

int dcc_decoder_init(struct dcc_decoder_stm32* decoder);

void dcc_decoder_disable();

#endif /* LCC_TORTOISE_ZEPHYR_SRC_DCC_DECODE_H_ */
```

## src/dcc_to_computer.c
```c
/*
 * dcc_to_computer.c
 *
 *  Created on: May 31, 2025
 *      Author: robert
 */
#include <zephyr/drivers/uart.h>
#include <string.h>

#include "dcc_to_computer.h"
#include "dcc-decode-stm32.h"
#include "dcc-decoder.h"
#include "dcc-packet-parser.h"

extern struct dcc_decoder_stm32 dcc_decode_ctx;

static void dcc_process(void *arg1, void *unused2, void *unused3) {
	uint32_t timediff;

	while(k_msgq_get(&dcc_decode_ctx.readings, &timediff, K_NO_WAIT) == 0){
//		printf(".");
		if(dcc_decoder_polarity_changed(dcc_decode_ctx.dcc_decoder, timediff) == 1){
			dcc_decoder_pump_packet(dcc_decode_ctx.dcc_decoder);
		}
	}
}

void dcc_to_computer_init(struct dcc_to_computer* dcc, const struct device* computer_uart){
	ring_buf_init(&dcc->ringbuf_outgoing,
				sizeof(dcc->ring_buffer_outgoing),
				dcc->ring_buffer_outgoing);
	dcc->computer_uart = computer_uart;
}

void dcc_to_computer_add_packet(struct dcc_to_computer* dcc, const uint8_t* packet_bytes, int len){
	struct dcc_packet packet = {0};
	if(len > sizeof(packet.data)){
		len = sizeof(packet.data);
	}
	packet.len = len;
	memcpy(packet.data, packet_bytes, len);

	uint32_t dtr = 0U;
	uart_line_ctrl_get(dcc->computer_uart, UART_LINE_CTRL_DTR, &dtr);
	if (!dtr) {
		return;
	}

	int put = ring_buf_put(&dcc->ringbuf_outgoing, &packet, sizeof(packet));
	if(put != sizeof(packet)){
		printf("Only put %d bytes", put);
	}
	uart_irq_tx_enable(dcc->computer_uart);
}
```

## src/dcc_to_computer.h
```c
#ifndef DCC_TO_COMPUTER_H
#define DCC_TO_COMPUTER_H

#include <zephyr/kernel.h>
#include <zephyr/sys/ring_buffer.h>

struct dcc_packet{
	uint8_t len;
	uint8_t data[15];
} __attribute__ ((packed));

struct dcc_to_computer{
	uint8_t ring_buffer_outgoing[1024];
	struct ring_buf ringbuf_outgoing;
	const struct device* computer_uart;
};

void dcc_to_computer_init(struct dcc_to_computer* dcc, const struct device* computer_uart);

void dcc_to_computer_add_packet(struct dcc_to_computer* dcc, const uint8_t* packet_bytes, int len);

#endif /* DCC_TO_COMPUTER_H */
```

## src/firmware-load.c
```c
/*
 * firmware-load.c
 *
 *  Created on: May 31, 2025
 *      Author: robert
 */
#include <zephyr/storage/flash_map.h>
#include <zephyr/sys/reboot.h>
#include <zephyr/kernel.h>
#include <zephyr/drivers/can.h>
#include <zephyr/drivers/eeprom.h>
#include <zephyr/storage/flash_map.h>
#include <zephyr/drivers/uart.h>

#include "firmware-load.h"
#include "lcc.h"
#include "lcc-common.h"
#include "lcc-event.h"
#include "lcc-memory.h"
#include "lcc-firmware-upgrade.h"
#include "computer_to_can.h"
#include "can_to_computer.h"
#include "dcc-decode-stm32.h"
#include "lcc-gridconnect.h"

static const struct flash_area* slot1 = NULL;

static void firmware_upgrade_start(struct lcc_firmware_upgrade_context* ctx){
	int ret = flash_area_erase(slot1, 0, slot1->fa_size);
	if( ret < 0){
		flash_area_close(slot1);
		slot1 = NULL;
		printf("flash erase bad\n");
	}

	printf("firmware upgrade start\n");
}

static void firmware_upgrade_incoming_data(struct lcc_firmware_upgrade_context* ctx, uint32_t starting_address, void* data, int data_len){
	if(!slot1){
		lcc_firmware_write_error(ctx, LCC_ERRCODE_PERMANENT, NULL);
		return;
	}

	// Make sure that the memory is aligned
	uint32_t alignment = flash_area_align(slot1);
	void* data_to_write = data;
	uint8_t data_aligned[60];
	if(data_len % alignment){
		// The data is not aligned
		memset(data_aligned, 0, sizeof(data_aligned));
		memcpy(data_aligned, data, data_len);
		while(data_len % alignment){
			data_len++;
		}
		data_to_write = data_aligned;
	}

	int ret = flash_area_write(slot1, starting_address, data_to_write, data_len);
	if(ret == 0){
		lcc_firmware_write_ok(ctx);
	}else{
		printf("write err: %d starting addr 0x%08X.  Tried to write %d bytes\n", ret, starting_address, data_len);
		lcc_firmware_write_error(ctx, LCC_ERRCODE_PERMANENT, NULL);
	}
}

static void firmware_upgrade_finished(struct lcc_firmware_upgrade_context* ctx){
	printf("firmware upgrade finished\n");
	boot_set_pending(1);
	// Wait for the final message to flush before we reboot
	k_sleep(K_MSEC(50));
	sys_reboot(SYS_REBOOT_COLD);
}

static int lcc_write_cb(struct lcc_context* ctx, struct lcc_can_frame* lcc_frame){
	struct can_to_computer* can_to_computer = lcc_context_user_data(ctx);
	char gridconnect_out_buffer[64];

	if(lcc_canframe_to_gridconnect(lcc_frame, gridconnect_out_buffer, sizeof(gridconnect_out_buffer)) != LCC_OK){
		return -1;
	}

	ring_buf_put(&can_to_computer->ringbuf_outgoing, gridconnect_out_buffer, strlen(gridconnect_out_buffer));
	ring_buf_put(&can_to_computer->ringbuf_outgoing, "\r\n", 2);
	uart_irq_tx_enable(can_to_computer->computer_uart);

//	printf("lcc write cb\n");

	return LCC_OK;
}

static void mem_address_space_information_query(struct lcc_memory_context* ctx, uint16_t alias, uint8_t address_space){
	// This memory space does not exist: return an error
	lcc_memory_respond_information_query(ctx, alias, 0, address_space, 0, 0, 0);
}

static void mem_address_space_read(struct lcc_memory_context* ctx, uint16_t alias, uint8_t address_space, uint32_t starting_address, uint8_t read_count){
	lcc_memory_respond_read_reply_fail(ctx, alias, address_space, 0, 0, NULL);
}

void mem_address_space_write(struct lcc_memory_context* ctx, uint16_t alias, uint8_t address_space, uint32_t starting_address, void* data, int data_len){
	lcc_memory_respond_write_reply_fail(ctx, alias, address_space, starting_address, 0, NULL);
}

static void reboot(struct lcc_memory_context* ctx){
	sys_reboot(SYS_REBOOT_COLD);
}

struct lcc_context* firmware_load(struct computer_to_can* computer_to_can, struct can_to_computer* can_to_computer){
	// Disable the CAN and DCC so we don't do anything with those subsystems
//	can_stop(can_dev);
//	dcc_decoder_disable();

	const uint64_t lcc_id = 0x020202000000;

	struct lcc_context* ctx = lcc_context_new();
	lcc_context_set_unique_identifer( ctx,
			lcc_id );
	lcc_context_set_simple_node_information(ctx,
			"Snowball Creek Electronics",
			"LCC-Link",
			"R" CONFIG_BOARD_REVISION,
			"1");

	lcc_context_set_userdata(ctx, can_to_computer);

	lcc_context_set_write_function( ctx, lcc_write_cb, NULL );

	lcc_datagram_context_new(ctx);
	struct lcc_memory_context* mem_ctx = lcc_memory_new(ctx);
	// NOTE: currently bug in liblcc where CDI is required to exist otherwise firmware loading won't work
	const char* cdi = "<cdi></cdi>";
	lcc_memory_set_cdi(mem_ctx, cdi, strlen(cdi), 0);
	lcc_memory_set_memory_functions(mem_ctx,
	    mem_address_space_information_query,
	    mem_address_space_read,
	    mem_address_space_write);
	lcc_memory_set_reboot_function(mem_ctx, reboot);

	struct lcc_firmware_upgrade_context* fwu_ctx = lcc_firmware_upgrade_new(ctx);

	lcc_firmware_upgrade_set_functions(fwu_ctx,
			firmware_upgrade_start,
			firmware_upgrade_incoming_data,
			firmware_upgrade_finished);

	int id = FIXED_PARTITION_ID(slot1_partition);

	flash_area_open(id, &slot1);

	// TODO this should be more robust(check if alias is bad or good)
	// we're going to assume that since our network should be just us(and JMRI)
	// that there shouldn't be an alias collision
	int stat = lcc_context_generate_alias( ctx );
	lcc_context_claim_alias(ctx);

	// Now at this point, we just process packets that come in.
	// The pushing of packets is done in the main loop of the application

	return ctx;
}
```

## src/firmware-load.h
```c
/*
 * firmware-load.h
 *
 *  Created on: May 31, 2025
 *      Author: robert
 */

#ifndef LCC_LINK_SRC_FIRMWARE_LOAD_H_
#define LCC_LINK_SRC_FIRMWARE_LOAD_H_

struct computer_to_can;
struct can_to_computer;
struct lcc_context;

struct lcc_context* firmware_load(struct computer_to_can* computer_to_can, struct can_to_computer* can_to_computer);

#endif /* LCC_LINK_SRC_FIRMWARE_LOAD_H_ */
```

## src/lcc-link-config.h
```c
/*
 * lcc-link-config.h
 *
 *  Created on: Mar 30, 2026
 *      Author: robert
 */

#ifndef LCC_LINK_SRC_LCC_LINK_CONFIG_H_
#define LCC_LINK_SRC_LCC_LINK_CONFIG_H_

#include <stdint.h>

/**
 * Node info - segment 251
 */
struct node_info_segment {
	char name[64];
	char description[64];
};

/**
 * DCC decoding info - segment 253
 *
 * Contains bytes that determine if we should(or should not) pass
 * the specified packet type up to the computer.
 *
 * In the future, this may also do things such as filtering the packets that we
 * want to send up to the computer(e.g. only show accessory commands or packets
 * for a specified address).
 */
struct dcc_decoding_info{
	uint8_t pass_idle_packets;

	//note: min write size is 8, so make sure we have some data to write
	uint8_t reserved[7];
};

struct lcc_link_config{
	struct node_info_segment node_info;
	struct dcc_decoding_info dcc_decoding_info;
};

extern struct lcc_link_config lcc_link_data;

#endif /* LCC_LINK_SRC_LCC_LINK_CONFIG_H_ */
```
