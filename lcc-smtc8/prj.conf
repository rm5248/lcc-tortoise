## CMakeLists.txt
```
# SPDX-License-Identifier: Apache-2.0

cmake_minimum_required(VERSION 3.20.0)
find_package(Zephyr REQUIRED HINTS $ENV{ZEPHYR_BASE})
project(LCC-Tortoise)

# Bring in the LCC library
#set(LIBLCC_ENABLE_STATIC_CONTEXT ON)
#add_subdirectory(TrainUtils/LCC)

# Zephyr does not want to play with third party libraries nicely:
# https://github.com/zephyrproject-rtos/zephyr/issues/8439
# So we do the highly annoying thing here of re-creating part of the liblcc cmake file
# in order to bring in all of the sources that we need
set(TRAINUTILS_DIR "${CMAKE_CURRENT_SOURCE_DIR}/../TrainUtils")
include(${TRAINUTILS_DIR}/LCC/lcc-version)

file(GLOB lcc-sources
    ${TRAINUTILS_DIR}/LCC/*.c
    ${TRAINUTILS_DIR}/LCC/*.h
    ${TRAINUTILS_DIR}/DCC/*.h
    ${TRAINUTILS_DIR}/DCC/*.c
)

target_sources(app PRIVATE 
	src/main.c 
	src/tortoise.c 
	src/lcc-tortoise-state.c
	src/dcc-decode-stm32.c
	src/power-handler.c
	src/firmware_upgrade.c
	src/switch-tracker.c
	src/birthing.c
	src/tortoise-cdi.c
	${lcc-sources}
)
target_include_directories(app PRIVATE
	${TRAINUTILS_DIR}/LCC
	${CMAKE_CURRENT_BINARY_DIR}/TrainUtils/LCC
	${TRAINUTILS_DIR}/DCC
)


string(REPLACE "." ";" VERSION_LIST ${LIBLCC_VERSION})
list(GET VERSION_LIST 0 LCC_VERSION_MAJOR)
list(GET VERSION_LIST 1 LCC_VERSION_MINOR)
list(GET VERSION_LIST 2 LCC_VERSION_PATCH)
target_compile_definitions(app PRIVATE
    LIBLCC_BUILD
    LIBLCC_MAJOR=${LCC_VERSION_MAJOR}
    LIBLCC_MINOR=${LCC_VERSION_MINOR}
    LIBLCC_MICRO=${LCC_VERSION_PATCH}
    LIBLCC_HAS_CONFIG_H
)
set(LIBLCC_DEBUG 0)
set(LIBLCC_ENABLE_STATIC_CONTEXT 1)
set(LIBLCC_EVENT_LIST_STATIC_SIZE 4224)
set(PROJECT_VERSION_MAJOR ${LCC_VERSION_MAJOR})
set(PROJECT_VERSION_MINOR ${LCC_VERSION_MINOR})
set(PROJECT_VERSION_PATCH ${LCC_VERSION_PATCH})
configure_file( ${TRAINUTILS_DIR}/LCC/lcc-config.h.cmake TrainUtils/LCC/lcc-config.h )
```

## Kconfig
```
mainmenu "LCC Tortoise"

source "Kconfig.zephyr"
config LCC_TORTOISE
	default y
	bool
	select USE_STM32_HAL_TIM
	select USE_STM32_HAL_TIM_EX
	select USE_STM32_HAL_GPIO
```

## sysbuild.conf
```
# Sysbuild configuration file.

# Enable MCUboot per default for this sample.
SB_CONFIG_BOOTLOADER_MCUBOOT=y
#SB_CONFIG_BOOT_SIGNATURE_TYPE_NONE=y
SB_CONFIG_BOOT_SIGNATURE_KEY_FILE="${APP_DIR}/lcc-smtc8.pem"
```

## prj.conf
```kconfig
CONFIG_SERIAL=y
CONFIG_SPI=y
CONFIG_SYS_CLOCK_TICKS_PER_SEC=100000
CONFIG_COUNTER=y
CONFIG_GPIO=y
CONFIG_LOG=y
CONFIG_CONSOLE=y
CONFIG_BOOTLOADER_MCUBOOT=y
CONFIG_MCUBOOT_SIGNATURE_KEY_FILE="/home/robert/lcc-workspace/lcc-tortoise/lcc-smtc8/lcc-smtc8.pem"
CONFIG_MCUBOOT_IMGTOOL_SIGN_VERSION="1.3.2"
CONFIG_ARM_MPU=y
# CONFIG_INIT_ARCH_HW_AT_BOOT is not set
CONFIG_POLL=y
CONFIG_ADC=y
CONFIG_FLASH=y
CONFIG_CAN=y
CONFIG_UART_CONSOLE=y
CONFIG_PINCTRL_DYNAMIC=y
CONFIG_CONSOLE_SUBSYS=y
CONFIG_CONSOLE_GETLINE=y
CONFIG_IMG_MANAGER=y
CONFIG_MCUBOOT_UPDATE_FOOTER_SIZE=0x1800
CONFIG_FLASH_MAP=y
CONFIG_STREAM_FLASH=y
CONFIG_ROM_END_OFFSET=0x1800
CONFIG_KERNEL_BIN_NAME="lcc-smtc8"
CONFIG_REBOOT=y
```

## src/birthing.c
```c
/*
 * birthing.c
 *
 *  Created on: Jan 5, 2025
 *      Author: robert
 */

#include <zephyr/drivers/gpio.h>
#include <stm32g0xx_ll_adc.h>
#include <stm32g0xx_ll_gpio.h>

#include "lcc-tortoise-state.h"
#include "birthing.h"
#include "tortoise.h"

static uint32_t vrefint;

static void panic(){
	printf("Unable to init GPIO!\n");
	while(1){

	}
}

static void do_tortoise_state(int state){
	for(int x = 0; x < 8; x++){
		struct tortoise* tort = &lcc_tortoise_state.tortoises[x];

		switch(state){
		case 0:
			gpio_pin_set_dt(&tort->gpios[0], 0);
			gpio_pin_set_dt(&tort->gpios[1], 0);
			break;
		case 1:
			gpio_pin_set_dt(&tort->gpios[0], 1);
			gpio_pin_set_dt(&tort->gpios[1], 0);
			break;
		case 2:
			gpio_pin_set_dt(&tort->gpios[0], 0);
			gpio_pin_set_dt(&tort->gpios[1], 1);
			break;
		case 3:
			gpio_pin_set_dt(&tort->gpios[0], 1);
			gpio_pin_set_dt(&tort->gpios[1], 1);
			break;
		}
	}
}

static void init_adc(){
	__HAL_RCC_ADC_CLK_ENABLE();

	LL_GPIO_SetPinMode(GPIOA, LL_GPIO_PIN_1, LL_GPIO_MODE_ANALOG);
	LL_GPIO_SetPinMode(GPIOA, LL_GPIO_PIN_0, LL_GPIO_MODE_ANALOG);

    /* Enable ADC internal voltage regulator */
	LL_ADC_EnableInternalRegulator(ADC1);
	while (LL_ADC_IsCalibrationOnGoing(ADC1) != 0U){
		k_sleep(K_USEC(2));
	}

	LL_ADC_SetClock(ADC1, LL_ADC_CLOCK_SYNC_PCLK_DIV2);
	LL_ADC_REG_SetOverrun(ADC1, LL_ADC_REG_OVR_DATA_OVERWRITTEN);
	LL_ADC_REG_SetContinuousMode(ADC1, LL_ADC_REG_CONV_SINGLE);
	LL_ADC_SetResolution(ADC1, LL_ADC_RESOLUTION_12B);

	LL_ADC_SetSamplingTimeCommonChannels(ADC1, LL_ADC_SAMPLINGTIME_COMMON_1, LL_ADC_SAMPLINGTIME_39CYCLES_5);
//	LL_ADC_REG_SetSequencerChannels(ADC1, (LL_ADC_CHANNEL_0 |
//			LL_ADC_CHANNEL_1 |
//			LL_ADC_CHANNEL_VREFINT));

	// Sampling time
	LL_ADC_SetChannelSamplingTime(ADC1, LL_ADC_CHANNEL_0, LL_ADC_SAMPLINGTIME_COMMON_1);
	LL_ADC_SetChannelSamplingTime(ADC1, LL_ADC_CHANNEL_1, LL_ADC_SAMPLINGTIME_COMMON_1);

	// Now let's enable it and start the ADC running
	LL_ADC_Enable(ADC1);
}

static int adc_value(int channel){
	LL_ADC_REG_SetSequencerChannels(ADC1, channel);
	LL_ADC_REG_StartConversion(ADC1);

	while(!LL_ADC_IsActiveFlag_EOC(ADC1)){}
	int reading = LL_ADC_REG_ReadConversionData32(ADC1);
	while(!LL_ADC_IsActiveFlag_EOS(ADC1)){}

	return reading;
}

static uint32_t calc_voltage_divider(int r1, int r2, int counts_in){
	// Vchannelx = vref/full_scale * adc_data
	// see section 15.9 in the refence manual
	uint32_t voltage_mv = counts_in * 3300 / 4095;
	uint32_t analog_ref_voltage = __LL_ADC_CALC_VREFANALOG_VOLTAGE(vrefint, LL_ADC_RESOLUTION_12B);
	uint32_t voltage_mv2 = __LL_ADC_CALC_DATA_TO_VOLTAGE(analog_ref_voltage, counts_in, LL_ADC_RESOLUTION_12B);

	// the analog_ref_voltage seems to always be way too high for some reason, so the readings are all invalid.
//	printf("vrefint: %d vref: %d one: %d two: %d\n", vrefint, analog_ref_voltage, voltage_mv, voltage_mv2);

	return ((r1 + r2) * voltage_mv) / r2;
}

void smtc8_birthing(){
	init_adc();

	for(int x = 0; x < 8; x++){
		int ret;
		struct tortoise* tort = &lcc_tortoise_state.tortoises[x];
		ret = gpio_pin_configure_dt(&tort->gpios[0], GPIO_OUTPUT_INACTIVE);
		if (ret < 0) {
			panic();
		}
		ret = gpio_pin_configure_dt(&tort->gpios[1], GPIO_OUTPUT_INACTIVE);
		if (ret < 0) {
			panic();
		}
	}

	printf("Press blue button to go forward in state, gold to exit\n");
	int state = 0;
	int blue_state = 0;
	int gold_state = 0;
	while(1){
		int new_blue_state = gpio_pin_get_dt(&lcc_tortoise_state.blue_button);
		int new_gold_state = gpio_pin_get_dt(&lcc_tortoise_state.gold_button);
		if(new_blue_state == 1 && blue_state == 0){
			state++;
			if(state > 3){
				state = 0;
			}
			vrefint = adc_value(LL_ADC_CHANNEL_VREFINT);
			int volts = adc_value(LL_ADC_CHANNEL_0);
			int vin = adc_value(LL_ADC_CHANNEL_1);
			printf("State: %d Volts: %d(%dmv) VIN: %d(%dmv)\n",
					state,
					volts, (int)(volts * 1000 / 274.5),
					vin, vin * 1000 / 271);
			gpio_pin_toggle_dt(&lcc_tortoise_state.blue_led);
			gpio_pin_toggle_dt(&lcc_tortoise_state.gold_led);
			gpio_pin_toggle_dt(&lcc_tortoise_state.green_led);
		}
		if(new_gold_state == 1 && gold_state == 0){
			break;
		}
		blue_state = new_blue_state;
		do_tortoise_state(state);
	}
}
```

## src/birthing.h
```c
/*
 * birthing.h
 *
 *  Created on: Jan 5, 2025
 *      Author: robert
 */

#ifndef LCC_SMTC8_SRC_BIRTHING_H_
#define LCC_SMTC8_SRC_BIRTHING_H_

void smtc8_birthing();

#endif /* LCC_SMTC8_SRC_BIRTHING_H_ */
```

## src/dcc-decode-stm32.c
```c
/*
 * dcc-decode.c
 *
 *  Created on: Jun 17, 2024
 *      Author: robert
 */
#include <stdint.h>
#include <zephyr/kernel.h>
#include <zephyr/drivers/gpio.h>
#include <stm32g0xx_ll_tim.h>
#include <stm32g0xx_ll_gpio.h>

#include "dcc-decoder.h"
#include "dcc-packet-parser.h"

#include "dcc-decode-stm32.h"
#include "dcc-decoder.h"
#include "lcc-tortoise-state.h"

static uint32_t readings[1000];
static uint32_t pos = 0;
static uint32_t num_sr = 0;
static uint32_t num_bad_bits = 0;

struct dcc_decoder_stm32 dcc_decode_ctx;

static void debug_isr_halfbit(uint32_t cycle_time_usec){
	readings[pos++] = cycle_time_usec;
	if(pos == (sizeof(readings)/sizeof(readings[0]))){
		pos = 0;
//		printf("readings:\n");
		int num_readings_good = 0;
		int num_readings_bad = 0;
		for(int x = 0; x < sizeof(readings)/sizeof(readings[0]); x++){
			printf("%lu,", readings[x]);
			if(readings[x] >= 52 && readings[x] <= 64){
				num_readings_good++;
//				printf("1");
			}else if(readings[x] >= 90 && readings[x] <= 200){
				num_readings_good++;
//				printf("0");
			}else{
				num_readings_bad++;
//				printf("-");
			}
		}
		printf("good: %d bad: %d over: %d\n", num_readings_good, num_readings_bad, num_sr);
		num_sr = 0;
	}
}

static void debug_isr_fullbit(uint32_t cycle_time_usec){
	readings[pos++] = cycle_time_usec;
	if(pos == (sizeof(readings)/sizeof(readings[0]))){
		pos = 0;
//		printf("readings:\n");
		int num_readings_good = 0;
		int num_readings_bad = 0;
		for(int x = 0; x < sizeof(readings)/sizeof(readings[0]); x++){
			printf("%lu,", readings[x]);
			if(readings[x] >= (52*2) && readings[x] <= (64*2)){
				num_readings_good++;
//				printf("1");
			}else if(readings[x] >= (90*2) && readings[x] <= (200*2)){
				num_readings_good++;
//				printf("0");
			}else{
				num_readings_bad++;
//				printf("-");
			}
		}
		printf("good: %d bad: %d over: %d\n", num_readings_good, num_readings_bad, num_sr);
		num_sr = 0;
	}
}

ISR_DIRECT_DECLARE(tim2_irq_fn)
{
	ISR_DIRECT_HEADER();
	// Return 1 if a reschedule should be done, 0 if not
	int ret = 0;

	if (LL_TIM_IsActiveFlag_CC1(TIM2))
	{
		const uint32_t value = LL_TIM_IC_GetCaptureCH1(TIM2); // read value and clear the IRQ by reading CCR1
		// Timer should keep on running here.
		// We need to rebase the time on the counter such that 0 is the time that the value changed.
		// Since our IRQ doesn't happen immediately, calculate the new difference and set the timer
		// to that value.
		uint32_t new_value = LL_TIM_GetCounter(TIM2) - value;
		LL_TIM_SetCounter(TIM2, new_value);
		uint32_t sr = TIM2->SR;
		int overcap = sr & (0x01 << 9);
		if(overcap){
			num_sr++;
			sr &= ~(0x01 << 9);
			TIM2->SR = sr;
		}

		k_msgq_put(&dcc_decode_ctx.readings, &value, K_NO_WAIT);

		// We don't need to reschedule on every bit change, but we do need to do
		// it on a somewhat regular schedule.
		if(k_msgq_num_used_get(&dcc_decode_ctx.readings) >= 16){
			ret = 1;
		}
	}

	ISR_DIRECT_FOOTER(ret);
	return ret;
}

static int timer2_init(){
	// First enable the clock to the timer
	__HAL_RCC_TIM2_CLK_ENABLE();

	k_sleep(K_MSEC(1));

	// Set prescaler properly so we count every 1us
	LL_TIM_SetPrescaler(TIM2, 32);

	TIM2->CR1 = 0;
	TIM2->EGR = TIM_EGR_UG;

	// Steps are from RM0444, section 22.3.5
	// Step 1: Set TI1SEL bits to 0
	TIM2->TISEL = 0;
	// 2: select active input: TIM2_CCR1 must be linked to T1 input
	TIM2->CCMR1 = 1 | (0x2 << 4); // seems okay??
//	TIM2->CCMR1 = 1 | (0x3 << 4);
	// 3: set filter duration in CCMR1
	// 4: Set polarity of transitions.  We want both for DCC
	TIM2->CCER = 0xb; // both polarity
//	TIM2->CCER = 0x1; // rising only
	// 5: set input prescaler.  Leave at default values
	// 6: enable capture from counter into capture register
	// 7: enable the interrupt
	LL_TIM_EnableIT_CC1(TIM2);
	LL_TIM_EnableCounter(TIM2);

	return 0;
}

int dcc_decoder_init(struct dcc_decoder_stm32* decoder){
	k_msgq_init(&decoder->readings,
			decoder->readings_data,
			sizeof(uint32_t),
			ARRAY_SIZE(decoder->readings_data));

	timer2_init();

	// Configure the pin input for timer 2
	LL_GPIO_SetPinMode(GPIOA, LL_GPIO_PIN_15, LL_GPIO_MODE_ALTERNATE);
	LL_GPIO_SetPinPull(GPIOA, LL_GPIO_PIN_15, LL_GPIO_PULL_DOWN);
	LL_GPIO_SetAFPin_8_15(GPIOA, LL_GPIO_PIN_15, LL_GPIO_AF_2);

	// Custom IRQ handler for timer 2
	IRQ_DIRECT_CONNECT(TIM2_IRQn, 0, tim2_irq_fn, 0);
	irq_enable(TIM2_IRQn);

	// Configure and start timer2
	int res = timer2_init();
	if(res != 0){
		printf("can't init: %d\n", res);
	}

	decoder->packet_parser = dcc_packet_parser_new();
	if(decoder->packet_parser == NULL){
		// This uses only static data to initialize, so this should never happen.
		printf("error: unable to initialize! %d\n", __LINE__);
		return -1;
	}

	decoder->dcc_decoder = dcc_decoder_new(DCC_DECODER_IRQ_BOTH, DCC_DECODER_FLAG_EXPAND_ONE_BIT_DURATION);
	if(decoder->dcc_decoder == NULL){
		// This uses only static data to initialize, so this should never happen.
		printf("error: unable to initialize! %d\n", __LINE__);
		return -1;
	}

	return 0;
}

void dcc_decoder_disable(){
	irq_disable(TIM2_IRQn);
}
```

## src/dcc-decode-stm32.h
```c
/*
 * dcc-decode.h
 *
 *  Created on: Jun 17, 2024
 *      Author: robert
 */

#ifndef LCC_TORTOISE_ZEPHYR_SRC_DCC_DECODE_H_
#define LCC_TORTOISE_ZEPHYR_SRC_DCC_DECODE_H_

#include <zephyr/kernel.h>

struct dcc_decoder;
struct dcc_packet_parser;

struct dcc_decoder_stm32{
	struct k_msgq readings;
	uint32_t readings_data[128];
	struct dcc_decoder* dcc_decoder;
	struct dcc_packet_parser* packet_parser;
	struct gpio_callback dcc_cb_data;
};

extern struct dcc_decoder_stm32 dcc_decode_ctx;

int dcc_decoder_init(struct dcc_decoder_stm32* decoder);

void dcc_decoder_disable();

#endif /* LCC_TORTOISE_ZEPHYR_SRC_DCC_DECODE_H_ */
```

## src/firmware_upgrade.c
```c
/*
 * firmware_upgrade.c
 *
 *  Created on: Aug 14, 2024
 *      Author: robert
 */


#include <zephyr/storage/flash_map.h>
#include <zephyr/sys/reboot.h>
#include <zephyr/kernel.h>
// zephyr/west does not find the bootutil header??
//#include "bootutil/bootutil_public.h"
#include <stdio.h>

#include "firmware_upgrade.h"
#include "lcc-common.h"
#include "lcc-firmware-upgrade.h"
#include "lcc-tortoise-state.h"

static const struct flash_area* slot1 = NULL;

static void firmware_upgrade_start(struct lcc_firmware_upgrade_context* ctx){
	int ret = flash_area_erase(slot1, 0, slot1->fa_size);
	if( ret < 0){
		flash_area_close(slot1);
		slot1 = NULL;
		printf("flash erase bad\n");
	}

	printf("firmware upgrade start\n");
}

static void firmware_upgrade_incoming_data(struct lcc_firmware_upgrade_context* ctx, uint32_t starting_address, void* data, int data_len){
	if(!slot1){
		lcc_firmware_write_error(ctx, LCC_ERRCODE_PERMANENT, NULL);
		return;
	}

	// Make sure that the memory is aligned
	uint32_t alignment = flash_area_align(slot1);
	void* data_to_write = data;
	uint8_t data_aligned[60];
	if(data_len % alignment){
		// The data is not aligned
		memset(data_aligned, 0, sizeof(data_aligned));
		memcpy(data_aligned, data, data_len);
		while(data_len % alignment){
			data_len++;
		}
		data_to_write = data_aligned;
	}

	int ret = flash_area_write(slot1, starting_address, data_to_write, data_len);
	if(ret == 0){
		lcc_firmware_write_ok(ctx);
	}else{
		printf("write err: %d starting addr 0x%08X.  Tried to write %d bytes\n", ret, starting_address, data_len);
		printf("12");
		lcc_firmware_write_error(ctx, LCC_ERRCODE_PERMANENT, NULL);
	}
}

static void firmware_upgrade_finished(struct lcc_firmware_upgrade_context* ctx){
	printf("firmware upgrade finished\n");
	boot_set_pending(1);
	save_tortoise_positions();
	save_switch_tracker();
	// Wait for the final message to flush before we reboot
	k_sleep(K_MSEC(50));
	sys_reboot(SYS_REBOOT_COLD);
}

int firmware_upgrade_init(struct lcc_context* ctx){
	struct lcc_firmware_upgrade_context* fwu_ctx = lcc_firmware_upgrade_new(ctx);

	lcc_firmware_upgrade_set_functions(fwu_ctx,
			firmware_upgrade_start,
			firmware_upgrade_incoming_data,
			firmware_upgrade_finished);

	int id = FIXED_PARTITION_ID(slot1_partition);

	return flash_area_open(id, &slot1);
}
```

## src/lcc-tortoise-state.c
```c
/*
 * lcc-tortoise-state.c
 *
 *  Created on: May 19, 2024
 *      Author: robert
 */

#include <zephyr/kernel.h>
#include <zephyr/drivers/gpio.h>
#include <zephyr/drivers/counter.h>
#include <zephyr/drivers/pinctrl.h>
#include <zephyr/devicetree.h>
#include <zephyr/storage/flash_map.h>

#include "lcc-tortoise-state.h"
#include "tortoise.h"
#include "dcc-decoder.h"

struct lcc_tortoise_state lcc_tortoise_state = {
		.green_led = GPIO_DT_SPEC_GET(DT_ALIAS(greenled), gpios),
		.blue_led = GPIO_DT_SPEC_GET(DT_ALIAS(blueled), gpios),
		.gold_led = GPIO_DT_SPEC_GET(DT_ALIAS(goldled), gpios),
		.blue_button = GPIO_DT_SPEC_GET(DT_NODELABEL(blue_switch), gpios),
		.gold_button = GPIO_DT_SPEC_GET(DT_NODELABEL(gold_switch), gpios),
		.tortoises = {
				{
						.gpios = {
								GPIO_DT_SPEC_GET_BY_IDX(DT_NODELABEL(tortoise0), gpios, 1),
								GPIO_DT_SPEC_GET_BY_IDX(DT_NODELABEL(tortoise0), gpios, 0)
						},
						.current_position = POSITION_REVERSE
				},
				{
						.gpios = {
								GPIO_DT_SPEC_GET_BY_IDX(DT_NODELABEL(tortoise1), gpios, 1),
								GPIO_DT_SPEC_GET_BY_IDX(DT_NODELABEL(tortoise1), gpios, 0)
						},
						.current_position = POSITION_REVERSE
				},
				{
						.gpios = {
								GPIO_DT_SPEC_GET_BY_IDX(DT_NODELABEL(tortoise2), gpios, 1),
								GPIO_DT_SPEC_GET_BY_IDX(DT_NODELABEL(tortoise2), gpios, 0)
						},
						.current_position = POSITION_REVERSE
				},
				{
						.gpios = {
								GPIO_DT_SPEC_GET_BY_IDX(DT_NODELABEL(tortoise3), gpios, 1),
								GPIO_DT_SPEC_GET_BY_IDX(DT_NODELABEL(tortoise3), gpios, 0)
						},
						.current_position = POSITION_REVERSE
				},
				{
						.gpios = {
								GPIO_DT_SPEC_GET_BY_IDX(DT_NODELABEL(tortoise4), gpios, 1),
								GPIO_DT_SPEC_GET_BY_IDX(DT_NODELABEL(tortoise4), gpios, 0)
						},
						.current_position = POSITION_REVERSE
				},
				{
						.gpios = {
								GPIO_DT_SPEC_GET_BY_IDX(DT_NODELABEL(tortoise5), gpios, 1),
								GPIO_DT_SPEC_GET_BY_IDX(DT_NODELABEL(tortoise5), gpios, 0)
						},
						.current_position = POSITION_REVERSE
				},
				{
						.gpios = {
								GPIO_DT_SPEC_GET_BY_IDX(DT_NODELABEL(tortoise6), gpios, 1),
								GPIO_DT_SPEC_GET_BY_IDX(DT_NODELABEL(tortoise6), gpios, 0)
						},
						.current_position = POSITION_REVERSE
				},
				{
						.gpios = {
								GPIO_DT_SPEC_GET_BY_IDX(DT_NODELABEL(tortoise7), gpios, 1),
								GPIO_DT_SPEC_GET_BY_IDX(DT_NODELABEL(tortoise7), gpios, 0)
						},
						.current_position = POSITION_REVERSE
				},
		}
};

static int init_led(const struct gpio_dt_spec* led){
	if (!gpio_is_ready_dt(led)) {
		return -1;
	}

	if(gpio_pin_configure_dt(led, GPIO_OUTPUT_INACTIVE) < 0){
		return -1;
	}

	return 0;
}

static int init_button(const struct gpio_dt_spec* button){
	if (!gpio_is_ready_dt(button)) {
		return -1;
	}

	if(gpio_pin_configure_dt(button, GPIO_INPUT) < 0){
		return -1;
	}

	if(gpio_pin_interrupt_configure_dt(button, GPIO_INT_EDGE_BOTH) < 0){
		return -1;
	}

	// TODO callbacks on button press

	return 0;
}

int lcc_tortoise_state_init(){
	lcc_tortoise_state.blue_button_press = 0;
	lcc_tortoise_state.button_control = CONFIG_MODE_NORMAL;
	lcc_tortoise_state.allow_new_command = 1;
	lcc_tortoise_state.disable_outputs_voltage_out_of_range = 0;

	if(init_led(&lcc_tortoise_state.green_led) < 0){
		return -1;
	}
	if(init_led(&lcc_tortoise_state.gold_led) < 0){
		return -1;
	}
	if(init_led(&lcc_tortoise_state.blue_led) < 0){
		return -1;
	}
	if(init_button(&lcc_tortoise_state.blue_button) < 0){
		return -1;
	}
	if(init_button(&lcc_tortoise_state.gold_button) < 0){
		return -1;
	}

	lcc_tortoise_state.gpio_expander = DEVICE_DT_GET(DT_NODELABEL(gpio_expander));

	for(int x = 0; x < 8; x++){
		lcc_tortoise_state.tortoises[x].config = &lcc_tortoise_state.tortoise_config[x];

		if(tortoise_init(&lcc_tortoise_state.tortoises[x]) < 0){
			return -1;
		}
	}

	return 0;
}

void save_tortoise_positions(){
	if(!lcc_tortoise_state.save_tortoise_pos_on_shutdown){
		return;
	}

	if(!lcc_tortoise_state.tortoise_pos_dirty){
		return;
	}

	const struct flash_area* location_storage_area = NULL;
	int id = FIXED_PARTITION_ID(location_partition);
	uint8_t data_to_save[8 * 4];
	for(int x = 0; x < 8; x++){
		data_to_save[x] = lcc_tortoise_state.tortoises[x].current_position;
		data_to_save[x + 8] = lcc_tortoise_state.tortoises[x].current_position;
		data_to_save[x + 16] = lcc_tortoise_state.tortoises[x].current_position;
		data_to_save[x + 24] = lcc_tortoise_state.tortoises[x].current_position;
	}

	if(flash_area_open(id, &location_storage_area) < 0){
		return;
	}

	if(flash_area_write(location_storage_area, 0, data_to_save, sizeof(data_to_save)) < 0){
		return;
	}
	flash_area_close(location_storage_area);
	lcc_tortoise_state.save_tortoise_pos_on_shutdown = 0;
	lcc_tortoise_state.tortoise_pos_dirty = 0;
}

void set_tortoise_posistions_dirty(){
	if(lcc_tortoise_state.tortoise_pos_dirty){
		return;
	}

	lcc_tortoise_state.tortoise_pos_dirty = 1;

	// Erase the flash just once.
	const struct flash_area* location_storage_area = NULL;
	int id = FIXED_PARTITION_ID(location_partition);

	if(flash_area_open(id, &location_storage_area) < 0){
		return;
	}

	if(flash_area_erase(location_storage_area, 0, location_storage_area->fa_size) < 0){

	}

	flash_area_close(location_storage_area);
}

void save_switch_tracker(){
	// We store 4 outputs per byte, so our buffer only needs to be 512 long
	static uint8_t save_buffer[512];

	if(global_config.dcc_translation.do_dcc_translation != DCC_TRANSLATION_ENABLE_AND_SAVE){
		return;
	}

	if(!lcc_tortoise_state.switch_tracker_dirty){
		return;
	}

	const struct flash_area* switch_tracking_partition = NULL;
	int id = FIXED_PARTITION_ID(switch_tracking_partition);

	if(flash_area_open(id, &switch_tracking_partition) < 0){
		return;
	}

	int current_byte = 0;
	int current_shift = 6;
	memset(save_buffer, 0, sizeof(save_buffer));
	for(int x = 0; x < 2048; x++){
		switch(lcc_tortoise_state.trackers[x].current_pos){
		case SWITCH_UNKNOWN:
			break;
		case SWITCH_NORMAL:
			save_buffer[current_byte] |= (0x01 << current_shift);
			break;
		case SWITCH_REVERSED:
			save_buffer[current_byte] |= (0x02 << current_shift);
			break;
		}

		current_shift = current_shift - 2;
		if(current_shift < 0){
			current_shift = 6;
			current_byte++;
		}
	}

	// Save the buffer out
	if(flash_area_write(switch_tracking_partition, 0, save_buffer, sizeof(save_buffer)) < 0){
		return;
	}

	flash_area_close(switch_tracking_partition);
	lcc_tortoise_state.switch_tracker_dirty = 0;
}

void set_switch_tracker_dirty(){
	if(lcc_tortoise_state.switch_tracker_dirty){
		return;
	}

	if(global_config.dcc_translation.do_dcc_translation != DCC_TRANSLATION_ENABLE_AND_SAVE){
		return;
	}

	const struct flash_area* switch_tracking_partition = NULL;
	int id = FIXED_PARTITION_ID(switch_tracking_partition);

	if(flash_area_open(id, &switch_tracking_partition) < 0){
		return;
	}

	if(flash_area_erase(switch_tracking_partition, 0, switch_tracking_partition->fa_size) < 0){
		return;
	}
	flash_area_close(switch_tracking_partition);
	lcc_tortoise_state.switch_tracker_dirty = 1;
}
```

## src/lcc-tortoise-state.h
```c
/*
 * lcc-tortoise-state.h
 *
 *  Created on: May 19, 2024
 *      Author: robert
 */

#ifndef LCC_TORTOISE_ZEPHYR_SRC_LCC_TORTOISE_STATE_H_
#define LCC_TORTOISE_ZEPHYR_SRC_LCC_TORTOISE_STATE_H_

#include <zephyr/drivers/gpio.h>
#include <zephyr/drivers/can.h>

#include "tortoise.h"
#include "dcc-decode-stm32.h"
#include "switch-tracker.h"

struct lcc_context;
struct lcc_gridconnect;
struct dcc_decoder;
struct dcc_packet_parser;

enum ConfigMode{
	CONFIG_MODE_NORMAL = 0,
	CONFIG_MODE_DCC_ADDR_PROG = 1,
	CONFIG_MODE_FACTORY_RESET = 2,
	CONFIG_MODE_GRIDCONNECT = 3,
	CONFIG_MODE_MAX = 3,
};

/**
 * The global state struct for our application
 */
struct lcc_tortoise_state{
	const struct gpio_dt_spec green_led;
	const struct gpio_dt_spec blue_led;
	const struct gpio_dt_spec gold_led;
	const struct gpio_dt_spec blue_button;
	const struct gpio_dt_spec gold_button;
	const struct gpio_dt_spec dcc_signal;
	struct tortoise_config tortoise_config[8];
	struct tortoise tortoises[8];

	struct lcc_context* lcc_context;
	const struct device* gpio_expander;

	// State information for LED blinking
	uint32_t last_rx_dcc_msg;
	uint32_t last_rx_can_msg;
	uint32_t last_tx_can_msg;

	// Internal state programming tracking
	uint32_t blue_button_press;
	uint32_t blue_button_press_diff;
	uint32_t gold_button_press;
	uint32_t gold_button_press_diff;
	uint8_t allow_new_command;
	enum ConfigMode button_control;
	uint8_t tort_output_current_idx;

	uint8_t save_tortoise_pos_on_shutdown;
	uint8_t tortoise_pos_dirty;

	// Tracker for the current switch positions
	uint8_t switch_tracker_dirty;
	struct switch_tracker trackers[2048];

	// should we disable all commands to the outputs?
	uint8_t disable_outputs_voltage_out_of_range;
	uint32_t disable_outputs_start_time;

	// Gridconnect mode
	struct lcc_gridconnect* gridconnect;
	uint8_t gridconnect_mode;
};

struct global_config{
	uint64_t device_id;
	uint8_t config_version;
};

struct dcc_address_translation_config{
#define DCC_TRANSLATION_ENABLE 1
#define DCC_TRANSLATION_ENABLE_AND_SAVE 2
	uint8_t do_dcc_translation;
};

struct global_config_data {
	char node_name[64];
	char node_description[64];
	uint64_t base_event_id;
	struct dcc_address_translation_config dcc_translation;
	uint8_t max_turnouts_at_once;
};

struct output_position_request{
	uint8_t output_number;
	uint8_t position;
};

extern struct lcc_tortoise_state lcc_tortoise_state;
extern struct global_config config;
extern struct global_config_data global_config;

int lcc_tortoise_state_init();

void save_tortoise_positions();

void set_tortoise_positions_dirty();

void save_switch_tracker();

void set_switch_tracker_dirty();

#endif /* LCC_TORTOISE_ZEPHYR_SRC_LCC_TORTOISE_STATE_H_ */
```

## src/power-handler.c
```c
/*
 * power-handler.c
 *
 *  Created on: Aug 11, 2024
 *      Author: robert
 */
#include <zephyr/kernel.h>
#include <zephyr/drivers/gpio.h>
#include <zephyr/storage/flash_map.h>
#include <zephyr/drivers/adc.h>
#include <gpio/gpio_mcp23xxx.h>
#include <stm32g0xx_ll_adc.h>
#include <stm32g0xx_ll_gpio.h>

#include "lcc-tortoise-state.h"
#include "tortoise.h"
#include "dcc-decode-stm32.h"
#include "power-handler.h"

static void adc_irq_fn(void* arg)
{
	if(LL_ADC_IsActiveFlag_AWD1(ADC1)){
		LL_ADC_ClearFlag_AWD1(ADC1);
		const struct mcp23xxx_config* expander_config = lcc_tortoise_state.gpio_expander->config;
		// Disable the GPIO expander in order to save power(maybe)
		gpio_pin_toggle_dt(&expander_config->gpio_reset);

		dcc_decoder_disable();
		save_tortoise_positions();
		save_switch_tracker();
	}
}

void powerhandle_init(){
	__HAL_RCC_ADC_CLK_ENABLE();

	LL_GPIO_SetPinMode(GPIOA, LL_GPIO_PIN_1, LL_GPIO_MODE_ANALOG);
	LL_GPIO_SetPinMode(GPIOA, LL_GPIO_PIN_0, LL_GPIO_MODE_ANALOG);

	// Install our interrupt handler for the ADC
	IRQ_CONNECT(ADC1_COMP_IRQn, 0, adc_irq_fn, NULL, 0);
	irq_enable(ADC1_COMP_IRQn);

    /* Enable ADC internal voltage regulator */
    LL_ADC_EnableInternalRegulator(ADC1);
    while (LL_ADC_IsCalibrationOnGoing(ADC1) != 0U){
    	k_sleep(K_USEC(2));
    }

	LL_ADC_SetClock(ADC1, LL_ADC_CLOCK_SYNC_PCLK_DIV2);
	LL_ADC_REG_SetOverrun(ADC1, LL_ADC_REG_OVR_DATA_OVERWRITTEN);
	LL_ADC_REG_SetContinuousMode(ADC1, LL_ADC_REG_CONV_CONTINUOUS);

	LL_ADC_SetSamplingTimeCommonChannels(ADC1, LL_ADC_SAMPLINGTIME_COMMON_1, LL_ADC_SAMPLINGTIME_39CYCLES_5);
	LL_ADC_REG_SetSequencerChannels(ADC1, LL_ADC_CHANNEL_1 | LL_ADC_CHANNEL_0);

	// Configure analog watchdog 1
	LL_ADC_SetAnalogWDMonitChannels(ADC1, LL_ADC_AWD1, LL_ADC_AWD_CHANNEL_1_REG);
	LL_ADC_ClearFlag_AWD1(ADC1);
	LL_ADC_ConfigAnalogWDThresholds(ADC1, LL_ADC_AWD1, 0xFFF, 1500);
	LL_ADC_EnableIT_AWD1(ADC1);

	// Sampling time
	LL_ADC_SetChannelSamplingTime(ADC1, LL_ADC_CHANNEL_1, LL_ADC_SAMPLINGTIME_COMMON_1);
	LL_ADC_SetChannelSamplingTime(ADC1, LL_ADC_CHANNEL_0, LL_ADC_SAMPLINGTIME_COMMON_1);

	// Now let's enable it and start the ADC running
	LL_ADC_Enable(ADC1);
	LL_ADC_REG_StartConversion(ADC1);

	// adc values:
	// 2130 = ~10v
	// 1800 = ~8.5v
	// 1500 = ~7v
}

void powerhandle_check_if_save_required(){
	int new_save_settings = 0;

	for(int x = 0; x < 8; x++){
		if(lcc_tortoise_state.tortoise_config[x].startup_control == STARTUP_LAST_POSITION){
			new_save_settings = 1;
		}
	}

	lcc_tortoise_state.save_tortoise_pos_on_shutdown = new_save_settings;
}

static int adc_value(int channel){
	LL_ADC_REG_SetSequencerChannels(ADC1, channel);
	LL_ADC_ClearFlag_EOC(ADC1);
	LL_ADC_REG_StartConversion(ADC1);

	while(!LL_ADC_IsActiveFlag_EOC(ADC1)){}
	int reading = LL_ADC_REG_ReadConversionData32(ADC1);
	while(!LL_ADC_IsActiveFlag_EOS(ADC1)){}

	return reading;
}

void powerhandle_current_volts_mv(struct adc_readings* readings){
	LL_ADC_REG_StopConversion(ADC1);
	while(LL_ADC_REG_IsConversionOngoing(ADC1)){}

	LL_ADC_REG_SetContinuousMode(ADC1, LL_ADC_REG_CONV_SINGLE);
	int volts_count = adc_value(LL_ADC_CHANNEL_0);
	int vin_count = adc_value(LL_ADC_CHANNEL_1);

	LL_ADC_REG_SetContinuousMode(ADC1, LL_ADC_REG_CONV_CONTINUOUS);
	LL_ADC_REG_StartConversion(ADC1);

	readings->volts_mv = (int)(volts_count * 1000 / 274.5);
	readings->vin_mv = vin_count * 1000 / 271;
}
```

## src/power-handler.h
```c
/*
 * power-handler.h
 *
 *  Created on: Aug 11, 2024
 *      Author: robert
 */

#ifndef LCC_TORTOISE_SRC_POWER_HANDLER_H_
#define LCC_TORTOISE_SRC_POWER_HANDLER_H_

struct adc_readings{
	int volts_mv;
	int vin_mv;
};

void powerhandle_init();

/**
 * When settings change, call this function to configure the power handling.
 * This is needed so that we don't write to the flash if we don't need to.
 */
void powerhandle_check_if_save_required();

void powerhandle_current_volts_mv(struct adc_readings*);

#endif /* LCC_TORTOISE_SRC_POWER_HANDLER_H_ */
```

## src/switch-tracker.c
```c
/*
 * switch-tracker.c
 *
 *  Created on: Dec 16, 2024
 *      Author: robert
 */
#include <zephyr/storage/flash_map.h>

#include "switch-tracker.h"
#include "lcc-tortoise-state.h"

#include "lcc.h"
#include "lcc-common.h"
#include "lcc-event.h"

static enum lcc_producer_state switch_producer_state(struct lcc_context* ctx, uint64_t event_id){
	struct lcc_accessory_address addr = {0};
	enum lcc_producer_state ret = LCC_PRODUCER_UNKNOWN;

	if( lcc_event_id_to_accessory_decoder_2040(event_id, &addr) < 0){
		goto out;
	}

	if(addr.dcc_accessory_address < 0 || addr.dcc_accessory_address > 2048){
		goto out;
	}

	switch(lcc_tortoise_state.trackers[addr.dcc_accessory_address].current_pos){
	case SWITCH_UNKNOWN:
		break;
	case SWITCH_NORMAL:
		if(addr.active){
			ret = LCC_PRODUCER_VALID;
		}else{
			ret = LCC_PRODUCER_INVALID;
		}
		break;
	case SWITCH_REVERSED:
		if(!addr.active){
			ret = LCC_PRODUCER_VALID;
		}else{
			ret = LCC_PRODUCER_INVALID;
		}
	}

out:
	return ret;
}

void switch_tracker_init(int save_state_upon_shutdown){
	memset(lcc_tortoise_state.trackers, 0, sizeof(lcc_tortoise_state.trackers));

	struct lcc_accessory_address address;
	uint64_t event_id;
	struct lcc_event_context* evt_ctx = lcc_context_get_event_context(lcc_tortoise_state.lcc_context);

	lcc_event_add_event_produced_transaction_start(evt_ctx);

	for(int x = 0; x < 2040; x++){
		address.active = 1;
		address.dcc_accessory_address = x;
		address.reserved = 0;

		if(lcc_accessory_decoder_to_event_id_2040(&address, &event_id) == LCC_OK){
			lcc_event_add_event_produced(evt_ctx, event_id);
		}

		address.active = 0;
		if(lcc_accessory_decoder_to_event_id_2040(&address, &event_id) == LCC_OK){
			lcc_event_add_event_produced(evt_ctx, event_id);
		}
	}

	lcc_event_add_event_produced_transaction_end(evt_ctx);

	lcc_event_add_event_produced_query_fn(evt_ctx, switch_producer_state);

	if(save_state_upon_shutdown){
		// Load all of the saved posistions from non volatile memory
		static uint8_t read_buffer[512];
		const struct flash_area* switch_tracking_partition = NULL;
		int id = FIXED_PARTITION_ID(switch_tracking_partition);

		if(flash_area_open(id, &switch_tracking_partition) < 0){
			return;
		}

		int current_switch = 0;
		memset(read_buffer, 0, sizeof(read_buffer));
		flash_area_read(switch_tracking_partition, 0, &read_buffer, sizeof(read_buffer));
		for(int x = 0; x < 512; x++){
			for(int shift = 6; shift >= 0; shift -= 2){
				int val = read_buffer[x] & (0x3 << shift);
				val = val >> shift;

				if(val == 1){
					lcc_tortoise_state.trackers[current_switch].current_pos = SWITCH_NORMAL;
				}else if(val == 2){
					lcc_tortoise_state.trackers[current_switch].current_pos = SWITCH_REVERSED;
				}else{
					lcc_tortoise_state.trackers[current_switch].current_pos = SWITCH_UNKNOWN;
				}
				current_switch++;
			}
		}

		flash_area_close(switch_tracking_partition);
	}
}

void switch_tracker_incoming_switch_command(uint16_t accy_number, enum dcc_accessory_direction accy_dir){
	int active = 0;
	int current = lcc_tortoise_state.trackers[accy_number].current_pos;

	if(accy_number > 2048){
		return;
	}

	if(accy_dir == ACCESSORY_NORMAL){
		active = 1;
		lcc_tortoise_state.trackers[accy_number].current_pos = SWITCH_NORMAL;
	}else if(accy_dir == ACCESSORY_REVERSE){
		lcc_tortoise_state.trackers[accy_number].current_pos = SWITCH_REVERSED;
	}else{
		return;
	}

	if(current == lcc_tortoise_state.trackers[accy_number].current_pos){
		// No change
		return;
	}

	set_switch_tracker_dirty();
	struct lcc_accessory_address address;
	uint64_t event_id;
	struct lcc_event_context* evt_ctx = lcc_context_get_event_context(lcc_tortoise_state.lcc_context);

	address.active = active;
	address.dcc_accessory_address = accy_number;
	address.reserved = 0;

	if(lcc_accessory_decoder_to_event_id_2040(&address, &event_id) == LCC_OK){
		lcc_event_produce_event(evt_ctx, event_id);
	}
}
```

## src/switch-tracker.h
```c
#ifndef LCC_SMTC8_SRC_SWITCH_TRACKER_H_
#define LCC_SMTC8_SRC_SWITCH_TRACKER_H_

#include "dcc-packet-parser.h"

enum switch_position{
	SWITCH_UNKNOWN,
	SWITCH_NORMAL,
	SWITCH_REVERSED,
};

struct switch_tracker{
	enum switch_position current_pos;
};

/**
 * Initialize the switch tracker(tracks switches from DCC and sends out the
 * corresponding messages over LCC).
 */
void switch_tracker_init(int save_upon_shutdown);

void switch_tracker_incoming_switch_command(uint16_t accy_number, enum dcc_accessory_direction accy_dir);

#endif /* LCC_SMTC8_SRC_SWITCH_TRACKER_H_ */
```

## src/tortoise-cdi.c
```c
/*
 * tortoise-cdi.c
 *
 *  Created on: Oct 26, 2025
 *      Author: robert
 */

#include <stdlib.h>

#include "lcc-cdi-control.h"

const struct lcc_cdi_input segment_251_inputs[] = {
		{"Node Name", NULL, NULL, 0, 0, LCC_CDI_INPUT_TYPE_STRING, 63, 0},
		{"Node Description", NULL, NULL, 0, 0, LCC_CDI_INPUT_TYPE_STRING, 64, 1},
		{NULL, NULL, NULL, 0, 0, 0, 0, 0}
};

const struct lcc_cdi_group segment_251_groups[] = {
		{"Your name and description for this node", NULL, 0, 0, },
		{NULL, NULL, 0, 0, NULL}
};

const struct lcc_cdi_segment segment_251 = {
		.segment_space = 251,
		.segment_name = "Node ID",
		.groups = segment_251_groups,
		.inputs = {0}
};

const struct lcc_cdi_segment segments[] = {
		segment_251,
		{0}
};

const struct lcc_cdi_control smtc8_cdi_control = {
		.segments = segments,
		.simple_info = NULL
};
```
