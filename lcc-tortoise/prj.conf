## CMakeLists.txt
```
# SPDX-License-Identifier: Apache-2.0

cmake_minimum_required(VERSION 3.20.0)
find_package(Zephyr REQUIRED HINTS $ENV{ZEPHYR_BASE})
project(LCC-Tortoise)

# Bring in the LCC library
#set(LIBLCC_ENABLE_STATIC_CONTEXT ON)
#add_subdirectory(TrainUtils/LCC)

# Zephyr does not want to play with third party libraries nicely:
# https://github.com/zephyrproject-rtos/zephyr/issues/8439
# So we do the highly annoying thing here of re-creating part of the liblcc cmake file
# in order to bring in all of the sources that we need
include(TrainUtils/LCC/lcc-version)

file(GLOB lcc-sources
    TrainUtils/LCC/*.c
    TrainUtils/LCC/*.h
    TrainUtils/DCC/*.h
    TrainUtils/DCC/*.c
)

target_sources(app PRIVATE 
	src/main.c 
	src/tortoise.c 
	src/lcc-tortoise-state.c
	src/dcc-decode.c
	src/power-handler.c
	src/firmware_upgrade.c
	${lcc-sources}
)
target_include_directories(app PRIVATE
	${CMAKE_CURRENT_SOURCE_DIR}/TrainUtils/LCC
	${CMAKE_CURRENT_BINARY_DIR}/TrainUtils/LCC
	${CMAKE_CURRENT_SOURCE_DIR}/TrainUtils/DCC
)


string(REPLACE "." ";" VERSION_LIST ${LIBLCC_VERSION})
list(GET VERSION_LIST 0 LCC_VERSION_MAJOR)
list(GET VERSION_LIST 1 LCC_VERSION_MINOR)
list(GET VERSION_LIST 2 LCC_VERSION_PATCH)
target_compile_definitions(app PRIVATE
    LIBLCC_BUILD
    LIBLCC_MAJOR=${LCC_VERSION_MAJOR}
    LIBLCC_MINOR=${LCC_VERSION_MINOR}
    LIBLCC_MICRO=${LCC_VERSION_PATCH}
    LIBLCC_HAS_CONFIG_H
)
set(LIBLCC_DEBUG 0)
set(LIBLCC_ENABLE_STATIC_CONTEXT 1)
set(LIBLCC_EVENT_LIST_STATIC_SIZE 20)
configure_file( TrainUtils/LCC/lcc-config.h.cmake TrainUtils/LCC/lcc-config.h )
```

## prj.conf
```kconfig
CONFIG_SERIAL=y
CONFIG_SPI=y
CONFIG_SYS_CLOCK_TICKS_PER_SEC=100000
CONFIG_COUNTER=y
CONFIG_GPIO=y
CONFIG_LOG=y
CONFIG_CONSOLE=y
CONFIG_MCUBOOT_GENERATE_UNSIGNED_IMAGE=y
CONFIG_BOOTLOADER_MCUBOOT=y
CONFIG_MCUBOOT_IMGTOOL_SIGN_VERSION="0.3.0"
CONFIG_MCUBOOT_BOOTUTIL_LIB=y
CONFIG_ARM_MPU=y
# CONFIG_INIT_ARCH_HW_AT_BOOT is not set
CONFIG_POLL=y
CONFIG_FLASH=y
CONFIG_CAN=y
CONFIG_UART_CONSOLE=y
CONFIG_PINCTRL_DYNAMIC=y
CONFIG_CONSOLE_SUBSYS=y
CONFIG_CONSOLE_GETLINE=y
CONFIG_FLASH_MAP=y
CONFIG_ROM_END_OFFSET=0x1800
CONFIG_KERNEL_BIN_NAME="lcc-tortoise8"
```

## src/main.c
```c
/*
 * SPDX-License-Identifier: GPL-2.0
 */

#include <stdio.h>
#include <stdlib.h>
#include <assert.h>
#include <zephyr/kernel.h>
#include <zephyr/drivers/gpio.h>
#include <zephyr/drivers/can.h>
#include <zephyr/drivers/eeprom.h>
#include <zephyr/storage/flash_map.h>
#include <zephyr/device.h>
#include <zephyr/sys/reboot.h>
#include <zephyr/console/console.h>
#include "dcc-decode-stm32.h"

#include "lcc-tortoise-state.h"
#include "tortoise.h"
#include "tortoise-cdi.h"
#include "power-handler.h"
#include "firmware_upgrade.h"

#include "lcc.h"
#include "lcc-common.h"
#include "lcc-event.h"
#include "lcc-memory.h"

#include "dcc-decoder.h"
#include "dcc-packet-parser.h"

/*
 * Address Space / storage information
 * 253 = basic config space.  This is stored in RAM during run-time.
 *   If it changes, it is written to the config_partition location
 * 251 = node name/description.  This is stored in the global_partition
 *
 * LCC ID is stored in the lcc_partition.  This partition is effectively readonly,
 * it should never be overwritten as it is possible that writing to it might occur
 * at a bad time causing the LCC ID to be lost.
 *
 * The base event ID(when the system is reset) is stored in the global_partition.
 * This is for the LCC specification that when a node is reset to factory defaults,
 * the eventIDs need to not repeat.
 */

struct global_config_data {
	char node_name[64];
	char node_description[64];
	uint64_t base_event_id;
};

const struct device *const can_dev = DEVICE_DT_GET(DT_CHOSEN(zephyr_canbus));
static struct lcc_can_frame lcc_rx;
static struct global_config_data global_config;

static struct gpio_callback blue_button_cb_data;
static struct gpio_callback gold_button_cb_data;

K_THREAD_STACK_DEFINE(tx_stack, 512);
struct k_thread tx_thread_data;
k_tid_t tx_thread_tid;
CAN_MSGQ_DEFINE(rx_msgq, 55);
CAN_MSGQ_DEFINE(tx_msgq, 12);

char *state_to_str(enum can_state state)
{
	switch (state) {
	case CAN_STATE_ERROR_ACTIVE:
		return "error-active";
	case CAN_STATE_ERROR_WARNING:
		return "error-warning";
	case CAN_STATE_ERROR_PASSIVE:
		return "error-passive";
	case CAN_STATE_BUS_OFF:
		return "bus-off";
	case CAN_STATE_STOPPED:
		return "stopped";
	default:
		return "unknown";
	}
}

static void can_frame_send_thread(void *unused1, void *unused2, void *unused3)
{
	static struct can_frame tx_frame;
	struct can_bus_err_cnt err_cnt = {0, 0};
	enum can_state state;

	while(1){
		if(k_msgq_get(&tx_msgq, &tx_frame, K_FOREVER) == 0){
			printf("Send frame 0x%08X\n", tx_frame.id);

			int err = can_get_state(can_dev, &state, &err_cnt);
			if(err != 0){
				printf("Can't get CAN state\n");
				continue;
			}

			if(state == CAN_STATE_BUS_OFF){
				printf("CAN bus off, dropping packet\n");
				continue;
			}

			int stat = can_send(can_dev, &tx_frame, K_FOREVER, NULL, NULL );
			if(stat < 0){
				printf("Unable to send: %d\n", stat);
			}
		}
	}
}

static int lcc_write_cb(struct lcc_context*, struct lcc_can_frame* lcc_frame){
	static struct can_frame zephyr_can_frame_tx;
	memset(&zephyr_can_frame_tx, 0, sizeof(zephyr_can_frame_tx));
	zephyr_can_frame_tx.id = lcc_frame->can_id;
	zephyr_can_frame_tx.dlc = lcc_frame->can_len;
	zephyr_can_frame_tx.flags = CAN_FRAME_IDE;
	memcpy(zephyr_can_frame_tx.data, lcc_frame->data, 8);

	if(k_msgq_put(&tx_msgq, &zephyr_can_frame_tx, K_NO_WAIT) < 0){
		return LCC_ERROR_TX;
	}

	return LCC_OK;
}

static void incoming_event(struct lcc_context* ctx, uint64_t event_id){
	for(int x = 0; x < 8; x++){
		tortoise_incoming_event(&lcc_tortoise_state.tortoises[x], event_id);
	}
}

static void init_can_txrx(){
	const struct can_filter filter = {
			.flags = CAN_FILTER_IDE,
			.id = 0x0,
			.mask = 0
	};
	int filter_id;

	filter_id = can_add_rx_filter_msgq(can_dev, &rx_msgq, &filter);
	printf("Filter ID: %d\n", filter_id);

	tx_thread_tid = k_thread_create(&tx_thread_data,
				tx_stack,
				K_THREAD_STACK_SIZEOF(tx_stack),
				can_frame_send_thread, NULL, NULL, NULL,
				0, 0,
				K_NO_WAIT);
	if (!tx_thread_tid) {
		printf("ERROR spawning tx thread\n");
	}
}

/**
 * Load the tortoise settings.
 *
 * @return 0 if settings were loaded, 1 if they were not, 2 if settings are blank
 */
static int load_tortoise_settings(){
	int ret = 0;
	uint8_t tortoise_positions[8 * 4];

	const struct flash_area* storage_area = NULL;
	int id = FIXED_PARTITION_ID(config_partition);
	const struct flash_area* location_area = NULL;
	int id2 = FIXED_PARTITION_ID(location_partition);

	if(flash_area_open(id, &storage_area) < 0){
		return 1;
	}

	if(flash_area_open(id2, &location_area) < 0){
		return 1;
	}

	if(flash_area_read(storage_area, 0, &lcc_tortoise_state.tortoise_config, sizeof(lcc_tortoise_state.tortoise_config)) < 0){
		return 1;
	}

	if(flash_area_read(location_area, 0, tortoise_positions, sizeof(tortoise_positions)) < 0){
		return 1;
	}

	// Check to see if the first 8 bytes are 0xFF.  If so, we assume the data is uninitialized
	const uint8_t mem[8] = {
			0xFF, 0xFF, 0xFF, 0xFF,
			0xFF, 0xFF, 0xFF, 0xFF
	};
	if(memcmp(lcc_tortoise_state.tortoise_config, mem, 8) == 0){
		ret = 2;
		goto out;
	}

	for(int x = 0; x < 8; x++){
		if(lcc_tortoise_state.tortoise_config[x].startup_control == STARTUP_LAST_POSITION){
			// Figure out the last position
			int count_agree_normal = 0;
			int count_agree_reverse = 0;

			for(int y = 0; y < 4; y++){
				int offset_val = tortoise_positions[x + (8 * y)];
				if(offset_val == 0){
					count_agree_normal++;
				}else if(offset_val == 1){
					count_agree_reverse++;
				}
			}

			if(count_agree_normal > count_agree_reverse){
				lcc_tortoise_state.tortoise_config[x].last_known_pos = POSITION_NORMAL;
			}else if(count_agree_reverse > count_agree_normal){
				lcc_tortoise_state.tortoise_config[x].last_known_pos = POSITION_REVERSE;
			}
		}

		tortoise_init_startup_position(&lcc_tortoise_state.tortoises[x]);
	}

out:
	flash_area_close(storage_area);
	flash_area_close(location_area);
	return ret;
}

void mem_address_space_information_query(struct lcc_memory_context* ctx, uint16_t alias, uint8_t address_space){
	if(address_space == 251){
		lcc_memory_respond_information_query(ctx, alias, 1, address_space, 64 + 64, 0, 0);
	}else if(address_space == 253){
		// basic config space
		// 32 bytes * 8 tortoises
		uint32_t upper_address = sizeof(struct tortoise_config) * 8;
		lcc_memory_respond_information_query(ctx, alias, 1, address_space, upper_address, 0, 0);
	}else{
		// This memory space does not exist: return an error
		lcc_memory_respond_information_query(ctx, alias, 0, address_space, 0, 0, 0);
	}
}

void mem_address_space_read(struct lcc_memory_context* ctx, uint16_t alias, uint8_t address_space, uint32_t starting_address, uint8_t read_count){
	if(address_space == 251){
		// This space is what we use for node name/description
		uint8_t* buffer = global_config.node_name + starting_address;

		if(starting_address + read_count > 128){
			// trying to read too much memory
			lcc_memory_respond_read_reply_fail(ctx, alias, address_space, 0, 0, NULL);
			return;
		}

		lcc_memory_respond_read_reply_ok(ctx, alias, address_space, starting_address, buffer, read_count);
	  }else if(address_space == 253){
		// Basic config space
		if(starting_address + read_count > (sizeof(lcc_tortoise_state.tortoise_config))){
		  // trying to read too much memory
		  lcc_memory_respond_read_reply_fail(ctx, alias, address_space, 0, 0, NULL);
		  return;
		}

	    uint8_t* config_as_u8 = (uint8_t*)lcc_tortoise_state.tortoise_config;

	    lcc_memory_respond_read_reply_ok(ctx, alias, address_space, starting_address, config_as_u8 + starting_address, read_count);
	  }
}

int save_configs_to_flash(){
	int ret = 0;

	const struct flash_area* storage_area = NULL;
	int id = FIXED_PARTITION_ID(config_partition);

	if(flash_area_open(id, &storage_area) < 0){
		return 1;
	}

	ret = flash_area_erase(storage_area, 0, sizeof(lcc_tortoise_state.tortoise_config));
	if(ret){
		goto out;
	}

	if(flash_area_write(storage_area, 0, &lcc_tortoise_state.tortoise_config, sizeof(lcc_tortoise_state.tortoise_config)) < 0){
		ret = 1;
	}

out:
	flash_area_close(storage_area);
	if(ret){
		printf("Unable to save configs to flash\n");
	}

	powerhandle_check_if_save_required();
	return ret;
}

static int save_global_config(){
	const struct flash_area* storage_area = NULL;
	int id = FIXED_PARTITION_ID(global_partition);
	int ret = 0;

	if(flash_area_open(id, &storage_area) < 0){
		return 1;
	}

	ret = flash_area_erase(storage_area, 0, sizeof(global_config));
	if(ret){
		goto out;
	}

	if(flash_area_write(storage_area, 0, &global_config, sizeof(global_config)) < 0){
		ret = 1;
	}

out:
	flash_area_close(storage_area);
	if(ret){
		printf("Unable to save global config to flash\n");
	}

	return ret;
}

void mem_address_space_write(struct lcc_memory_context* ctx, uint16_t alias, uint8_t address_space, uint32_t starting_address, void* data, int data_len){
	  if(address_space == 251){
		  if((starting_address + data_len) > 128){
				lcc_memory_respond_write_reply_fail(ctx, alias, address_space, starting_address, 0, NULL);
				return;
		  }

		  uint8_t* global_config_raw = &global_config;
		  memcpy(global_config_raw + starting_address, data, data_len);
		  save_global_config();

		  lcc_memory_respond_write_reply_ok(ctx, alias, address_space, starting_address);
	  }else if(address_space == 253){
		  if((starting_address + data_len) > sizeof(lcc_tortoise_state.tortoise_config)){
			    lcc_memory_respond_write_reply_fail(ctx, alias, address_space, starting_address, 0, NULL);
			    return;
		  }
		  uint8_t* buffer_u8 = (uint8_t*)lcc_tortoise_state.tortoise_config;

		  memcpy(buffer_u8 + starting_address, data, data_len);

	    // Write out to non-volatile memory
	    save_configs_to_flash();

	    lcc_memory_respond_write_reply_ok(ctx, alias, address_space, starting_address);

	    // Re-init the events we consume
	    {
	    	struct lcc_event_context* evt_ctx = lcc_context_get_event_context(lcc_tortoise_state.lcc_context);
			lcc_event_clear_events(evt_ctx, LCC_EVENT_CONTEXT_CLEAR_EVENTS_CONSUMED);
			for(int x = 0; x < 8; x++){
				uint64_t* events_consumed = tortoise_events_consumed(&lcc_tortoise_state.tortoises[x]);
				lcc_event_add_event_consumed(evt_ctx, events_consumed[0]);
				lcc_event_add_event_consumed(evt_ctx, events_consumed[1]);
			}
	    }
	  }else{
	    lcc_memory_respond_write_reply_fail(ctx, alias, address_space, starting_address, 0, NULL);
	    return;
	  }
}

static void reboot(struct lcc_memory_context* ctx){
	sys_reboot(SYS_REBOOT_COLD);
}

static void factory_reset(struct lcc_memory_context* ctx){
	memset(&lcc_tortoise_state.tortoise_config, 0, sizeof(lcc_tortoise_state.tortoise_config));
	uint64_t new_base_eventid = global_config.base_event_id + 16;
	memset(&global_config, 0, sizeof(global_config));
	global_config.base_event_id = new_base_eventid;

	for(int x = 0; x < 8; x++){
		lcc_tortoise_state.tortoise_config[x].BE_accessory_number = __builtin_bswap16(x + 1);
		lcc_tortoise_state.tortoise_config[x].startup_control = STARTUP_NORMAL;
		lcc_tortoise_state.tortoise_config[x].BE_event_id_closed = __builtin_bswap64(new_base_eventid++);
		lcc_tortoise_state.tortoise_config[x].BE_event_id_thrown = __builtin_bswap64(new_base_eventid++);
	}

	save_configs_to_flash();
	save_global_config();
}

static enum lcc_consumer_state query_consumer_state(struct lcc_context* ctx, uint64_t event_id){
	for(int x = 0; x < 8; x++){
		uint64_t* events = tortoise_events_consumed(&lcc_tortoise_state.tortoises[x]);

		if(event_id == events[0]){
			// reverse/off
			if(lcc_tortoise_state.tortoises[x].current_position == POSITION_REVERSE){
				return LCC_CONSUMER_VALID;
			}
			return LCC_CONSUMER_INVALID;
		}else if(event_id == events[1]){
			// normal/on
			if(lcc_tortoise_state.tortoises[x].current_position == POSITION_NORMAL){
				return LCC_CONSUMER_VALID;
			}
			return LCC_CONSUMER_INVALID;
		}
	}

	return LCC_CONSUMER_UNKNOWN;
}

static void accy_cb(struct dcc_packet_parser* parser, uint16_t accy_number, enum dcc_accessory_direction accy_dir){
	for(int x = 0; x < 8; x++){
		tortoise_incoming_accy_command(&lcc_tortoise_state.tortoises[x],
				accy_number,
				accy_dir == ACCESSORY_NORMAL ? POSITION_NORMAL : POSITION_REVERSE);
	}
}

static void incoming_dcc(struct dcc_decoder* decoder, const uint8_t* packet_bytes, int len){
	static int count = 0;
	static int idle_packet_count = 0;

	count++;

	if(len == 3 &&
			packet_bytes[0] == 0xFF &&
			packet_bytes[1] == 0x00 &&
			packet_bytes[2] == 0xFF){
		// Idle packet
		idle_packet_count++;
	}

	// TODO do we periodically blink an LED here?
}

static uint64_t load_lcc_id(){
	uint64_t ret = 0;

	const struct flash_area* lcc_storage_area = NULL;
	int id = FIXED_PARTITION_ID(lcc_partition);

	if(flash_area_open(id, &lcc_storage_area) < 0){
		return 1;
	}

	if(flash_area_read(lcc_storage_area, 0, &ret, sizeof(ret)) < 0){
		return 1;
	}

	// Check to see if the first 8 bytes are 0xFF.  If so, we assume the data is uninitialized
	const uint8_t mem[8] = {
			0xFF, 0xFF, 0xFF, 0xFF,
			0xFF, 0xFF, 0xFF, 0xFF
	};
	if(memcmp(&ret, mem, 8) == 0){
		uint64_t new_id = 0;
		int valid = 0;

		console_getline_init();

		while(!valid){
			printf("LCC ID blank!  Please input LCC ID as a single hex string followed by enter:\n");
			char id_buffer[32];
			char* console_data = console_getline();
			printf("console line: %s\n", console_data);
			new_id = strtoull(console_data, NULL, 16);
			lcc_node_id_to_dotted_format(new_id, id_buffer, sizeof(id_buffer));

			printf("New node ID will be %s.  Type 'y'<ENTER> to accept\n", id_buffer);
			console_data = console_getline();
			printf("response: %s\n", console_data);
			if(console_data[0] == 'y'){
				valid = 1;
				ret = new_id;
			}
		}

		flash_area_write(lcc_storage_area, 0, &ret, sizeof(ret));

		global_config.base_event_id = ret << 16;
		// Do a 'factory reset' to make sure everything is initialized
		factory_reset(NULL);
	}

out:
	flash_area_close(lcc_storage_area);
	return ret;
}

static void load_global_config(){
	const struct flash_area* storage_area = NULL;
	int id = FIXED_PARTITION_ID(global_partition);
	int ret = 0;

	if(flash_area_open(id, &storage_area) < 0){
		return 1;
	}

	if(flash_area_read(storage_area, 0, &global_config, sizeof(global_config)) < 0){
		ret = 1;
	}

out:
	flash_area_close(storage_area);
	if(ret){
		printf("Unable to load global config\n");
	}

	return ret;
}

static void blue_button_pressed(const struct device *dev, struct gpio_callback *cb,
		    uint32_t pins)
{
	printk("Blue Button pressed at %" PRIu32 "\n", k_cycle_get_32());
}

static void gold_button_pressed(const struct device *dev, struct gpio_callback *cb,
		    uint32_t pins)
{
	printk("Gold Button pressed at %" PRIu32 "\n", k_cycle_get_32());
}

static void main_loop(){
	struct k_poll_event poll_data[2];
	struct k_timer alias_timer;
	struct can_frame rx_frame;
	struct lcc_context* ctx = lcc_tortoise_state.lcc_context;

	k_poll_event_init(&poll_data[0],
			K_POLL_TYPE_MSGQ_DATA_AVAILABLE,
			K_POLL_MODE_NOTIFY_ONLY,
			&rx_msgq);
	k_poll_event_init(&poll_data[1],
			K_POLL_TYPE_MSGQ_DATA_AVAILABLE,
			K_POLL_MODE_NOTIFY_ONLY,
			&dcc_decode_ctx.readings);

	k_timer_init(&alias_timer, NULL, NULL);
	k_timer_start(&alias_timer, K_MSEC(250), K_NO_WAIT);

	while (1) {
		int rc = k_poll(poll_data, ARRAY_SIZE(poll_data), K_MSEC(250));
		if(poll_data[0].state == K_POLL_STATE_MSGQ_DATA_AVAILABLE){
			// Receive a CAN frame if there is any
			while(k_msgq_get(&rx_msgq, &rx_frame, K_NO_WAIT) == 0){
				memset(&lcc_rx, 0, sizeof(lcc_rx));
				lcc_rx.can_id = rx_frame.id;
				lcc_rx.can_len = rx_frame.dlc;
				memcpy(lcc_rx.data, rx_frame.data, 8);

				printf("Incoming frame: %x\n", lcc_rx.can_id);
				lcc_context_incoming_frame(ctx, &lcc_rx);
			}
			poll_data[0].state = K_POLL_STATE_NOT_READY;
		}else if(poll_data[1].state == K_POLL_STATE_MSGQ_DATA_AVAILABLE){
			uint32_t timediff;
			while(k_msgq_get(&dcc_decode_ctx.readings, &timediff, K_NO_WAIT) == 0){
				if(dcc_decoder_polarity_changed(dcc_decode_ctx.dcc_decoder, timediff) == 1){
					dcc_decoder_pump_packet(dcc_decode_ctx.dcc_decoder);
				}
			}
			poll_data[1].state = K_POLL_STATE_NOT_READY;
		}

		if(k_timer_status_get(&alias_timer) > 0 &&
		    lcc_context_current_state(ctx) == LCC_STATE_INHIBITED){
		    int stat = lcc_context_claim_alias(ctx);
		    if(stat == LCC_ERROR_ALIAS_TX_NOT_EMPTY){
		    	k_timer_start(&alias_timer, K_MSEC(500), K_NO_WAIT);
		    	continue;
		    }
		    if(stat != LCC_OK){
		      // If we were unable to claim our alias, we need to generate a new one and start over
		      lcc_context_generate_alias(ctx);
		    }else{
		      printf("Claimed alias %X\n", lcc_context_alias(ctx) );

				// initialize our low power handling.
				// We do this right after we have an alias, since logically nothing will have changed
				// until we are actually able to process commands from some other device on the network.
				powerhandle_init();
				powerhandle_check_if_save_required();
		    }
		}
	}
}

static int tx_queue_size_cb(struct lcc_context*){
	return k_msgq_num_free_get(&tx_msgq);
}

int main(void)
{
	int ret;

	// Sleep for a bit before we start to allow power to become stable.
	// This is probably not needed, but it shouldn't hurt.
	// This will also give other devices on the network a chance to come up.
	k_sleep(K_MSEC(250));

	_Static_assert(sizeof(struct tortoise_config) == 32);

	if(lcc_tortoise_state_init() < 0){
		// This uses only static data to initialize, so this should never happen.
		printf("error: unable to initialize! %d\n", __LINE__);
		return 0;
	}

	dcc_decoder_init(&dcc_decode_ctx);

	// Load the tortoise settings, and set the outputs to the correct valu depending on their startup settings
	int tortoise_load_stat = load_tortoise_settings();
	if(tortoise_load_stat == 1){
		printf("Error: Unable to load settings!\n");
		return 1;
	}else if(tortoise_load_stat == 2){
		printf("Chip is blank, initializing to default values...\n");
		factory_reset(NULL);
	}
	for(int x = 0; x < 8; x++){
		tortoise_set_position(&lcc_tortoise_state.tortoises[x], lcc_tortoise_state.tortoises[x].current_position);
	}

	if (!device_is_ready(can_dev)) {
		printf("CAN: Device %s not ready.\n", can_dev->name);
		return 0;
	}

	ret = can_start(can_dev);
	if(ret != 0){
		printf("Can't start CAN\n");
		return 0;
	}

	init_can_txrx();

	lcc_tortoise_state.lcc_context = lcc_context_new();
	if(lcc_tortoise_state.lcc_context == NULL){
		// This uses only static data to initialize, so this should never happen.
		printf("error: unable to initialize! %d\n", __LINE__);
		return -1;
	}

	dcc_decoder_set_packet_callback(dcc_decode_ctx.dcc_decoder, incoming_dcc);
	dcc_decoder_set_packet_parser(dcc_decode_ctx.dcc_decoder, dcc_decode_ctx.packet_parser);

	uint64_t lcc_id = load_lcc_id();
	load_global_config();
	struct lcc_context* ctx = lcc_tortoise_state.lcc_context;
	lcc_context_set_unique_identifer( ctx,
			lcc_id );
	lcc_context_set_simple_node_information(ctx,
			"Snowball Creek",
			"Tortoise-8",
			"P3",
			"0.3");

	lcc_context_set_write_function( ctx, lcc_write_cb, tx_queue_size_cb );
	struct lcc_event_context* evt_ctx = lcc_event_new(ctx);

	lcc_event_set_incoming_event_function(evt_ctx, incoming_event);
	lcc_event_add_event_consumed_query_fn(evt_ctx, query_consumer_state);

	for(int x = 0; x < 8; x++){
		uint64_t* events_consumed = tortoise_events_consumed(&lcc_tortoise_state.tortoises[x]);
		lcc_event_add_event_consumed(evt_ctx, events_consumed[0]);
		lcc_event_add_event_consumed(evt_ctx, events_consumed[1]);
	}

	lcc_datagram_context_new(ctx);
	struct lcc_memory_context* mem_ctx = lcc_memory_new(ctx);
	lcc_memory_set_cdi(mem_ctx, cdi, sizeof(cdi), 0);
	lcc_memory_set_memory_functions(mem_ctx,
	    mem_address_space_information_query,
	    mem_address_space_read,
	    mem_address_space_write);
	lcc_memory_set_reboot_function(mem_ctx, reboot);
	lcc_memory_set_factory_reset_function(mem_ctx, factory_reset);

	firmware_upgrade_init(ctx);

	int stat = lcc_context_generate_alias( ctx );
	if(stat < 0){
		printf("error: can't gen alias: %d\n", stat);
		return 0;
	}

	dcc_packet_parser_set_accessory_cb(dcc_decode_ctx.packet_parser, accy_cb);

	// Init our callbacks
	gpio_init_callback(&gold_button_cb_data, gold_button_pressed, BIT(lcc_tortoise_state.gold_button.pin));
	gpio_add_callback(lcc_tortoise_state.gold_button.port, &gold_button_cb_data);
	gpio_init_callback(&blue_button_cb_data, blue_button_pressed, BIT(lcc_tortoise_state.blue_button.pin));
	gpio_add_callback(lcc_tortoise_state.blue_button.port, &blue_button_cb_data);

	main_loop();

	return 0;
}
```

## src/dcc-decode-stm32.c
```c
/*
 * dcc-decode.c
 *
 *  Created on: Jun 17, 2024
 *      Author: robert
 */
#include <stdint.h>
#include <zephyr/kernel.h>
#include <zephyr/drivers/gpio.h>
#include <stm32g0xx_ll_tim.h>
#include <stm32g0xx_ll_gpio.h>

#include "dcc-decoder.h"
#include "dcc-packet-parser.h"

#include "dcc-decode-stm32.h"
#include "dcc-decoder.h"
#include "lcc-tortoise-state.h"

static uint32_t readings[1000];
static uint32_t pos = 0;
static uint32_t num_sr = 0;
static uint32_t num_bad_bits = 0;

struct dcc_decoder_stm32 dcc_decode_ctx;

static void debug_isr_halfbit(uint32_t cycle_time_usec){
	readings[pos++] = cycle_time_usec;
	if(pos == (sizeof(readings)/sizeof(readings[0]))){
		pos = 0;
//		printf("readings:\n");
		int num_readings_good = 0;
		int num_readings_bad = 0;
		for(int x = 0; x < sizeof(readings)/sizeof(readings[0]); x++){
			printf("%lu,", readings[x]);
			if(readings[x] >= 52 && readings[x] <= 64){
				num_readings_good++;
//				printf("1");
			}else if(readings[x] >= 90 && readings[x] <= 200){
				num_readings_good++;
//				printf("0");
			}else{
				num_readings_bad++;
//				printf("-");
			}
		}
		printf("good: %d bad: %d over: %d\n", num_readings_good, num_readings_bad, num_sr);
		num_sr = 0;
	}
}

static void debug_isr_fullbit(uint32_t cycle_time_usec){
	readings[pos++] = cycle_time_usec;
	if(pos == (sizeof(readings)/sizeof(readings[0]))){
		pos = 0;
//		printf("readings:\n");
		int num_readings_good = 0;
		int num_readings_bad = 0;
		for(int x = 0; x < sizeof(readings)/sizeof(readings[0]); x++){
			printf("%lu,", readings[x]);
			if(readings[x] >= (52*2) && readings[x] <= (64*2)){
				num_readings_good++;
//				printf("1");
			}else if(readings[x] >= (90*2) && readings[x] <= (200*2)){
				num_readings_good++;
//				printf("0");
			}else{
				num_readings_bad++;
//				printf("-");
			}
		}
		printf("good: %d bad: %d over: %d\n", num_readings_good, num_readings_bad, num_sr);
		num_sr = 0;
	}
}

ISR_DIRECT_DECLARE(tim2_irq_fn)
{
	ISR_DIRECT_HEADER();

	if (LL_TIM_IsActiveFlag_CC1(TIM2))
	{
		const uint32_t value = LL_TIM_IC_GetCaptureCH1(TIM2); // read value and clear the IRQ by reading CCR1
		// Timer should keep on running here.
		// We need to rebase the time on the counter such that 0 is the time that the value changed.
		// Since our IRQ doesn't happen immediately, calculate the new difference and set the timer
		// to that value.
		uint32_t new_value = LL_TIM_GetCounter(TIM2) - value;
		LL_TIM_SetCounter(TIM2, new_value);
		uint32_t sr = TIM2->SR;
		int overcap = sr & (0x01 << 9);
		if(overcap){
			num_sr++;
			sr &= ~(0x01 << 9);
			TIM2->SR = sr;
		}

		k_msgq_put(&dcc_decode_ctx.readings, &value, K_NO_WAIT);
	}

	ISR_DIRECT_FOOTER(1);
	return 1;
}

static int timer2_init(){
	// First enable the clock to the timer
	__HAL_RCC_TIM2_CLK_ENABLE();

	k_sleep(K_MSEC(1));

	// Set prescaler properly so we count every 1us
	LL_TIM_SetPrescaler(TIM2, 32);

	TIM2->CR1 = 0;
	TIM2->EGR = TIM_EGR_UG;

	// Steps are from RM0444, section 22.3.5
	// Step 1: Set TI1SEL bits to 0
	TIM2->TISEL = 0;
	// 2: select active input: TIM2_CCR1 must be linked to T1 input
	TIM2->CCMR1 = 1 | (0x2 << 4); // seems okay??
//	TIM2->CCMR1 = 1 | (0x3 << 4);
	// 3: set filter duration in CCMR1
	// 4: Set polarity of transitions.  We want both for DCC
	TIM2->CCER = 0xb; // both polarity
//	TIM2->CCER = 0x1; // rising only
	// 5: set input prescaler.  Leave at default values
	// 6: enable capture from counter into capture register
	// 7: enable the interrupt
	LL_TIM_EnableIT_CC1(TIM2);
	LL_TIM_EnableCounter(TIM2);

	return 0;
}

int dcc_decoder_init(struct dcc_decoder_stm32* decoder){
	k_msgq_init(&decoder->readings,
			decoder->readings_data,
			sizeof(uint32_t),
			ARRAY_SIZE(decoder->readings_data));

	timer2_init();

	// Configure the pin input for timer 2
	LL_GPIO_SetPinMode(GPIOA, LL_GPIO_PIN_15, LL_GPIO_MODE_ALTERNATE);
	LL_GPIO_SetPinPull(GPIOA, LL_GPIO_PIN_15, LL_GPIO_PULL_DOWN);
	LL_GPIO_SetAFPin_8_15(GPIOA, LL_GPIO_PIN_15, LL_GPIO_AF_2);

	// Custom IRQ handler for timer 2
	IRQ_DIRECT_CONNECT(TIM2_IRQn, 0, tim2_irq_fn, 0);
	irq_enable(TIM2_IRQn);

	// Configure and start timer2
	int res = timer2_init();
	if(res != 0){
		printf("can't init: %d\n", res);
	}

	decoder->packet_parser = dcc_packet_parser_new();
	if(decoder->packet_parser == NULL){
		// This uses only static data to initialize, so this should never happen.
		printf("error: unable to initialize! %d\n", __LINE__);
		return -1;
	}

	decoder->dcc_decoder = dcc_decoder_new(DCC_DECODER_IRQ_BOTH);
	if(decoder->dcc_decoder == NULL){
		// This uses only static data to initialize, so this should never happen.
		printf("error: unable to initialize! %d\n", __LINE__);
		return -1;
	}

	return 0;
}
```

## src/dcc-decode-stm32.h
```c
/*
 * dcc-decode.h
 *
 *  Created on: Jun 17, 2024
 *      Author: robert
 */

#ifndef LCC_TORTOISE_ZEPHYR_SRC_DCC_DECODE_H_
#define LCC_TORTOISE_ZEPHYR_SRC_DCC_DECODE_H_

#include <zephyr/kernel.h>

struct dcc_decoder;
struct dcc_packet_parser;

struct dcc_decoder_stm32{
	struct k_msgq readings;
	uint32_t readings_data[128];
	struct dcc_decoder* dcc_decoder;
	struct dcc_packet_parser* packet_parser;
	struct gpio_callback dcc_cb_data;
};

extern struct dcc_decoder_stm32 dcc_decode_ctx;

int dcc_decoder_init(struct dcc_decoder_stm32* decoder);

#endif /* LCC_TORTOISE_ZEPHYR_SRC_DCC_DECODE_H_ */
```

## src/dcc-decode.c
```c
/*
 * dcc-decode.c
 *
 *  Created on: Jun 17, 2024
 *      Author: robert
 */
#include <stdint.h>
#include <zephyr/kernel.h>
#include <zephyr/drivers/gpio.h>
#include "dcc-decode.h"
#include "lcc-tortoise-state.h"
#include "dcc-decoder.h"

static void polarity_change(int value){
	const uint32_t curr_cycle = k_cycle_get_32();
	const uint32_t cycle_time_usec = k_cyc_to_us_floor32(curr_cycle - lcc_tortoise_state.prev_cycle);
	lcc_tortoise_state.prev_cycle = curr_cycle;

	gpio_pin_set_dt(&lcc_tortoise_state.gold_led, value);

	dcc_decoder_polarity_changed(lcc_tortoise_state.dcc_decoder, cycle_time_usec);
}

void dcc_decoder_thread(void*, void*, void*){
	int prev = 0;

	while(1){
		int state = gpio_pin_get_dt(&lcc_tortoise_state.dcc_signal);
		if( state != prev ){
			prev = state;
			polarity_change(state);
		}
		k_yield();
	}
}
```

## src/dcc-decode.h
```c
/*
 * dcc-decode.h
 *
 *  Created on: Jun 17, 2024
 *      Author: robert
 */

#ifndef LCC_TORTOISE_ZEPHYR_SRC_DCC_DECODE_H_
#define LCC_TORTOISE_ZEPHYR_SRC_DCC_DECODE_H_

void dcc_decoder_thread(void*, void*, void*);

#endif /* LCC_TORTOISE_ZEPHYR_SRC_DCC_DECODE_H_ */
```

## src/firmware_upgrade.c
```c
/*
 * firmware_upgrade.c
 *
 *  Created on: Aug 14, 2024
 *      Author: robert
 */


#include <zephyr/storage/flash_map.h>
#include <zephyr/sys/reboot.h>
#include <stdio.h>

#include "firmware_upgrade.h"
#include "lcc-common.h"
#include "lcc-firmware-upgrade.h"

static const struct flash_area* slot1 = NULL;

static void firmware_upgrade_start(struct lcc_firmware_upgrade_context* ctx){
	int ret = flash_area_erase(slot1, 0, slot1->fa_size);
	if( ret < 0){
		flash_area_close(slot1);
		slot1 = NULL;
		printf("flash erase bad\n");
	}

	printf("firmware upgrade start\n");
}

static void firmware_upgrade_incoming_data(struct lcc_firmware_upgrade_context* ctx, uint32_t starting_address, void* data, int data_len){
	if(!slot1){
		lcc_firmware_write_error(ctx, LCC_ERRCODE_PERMANENT, NULL);
		return;
	}

	int ret = flash_area_write(slot1, starting_address, data, data_len);
	if(ret == 0){
		printf("write ok\n");
		lcc_firmware_write_ok(ctx);
	}else{
		printf("write err: %d startring addr %d\n", ret, starting_address);
		lcc_firmware_write_error(ctx, LCC_ERRCODE_PERMANENT, NULL);
	}
}

static void firmware_upgrade_finished(struct lcc_firmware_upgrade_context* ctx){
	printf("firmware upgrade finished\n");
	sys_reboot(SYS_REBOOT_COLD);
}

int firmware_upgrade_init(struct lcc_context* ctx){
	struct lcc_firmware_upgrade_context* fwu_ctx = lcc_firmware_upgrade_new(ctx);

	lcc_firmware_upgrade_set_functions(fwu_ctx,
			firmware_upgrade_start,
			firmware_upgrade_incoming_data,
			firmware_upgrade_finished);

	int id = FIXED_PARTITION_ID(slot1_partition);

	return flash_area_open(id, &slot1);
}
```

## src/firmware_upgrade.h
```c
/*
 * firmware_upgrade.h
 *
 *  Created on: Aug 14, 2024
 *      Author: robert
 */

#ifndef LCC_TORTOISE_SRC_FIRMWARE_UPGRADE_H_
#define LCC_TORTOISE_SRC_FIRMWARE_UPGRADE_H_

struct lcc_context;

int firmware_upgrade_init(struct lcc_context*);


#endif /* LCC_TORTOISE_SRC_FIRMWARE_UPGRADE_H_ */
```

## src/lcc-tortoise-state.c
```c
/*
 * lcc-tortoise-state.c
 *
 *  Created on: May 19, 2024
 *      Author: robert
 */

#include <zephyr/kernel.h>
#include <zephyr/drivers/gpio.h>
#include <zephyr/drivers/counter.h>
#include <zephyr/drivers/pinctrl.h>
#include <zephyr/devicetree.h>

#include "lcc-tortoise-state.h"
#include "tortoise.h"
#include "dcc-decoder.h"

struct lcc_tortoise_state lcc_tortoise_state = {
		.green_led = GPIO_DT_SPEC_GET(DT_ALIAS(greenled), gpios),
		.blue_led = GPIO_DT_SPEC_GET(DT_ALIAS(blueled), gpios),
		.gold_led = GPIO_DT_SPEC_GET(DT_ALIAS(goldled), gpios),
		.blue_button = GPIO_DT_SPEC_GET(DT_NODELABEL(blue_switch), gpios),
		.gold_button = GPIO_DT_SPEC_GET(DT_NODELABEL(gold_switch), gpios),
		.tortoises = {
				{
						.gpios = {
								GPIO_DT_SPEC_GET_BY_IDX(DT_NODELABEL(tortoise0), gpios, 0),
								GPIO_DT_SPEC_GET_BY_IDX(DT_NODELABEL(tortoise0), gpios, 1)
						},
						.current_position = POSITION_REVERSE
				},
				{
						.gpios = {
								GPIO_DT_SPEC_GET_BY_IDX(DT_NODELABEL(tortoise1), gpios, 0),
								GPIO_DT_SPEC_GET_BY_IDX(DT_NODELABEL(tortoise1), gpios, 1)
						},
						.current_position = POSITION_REVERSE
				},
				{
						.gpios = {
								GPIO_DT_SPEC_GET_BY_IDX(DT_NODELABEL(tortoise2), gpios, 0),
								GPIO_DT_SPEC_GET_BY_IDX(DT_NODELABEL(tortoise2), gpios, 1)
						},
						.current_position = POSITION_REVERSE
				},
				{
						.gpios = {
								GPIO_DT_SPEC_GET_BY_IDX(DT_NODELABEL(tortoise3), gpios, 0),
								GPIO_DT_SPEC_GET_BY_IDX(DT_NODELABEL(tortoise3), gpios, 1)
						},
						.current_position = POSITION_REVERSE
				},
				{
						.gpios = {
								GPIO_DT_SPEC_GET_BY_IDX(DT_NODELABEL(tortoise4), gpios, 0),
								GPIO_DT_SPEC_GET_BY_IDX(DT_NODELABEL(tortoise4), gpios, 1)
						},
						.current_position = POSITION_REVERSE
				},
				{
						.gpios = {
								GPIO_DT_SPEC_GET_BY_IDX(DT_NODELABEL(tortoise5), gpios, 0),
								GPIO_DT_SPEC_GET_BY_IDX(DT_NODELABEL(tortoise5), gpios, 1)
						},
						.current_position = POSITION_REVERSE
				},
				{
						.gpios = {
								GPIO_DT_SPEC_GET_BY_IDX(DT_NODELABEL(tortoise6), gpios, 0),
								GPIO_DT_SPEC_GET_BY_IDX(DT_NODELABEL(tortoise6), gpios, 1)
						},
						.current_position = POSITION_REVERSE
				},
				{
						.gpios = {
								GPIO_DT_SPEC_GET_BY_IDX(DT_NODELABEL(tortoise7), gpios, 0),
								GPIO_DT_SPEC_GET_BY_IDX(DT_NODELABEL(tortoise7), gpios, 1)
						},
						.current_position = POSITION_REVERSE
				},
		}
};

static int init_led(const struct gpio_dt_spec* led){
	if (!gpio_is_ready_dt(led)) {
		return -1;
	}

	if(gpio_pin_configure_dt(led, GPIO_OUTPUT_INACTIVE) < 0){
		return -1;
	}

	return 0;
}

static int init_button(const struct gpio_dt_spec* button){
	if (!gpio_is_ready_dt(button)) {
		return -1;
	}

	if(gpio_pin_configure_dt(button, GPIO_INPUT) < 0){
		return -1;
	}

	if(gpio_pin_interrupt_configure_dt(button, GPIO_INT_EDGE_BOTH) < 0){
		return -1;
	}

	// TODO callbacks on button press

	return 0;
}

int lcc_tortoise_state_init(){
	if(init_led(&lcc_tortoise_state.green_led) < 0){
		return -1;
	}
	if(init_led(&lcc_tortoise_state.gold_led) < 0){
		return -1;
	}
	if(init_led(&lcc_tortoise_state.blue_led) < 0){
		return -1;
	}
	if(init_button(&lcc_tortoise_state.blue_button) < 0){
		return -1;
	}
//	if(init_button(&lcc_tortoise_state.gold_button) < 0){
//		return -1;
//	}

	lcc_tortoise_state.gpio_expander = DEVICE_DT_GET(DT_NODELABEL(gpio_expander));

	for(int x = 0; x < 8; x++){
		lcc_tortoise_state.tortoises[x].config = &lcc_tortoise_state.tortoise_config[x];

		if(tortoise_init(&lcc_tortoise_state.tortoises[x]) < 0){
			return -1;
		}
	}

	return 0;
}
```

## src/lcc-tortoise-state.h
```c
/*
 * lcc-tortoise-state.h
 *
 *  Created on: May 19, 2024
 *      Author: robert
 */

#ifndef LCC_TORTOISE_ZEPHYR_SRC_LCC_TORTOISE_STATE_H_
#define LCC_TORTOISE_ZEPHYR_SRC_LCC_TORTOISE_STATE_H_

#include <zephyr/drivers/gpio.h>
#include <zephyr/drivers/can.h>

#include "tortoise.h"
#include "dcc-decode-stm32.h"

struct lcc_context;
struct dcc_decoder;
struct dcc_packet_parser;

/**
 * The global state struct for our application
 */
struct lcc_tortoise_state{
	const struct gpio_dt_spec green_led;
	const struct gpio_dt_spec blue_led;
	const struct gpio_dt_spec gold_led;
	const struct gpio_dt_spec blue_button;
	const struct gpio_dt_spec gold_button;
	const struct gpio_dt_spec dcc_signal;
	struct tortoise_config tortoise_config[8];
	struct tortoise tortoises[8];

	struct lcc_context* lcc_context;
	const struct device* gpio_expander;
};

struct global_config{
	uint64_t device_id;
	uint8_t config_version;
};

extern struct lcc_tortoise_state lcc_tortoise_state;
extern struct global_config config;

int lcc_tortoise_state_init();


#endif /* LCC_TORTOISE_ZEPHYR_SRC_LCC_TORTOISE_STATE_H_ */
```

## src/power-handler.c
```c
/*
 * power-handler.c
 *
 *  Created on: Aug 11, 2024
 *      Author: robert
 */
#include <zephyr/kernel.h>
#include <zephyr/drivers/gpio.h>
#include <zephyr/storage/flash_map.h>
#include <gpio/gpio_mcp23xxx.h>

#include "lcc-tortoise-state.h"
#include "tortoise.h"

const static struct gpio_dt_spec volts_line = GPIO_DT_SPEC_GET(DT_NODELABEL(volts), gpios);
static struct gpio_callback volts_cb_data;
static int save_required = 0;

static void power_lost_irq(const struct device *dev, struct gpio_callback *cb,
		    uint32_t pins)
{
	struct mcp23xxx_config* expander_config = lcc_tortoise_state.gpio_expander->config;
	// Disable the GPIO expander in order to save power(maybe)
	gpio_pin_toggle_dt(&expander_config->gpio_reset);

	if(save_required){
		const struct flash_area* location_storage_area = NULL;
		int id = FIXED_PARTITION_ID(location_partition);
		uint8_t data_to_save[8 * 4];
		for(int x = 0; x < 8; x++){
			data_to_save[x] = lcc_tortoise_state.tortoises[x].current_position;
			data_to_save[x + 8] = lcc_tortoise_state.tortoises[x].current_position;
			data_to_save[x + 16] = lcc_tortoise_state.tortoises[x].current_position;
			data_to_save[x + 24] = lcc_tortoise_state.tortoises[x].current_position;
		}

		if(flash_area_open(id, &location_storage_area) < 0){
			return;
		}

		if(flash_area_write(location_storage_area, 0, data_to_save, sizeof(data_to_save)) < 0){
			return;
		}
	}

	while(1){
		printf(",");
		k_msleep(1);
	}
}

void powerhandle_init(){
	int ret;
	if (!gpio_is_ready_dt(&volts_line)) {
		printk("Error: volts not ready\n");
		return;
	}

	ret = gpio_pin_configure_dt(&volts_line, GPIO_INPUT);
	if (ret != 0) {
		printk("Error %d: failed to configure volts line\n");
		return;
	}

	ret = gpio_pin_interrupt_configure_dt(&volts_line,
						  GPIO_INT_TRIG_LOW);
	if (ret != 0) {
		printk("Error %d: failed to configure interrupt on volts\n");
		return;
	}

	gpio_init_callback(&volts_cb_data, power_lost_irq, BIT(volts_line.pin));
	gpio_add_callback(volts_line.port, &volts_cb_data);
}

void powerhandle_check_if_save_required(){
	int old_save_settings = save_required;
	int new_save_settings = 0;

	for(int x = 0; x < 8; x++){
		if(lcc_tortoise_state.tortoise_config[x].startup_control == STARTUP_LAST_POSITION){
			new_save_settings = 1;
		}
	}

	if(new_save_settings == 1 && old_save_settings == 0){
		// We need to save something - let's erase the flash just once.
		const struct flash_area* location_storage_area = NULL;
		int id = FIXED_PARTITION_ID(location_partition);

		if(flash_area_open(id, &location_storage_area) < 0){
			return;
		}

		if(flash_area_erase(location_storage_area, 0, location_storage_area->fa_size) < 0){

		}

		flash_area_close(location_storage_area);
	}

	save_required = new_save_settings;
}
```

## src/power-handler.h
```c
/*
 * power-handler.h
 *
 *  Created on: Aug 11, 2024
 *      Author: robert
 */

#ifndef LCC_TORTOISE_SRC_POWER_HANDLER_H_
#define LCC_TORTOISE_SRC_POWER_HANDLER_H_

void powerhandle_init();

#endif /* LCC_TORTOISE_SRC_POWER_HANDLER_H_ */
```

## src/tortoise-cdi.h
```c
/*
 * tortoise-cdi.h
 *
 *  Created on: Jun 17, 2024
 *      Author: robert
 */

#ifndef LCC_TORTOISE_ZEPHYR_SRC_TORTOISE_CDI_H_
#define LCC_TORTOISE_ZEPHYR_SRC_TORTOISE_CDI_H_

const char cdi[] = {
"<?xml version='1.0'?> \
<cdi xmlns:xsi='http://www.w3.org/2001/XMLSchema-instance' xsi:noNamespaceSchemaLocation='http://openlcb.org/schema/cdi/1/1/cdi.xsd'> \
<identification> \
<manufacturer>Snowball Creek</manufacturer> \
<model>Tortoise LCC-8</model> \
<hardwareVersion>0.1</hardwareVersion> \
<softwareVersion>0.1</softwareVersion> \
</identification> \
<acdi/> \
<segment space='251'> \
<name>Node ID</name> \
<group> \
<name>Your name and description for this node</name> \
<string size='63'> \
<name>Node Name</name> \
</string> \
<string size='64' offset='1'> \
<name>Node Description</name> \
</string> \
</group> \
</segment> \
<segment space='253'> \
<name>Outputs</name> \
<group replication='8'> \
<name>OUT</name> \
<repname>Output</repname> \
<eventid> \
<name>Reversed EventID</name> \
<description>Custom Event ID to use to set the switch to reversed.  Do not use if you are using standard EventIDs for switch control</description> \
</eventid> \
<eventid> \
<name>Normal EventID</name> \
<description>Custom Event ID to use to set the switch to normal.  Do not use if you are using standard EventIDs for switch control</description> \
</eventid> \
<int size='2'> \
<name>DCC Switch number</name> \
<description>The DCC switch number to react to.  When using standard EventIDs, set this value.</description> \
<min>1</min> \
<max>2048</max> \
</int> \
<int size='1'> \
<name>Startup Control</name> \
<description>How this switch should behave on startup</description> \
<map> \
<relation> \
<property>0</property> \
<value>Normal</value> \
</relation> \
<relation> \
<property>1</property> \
<value>Reversed</value> \
</relation> \
<relation> \
<property>2</property> \
<value>Last State</value> \
</relation> \
</map> \
</int> \
<int size='1'> \
<name>Control Type</name> \
<description>How this output is controlled</description> \
<map> \
<relation> \
<property>0</property> \
<value>LCC Only(Standard event IDs)</value> \
</relation> \
<relation> \
<property>1</property> \
<value>DCC Only</value> \
</relation> \
<relation> \
<property>2</property> \
<value>LCC and DCC</value> \
</relation> \
<relation> \
<property>3</property> \
<value>LCC(Custom event IDs)</value> \
</relation> \
</map> \
</int> \
<!-- invisible last known pos, 1 byte --> \
<int size='1' offset='1'> \
<name>Output Type</name> \
<description>How this output is changed</description> \
<map> \
<relation> \
<property>0</property> \
<value>Stall Motor(always-on)</value> \
</relation> \
<relation> \
<property>1</property> \
<value>Pulse</value> \
</relation> \
</map> \
</int> \
<int size='1'> \
<name>Pulse Length</name> \
<description>When output is set to pulse, how long the output is pulsed for</description> \
<map> \
<relation> \
<property>0</property> \
<value>200ms</value> \
</relation> \
<relation> \
<property>1</property> \
<value>400ms</value> \
</relation> \
<relation> \
<property>2</property> \
<value>800ms</value> \
</relation> \
<relation> \
<property>3</property> \
<value>1600ms</value> \
</relation> \
</map> \
</int> \
<!-- align to 32 bytes --> \
<group offset='9'/> \
</group> \
</segment> \
</cdi>"
};

#endif /* LCC_TORTOISE_ZEPHYR_SRC_TORTOISE_CDI_H_ */
```

## src/tortoise.c
```c
/*
 * tortoise.c
 *
 *  Created on: May 19, 2024
 *      Author: robert
 */

#include <zephyr/kernel.h>
#include <zephyr/drivers/gpio.h>
#include <string.h>
#include <stdlib.h>

#include "tortoise.h"
#include "lcc-event.h"

static uint64_t events[2];

static void tortoise_timer_expired(struct k_timer* timer){
	struct tortoise* tort = k_timer_user_data_get(timer);

	gpio_pin_set_dt(&tort->gpios[0], 0);
	gpio_pin_set_dt(&tort->gpios[1], 0);
}

int tortoise_init(struct tortoise* tort){
	int ret = 0;

	if (!gpio_is_ready_dt(&tort->gpios[0])) {
		return -1;
	}
	if (!gpio_is_ready_dt(&tort->gpios[1])) {
		return -1;
	}

	ret = gpio_pin_configure_dt(&tort->gpios[0], GPIO_OUTPUT_INACTIVE);
	if (ret < 0) {
		return -1;
	}
	ret = gpio_pin_configure_dt(&tort->gpios[1], GPIO_OUTPUT_INACTIVE);
	if (ret < 0) {
		return -1;
	}

	k_timer_init(&tort->pulse_timer, tortoise_timer_expired, NULL);
	k_timer_user_data_set(&tort->pulse_timer, tort);

	return 0;
}

int tortoise_init_startup_position(struct tortoise* tort){
	if( tort->config->startup_control == STARTUP_REVERSE ){
		tort->current_position = POSITION_REVERSE;
	}else if( tort->config->startup_control == STARTUP_NORMAL ){
		tort->current_position = POSITION_NORMAL;
	}else{
		tort->current_position = tort->config->last_known_pos;
	}

	return 0;
}

static int tortoise_handle_custom_event(struct tortoise* tort, uint64_t event_id){
	uint64_t throw_event_id = __builtin_bswap64(tort->config->BE_event_id_thrown);
	uint64_t close_event_id = __builtin_bswap64(tort->config->BE_event_id_closed);

	if(event_id == throw_event_id){
		tortoise_set_position(tort, POSITION_REVERSE);
	}else if(event_id == close_event_id){
		tortoise_set_position(tort, POSITION_NORMAL);
	}

	return 0;
}

int tortoise_incoming_event(struct tortoise* tort, uint64_t event_id){
	if(tort->config->control_type == CONTROL_LCC_CUSTOM_EVENT_ID){
		return tortoise_handle_custom_event(tort, event_id);
	}

	if( !lcc_event_id_is_accessory_address( event_id) ){
		return 0;
	}

	struct lcc_accessory_address addr;

	if( lcc_event_id_to_accessory_decoder_2040(event_id, &addr) < 0){
		return -1;
	}

	uint16_t accessory_number = __builtin_bswap16(tort->config->BE_accessory_number);
	if(accessory_number == addr.dcc_accessory_address){
		// This tortoise should change state
		tortoise_set_position(tort, addr.active ? POSITION_NORMAL : POSITION_REVERSE);
	}

	return 0;
}

int tortoise_incoming_accy_command(struct tortoise* tort, uint16_t accy_number, enum tortoise_position pos){
	if(tort->config->control_type == CONTROL_LCC_ONLY ||
			tort->config->control_type == CONTROL_LCC_CUSTOM_EVENT_ID){
		return 0;
	}

	uint16_t accessory_number = __builtin_bswap16(tort->config->BE_accessory_number);
	if(accessory_number == accy_number){
		// This tortoise should change state
		tortoise_set_position(tort, pos);
	}

	return 0;
}

int tortoise_set_position(struct tortoise* tort, enum tortoise_position position){
	tort->current_position = position;
	gpio_pin_set_dt(&tort->gpios[0], 0);
	gpio_pin_set_dt(&tort->gpios[1], 0);

	if(position == POSITION_NORMAL){
		gpio_pin_set_dt(&tort->gpios[0], 0);
		gpio_pin_set_dt(&tort->gpios[1], 1);
	}else{
		gpio_pin_set_dt(&tort->gpios[0], 1);
		gpio_pin_set_dt(&tort->gpios[1], 0);
	}

	if(tort->config->output_type == OUTPUT_TYPE_PULSE){
		int ms = 0;
		switch(tort->config->pulse_len){
		default:
		case 0:
			ms = 200;
			break;
		case 1:
			ms = 400;
			break;
		case 2:
			ms = 800;
			break;
		case 3:
			ms = 1600;
			break;
		}

		printf("Pulse output %d ms\n", ms);
		k_timer_start(&tort->pulse_timer, K_MSEC(ms), K_NO_WAIT);
	}

	return 0;
}

uint64_t* tortoise_events_consumed(struct tortoise* tort){
	memset(events, 0, sizeof(events));

	if(tort->config->control_type == CONTROL_LCC_ONLY){
		struct lcc_accessory_address addr;
		addr.dcc_accessory_address = __builtin_bswap16(tort->config->BE_accessory_number);
		addr.active = 0;

		lcc_accessory_decoder_to_event_id_2040(&addr, &events[0]);

		addr.active = 1;
		lcc_accessory_decoder_to_event_id_2040(&addr, &events[1]);
	}else if(tort->config->control_type == CONTROL_LCC_CUSTOM_EVENT_ID){
		events[0] = __builtin_bswap64(tort->config->BE_event_id_closed);
		events[1] = __builtin_bswap64(tort->config->BE_event_id_thrown);
	}

	return events;
}

int tortoise_disable_outputs(struct tortoise* tort){
	gpio_pin_set_dt(&tort->gpios[0], 0);
	gpio_pin_set_dt(&tort->gpios[1], 0);

	return 0;
}

//int tortoise_config_to_bigendian(struct tortoise* tort, struct tortoise_config* out){
//	if(tort == NULL || out == NULL){
//		return -1;
//	}
//
//	memset(out, 0, sizeof(struct tortoise_config));
//	*out = tort->config;
//	out->event_id_thrown = __builtin_bswap64(tort->config.event_id_thrown);
//	out->event_id_closed = __builtin_bswap64(tort->config.event_id_closed);
//	out->accessory_number = __builtin_bswap16(tort->config.accessory_number);
//
//	return 0;
//}
//
//int tortoise_config_set_from_bigendian(struct tortoise* tort, struct tortoise_config* in){
//	if(tort == NULL || in == NULL){
//		return -1;
//	}
//
//	tort->config = *in;
//	tort->config.event_id_thrown = __builtin_bswap64(in->event_id_thrown);
//	tort->config.event_id_closed = __builtin_bswap64(in->event_id_closed);
//	tort->config.accessory_number = __builtin_bswap16(in->accessory_number);
//
//	return 0;
//}
```
