## boards/io32-plus/Kconfig.io32-plus
```kconfig
# Copyright (c) 2019 Thomas Stranger
# SPDX-License-Identifier: Apache-2.0

config BOARD_IO32_PLUS
	select SOC_STM32G0B1XX
```

## boards/io32-plus/board.yml
```yaml
board:
  name: io32-plus
  vendor: snowball_creek
  socs:
    - name: stm32g0b1xx
  revision:
    format: number
    default: "1"
    revisions:
    - name: "1"
```

## boards/lcc_crossinggate/Kconfig.lcc_crossinggate
```kconfig
# Copyright (c) 2019 Thomas Stranger
# SPDX-License-Identifier: Apache-2.0

config BOARD_LCC_CROSSINGGATE
	select SOC_STM32G0B1XX
```

## boards/lcc_crossinggate/board.yml
```yaml
board:
  name: lcc_crossinggate
  vendor: snowball_creek
  socs:
    - name: stm32g0b1xx
  revision:
    format: number
    default: "1"
    revisions:
    - name: "1"
```

## boards/lcc_link/board.yml
```yaml
board:
  name: lcc_link
  vendor: snowball_creek
  socs:
    - name: stm32g0b1xx
  revision:
    format: number
    default: "2"
    revisions:
    - name: "2"
```

## boards/lcc_smtc8/board.yml
```yaml
board:
  name: lcc_smtc8
  vendor: snowball_creek
  socs:
    - name: stm32g0b1xx
  revision:
    format: number
    default: "1"
    revisions:
    - name: "1"
```

## boards/lcc_tortoise/Kconfig.lcc_tortoise
```kconfig
# Copyright (c) 2019 Thomas Stranger
# SPDX-License-Identifier: Apache-2.0

config BOARD_LCC_TORTOISE
	select SOC_STM32G0B1XX
```

## boards/lcc_tortoise/board.yml
```yaml
board:
  name: lcc_tortoise
  vendor: snowball_creek
  socs:
    - name: stm32g0b1xx
  revision:
    format: number
    default: "3"
    revisions:
    - name: "2"
    - name: "3"
```

## boards/lcc_tortoise_p2/board.yml
```yaml
board:
  name: lcc_tortoise_p2
  vendor: snowball_creek
  socs:
    - name: stm32g0b1xx
  revision:
    format: number
    default: "3"
    revisions:
    - name: "2"
    - name: "3"
```

## boards/servo-tc16/Kconfig.servo-tc16
```kconfig
# Copyright (c) 2019 Thomas Stranger
# SPDX-License-Identifier: Apache-2.0

config BOARD_SERVO_TC16
	select SOC_STM32G0B1XX
```

## boards/servo-tc16/board.yml
```yaml
board:
  name: servo-tc16
  vendor: snowball_creek
  socs:
    - name: stm32g0b1xx
  revision:
    format: number
    default: "1"
    revisions:
    - name: "1"
```
